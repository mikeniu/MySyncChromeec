/* Copyright 2024 The ChromiumOS Authors
 * Use of this source code is governed by a BSD-style license that can be
 * found in the LICENSE file.
 */

&ram_unpadded {
	reg = <0x100000 DT_SIZE_K(256)>;
};