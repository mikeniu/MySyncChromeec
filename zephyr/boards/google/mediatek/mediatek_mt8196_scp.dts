/dts-v1/;
#include <mediatek/mt8196_scp.dtsi>
/ {
	model = "Google Mediatek MT8196 SCP";
	compatible = "google,mediatek-mt8196-scp", "mediatek,mt8196-scp";

	chosen {
		zephyr,sram = &ram0;
		zephyr,console = &uart0;
		zephyr,shell-uart = &uart0;
		zephyr,flash = &flash;
	};

	/*
	 * Empty node to silence the compile time check in config_chip.h
	 */
	flash: flash@0 {
		reg = <0 1>;
	};
};

&uart0 {
	status = "okay";
};
