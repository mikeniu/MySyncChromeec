## zephyr/Kconfig.btn_ign
```kconfig
# Copyright 2026 The ChromiumOS Authors
# Use of this source code is governed by a BSD-style license that can be
# found in the LICENSE file.

DT_ALIAS_BTN_IGN_OUT := gpio-btn-ign-out

config PLATFORM_EC_FINGERPRINT_BTN_IGN_OUT
	bool "Enable power button ignore output"
	help
	  Enables setting power button ignore state by GPIO.
	  Enabled if the gpio-btn-ign-out alias is defined in the DT.
	default y
	depends on $(dt_alias_enabled,$(DT_ALIAS_BTN_IGN_OUT))

config PLATFORM_EC_FINGERPRINT_BTN_IGN_OUT_DELAY_MS
	int "Power button ignore deactivation delay (ms)"
	default 2000
	depends on PLATFORM_EC_FINGERPRINT_BTN_IGN_OUT
	help
	  Delay in milliseconds before deactivating the power button ignore signal.
```

## zephyr/Kconfig.pigweed
```kconfig
# Copyright 2022 The Chromium OS Authors. All rights reserved.
# Use of this source code is governed by a BSD-style license that can be
# found in the LICENSE file.

rsource "../../../third_party/pigweed/Kconfig.zephyr"

config ZEPHYR_PIGWEED_MODULE
        bool "Enable Pigweed Module"
        default y

if ZEPHYR_PIGWEED_MODULE

config PIGWEED_ASSERT
        default y

config PIGWEED_LOG
        default y

# Missing <cstddef>
config PIGWEED_CONTAINERS
        default n

config PIGWEED_CHRONO_SYSTEM_CLOCK
        default y

config PIGWEED_INTERRUPT_CONTEXT
        default y

# Missing <kernel.h>
config PIGWEED_SYNC_BINARY_SEMAPHORE
        default n

config PIGWEED_SYNC_MUTEX
        default y

# Missing <algorithm>
config PIGWEED_SYS_IO
        default n

# Missing <stdint.h>
config PIGWEED_VARINT
       default y

endif # ZEPHYR_PIGWEED_MODULE
```

## zephyr/app/Kconfig.chre
```kconfig
# Copyright 2026 The ChromiumOS Authors
# Use of this source code is governed by a BSD-style license that can be
# found in the LICENSE file.

config ISH_CHRE
	bool "Use CHRE on ISH"
	select PIGWEED_CHRONO_SYSTEM_TIMER
	select PIGWEED_SYNC_INTERRUPT_SPIN_LOCK
	select PIGWEED_SYNC_THREAD_NOTIFICATION
	select PIGWEED_SYNC_TIMED_THREAD_NOTIFICATION
	select PIGWEED_SYS_IO
	select PIGWEED_THREAD
	help
	  Enable the Context Hub Runtime Environment (CHRE) on Intel ISH.
	  CHRE is an event-driven runtime architecture designed for low-power,
	  always-on contextual computing such as sensor fusion, activity
	  recognition, and nanoapps.

config SCP_CHRE
	bool "Use CHRE on SCP"
	select PIGWEED_CHRONO_SYSTEM_TIMER
	select PIGWEED_SYNC_INTERRUPT_SPIN_LOCK
	select PIGWEED_SYNC_THREAD_NOTIFICATION
	select PIGWEED_SYNC_TIMED_THREAD_NOTIFICATION
	select PIGWEED_SYS_IO
	select PIGWEED_THREAD
	help
	  Enable the Context Hub Runtime Environment (CHRE) on MediaTek SCP.
	  CHRE is an event-driven runtime architecture designed for low-power,
	  always-on contextual computing such as sensor fusion, activity
	  recognition, and nanoapps.

if ISH_CHRE || SCP_CHRE

config CHRE_DYNAMIC_MEMORY_SIZE
	int "CHRE memory pool size"
	default 16384
	help
	  Size of the CHRE dynamic memory pool in bytes.

config ISH_CHRE_STACK_SIZE
	int "CHRE thread stack size"
	default 4096
	help
	  Stack size for the CHRE event loop thread in bytes.

config ISH_CHRE_PRIORITY
	int "CHRE thread priority"
	default 5
	help
	  Preemptible priority for the CHRE event loop thread.

config CHRE_TIMER_WORLD
	bool "Load TimerWorld static nanoapp"
	default y
	help
	  Statically link and run the CHRE TimerWorld example nanoapp
	  at boot to verify the CHRE event loop, timers, and nanoapp runtime.

config CHRE_HELLO_WORLD
	bool "Load HelloWorld static nanoapp"
	default n
	help
	  Statically link and run the CHRE HelloWorld example nanoapp
	  at boot to verify the CHRE event loop and nanoapp runtime.

config CHRE_SENSOR_WORLD
	bool "Load SensorWorld static nanoapp"
	default n
	help
	  Statically link and run the CHRE SensorWorld example nanoapp
	  at boot to verify the CHRE sensor PAL and sensor event pipeline.

config CHRE_MESSAGE_WORLD
	bool "Load MessageWorld static nanoapp"
	default n
	help
	  Statically link and run the CHRE MessageWorld example nanoapp
	  at boot to verify host-nanoapp messaging over HostLink.

endif # ISH_CHRE || SCP_CHRE
```

## zephyr/app/ec/chip/arm/st_stm32/Kconfig.stm32
```kconfig
# Copyright 2023 The ChromiumOS Authors.
# Use of this source code is governed by a BSD-style license that can be
# found in the LICENSE file.

if SOC_FAMILY_STM32

DT_CHOSEN_Z_SRAM := zephyr,sram

configdefault CROS_EC_PROGRAM_MEMORY_BASE
	default FLASH_BASE_ADDRESS

configdefault CROS_EC_RAM_BASE
	default SRAM_BASE_ADDRESS

configdefault CROS_EC_DATA_RAM_SIZE
	default $(dt_chosen_reg_size_hex,$(DT_CHOSEN_Z_SRAM))

configdefault CROS_EC_RAM_SIZE
	default $(dt_chosen_reg_size_hex,$(DT_CHOSEN_Z_SRAM))

configdefault CROS_EC_RO_MEM_OFF
	default $(dt_node_int_prop_hex,/binman/wp-ro,offset)

configdefault CROS_EC_RW_MEM_OFF
	default $(dt_node_int_prop_hex,/binman/ec-rw,offset)

# Tell the linker where the RO/RW part is.
configdefault FLASH_LOAD_OFFSET
	default CROS_EC_RO_MEM_OFF if CROS_EC_RO
	default CROS_EC_RW_MEM_OFF if CROS_EC_RW

endif # SOC_FAMILY_STM32
```

## zephyr/boards/google/mediatek/board.yml
```yaml
board:
  name: mediatek
  full_name: Mediatek EC
  vendor: google
  socs:
    - name: mt8196_scp
```

## zephyr/drivers/cros_irq/Kconfig
```kconfig
# Copyright 2021 The ChromiumOS Authors
# Use of this source code is governed by a BSD-style license that can be
# found in the LICENSE file.

config CROS_EC_IRQ_GPIO
	bool
	default y
	depends on DT_HAS_CROS_EC_IRQ_GPIO_ENABLED
	help
	  This option enables Serial Host Interface driver for the NPCX family
	  of processors. This is used for host-command communication on the
	  platform which AP is ARM-based SoC.

if CROS_EC_IRQ_GPIO
config IRQ_GPIO_INIT_PRIORITY
	int "Cros EC IRQ GPIO driver priority"
	default 100
	help
	  This is the driver priority
endif
```

## zephyr/drivers/fingerprint/Kconfig.rts5817maa
```kconfig
# Copyright 2026 The ChromiumOS Authors
# Use of this source code is governed by a BSD-style license that can be
# found in the LICENSE file.


menuconfig FINGERPRINT_SENSOR_RTS5817MAA
	bool "Fingerprint driver for RTS5817MAA"
	default y
	depends on DT_HAS_REALTEK_RTS5817MAA_ENABLED
	help
	  Driver for RTS5817MAA fingerprint sensor. It requires RTS5817MAA private
	  library to implement cros_fingerprint API.

if FINGERPRINT_SENSOR_RTS5817MAA

config FINGERPRINT_SENSOR_RTS5817MAA_HEAP_SIZE
	int "Size of heap for RTS5817MAA driver"
	default 34816
	help
	  Size of heap to be used by RTS5817MAA private library. The heap must have
	  enough size to keep finger templates during matching.
	  106KB is enough to match 3 templates at once.

config FINGERPRINT_SENSOR_RTS5817MAA_PAL
	bool "Platform Abstraction Layer for RTS5817MAA private library"
	default y if HAVE_RTS5817MAA_PRIVATE_DRIVER
	help
	  If enabled, Platform Abstraction Layer for RTS5817MAA private library will
	  be compiled. The PAL is used to interact with the sensor (SPI, GPIO)
	  and the system (heap allocations, printing messages, time functions).

# Enabled in private driver Kconfig
config HAVE_RTS5817MAA_PRIVATE_DRIVER
	bool
	default n
	help
	  If enabled, it indicates that the private driver is present.

endif # FINGERPRINT_SENSOR_RTS5817MAA
```
