/* Copyright 2026 The ChromiumOS Authors
 * Use of this source code is governed by a BSD-style license that can be
 * found in the LICENSE file.
 */

#include <zephyr/dt-bindings/pwm/it8xxx2_pwm.h>
#include <it8xxx2_emul.dts>
#include <board-overlays/common_native_sim.dtsi>

&gpioksoh {
	ngpios = <10>;
};
