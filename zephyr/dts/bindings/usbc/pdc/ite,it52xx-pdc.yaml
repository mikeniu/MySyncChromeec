## zephyr/dts/bindings/usbc/pdc/ite,it52xx-pdc.yaml
```yaml
# Copyright 2026 Google LLC
# Use of this source code is governed by a BSD-style license that can be
# found in the LICENSE file.

description: ITE PDC it52xx

compatible: "ite,it52xx-pdc"

include: ["i2c-device.yaml", "pdc-device.yaml"]

properties:
  irq-gpios:
    type: phandle-array
    required: true
    description: |
      Interrupt line from the PDC (Zephyr standard GPIO format).
  port-index-on-chip:
    type: int
    enum:
      - 1
    required: true
    description: |
      Connector number used in UCSI commands sent to the PDC. The IT5271 is a
      single-port PDC, so this value must be 1.
```

## zephyr/dts/bindings/wot/cros-ec,wot.yaml
```yaml
# Copyright 2026 The ChromiumOS Authors
# Use of this source code is governed by a BSD-style license that can be
# found in the LICENSE file.

description: ChromeOS EC Wake-On-Touch (WOT) Controller

compatible: "cros-ec,wot"

include: base.yaml

properties:
  report-en-gpios:
    type: phandle-array
    required: true
    description: GPIO to enable touch screen reporting

  wot-l-gpios:
    type: phandle-array
    required: true
    description: GPIO to assert WOT state (Active Low)

  bl-detect-gpios:
    type: phandle-array
    required: true
    description: GPIO to detect EDP backlight state

  tchscr-int-gpios:
    type: phandle-array
    required: true
    description: GPIO for touch screen interrupt
```

## zephyr/program/calypso/Kconfig
```kconfig
# Copyright 2026 The ChromiumOS Authors
# Use of this source code is governed by a BSD-style license that can be
# found in the LICENSE file.

config BOARD_CALYPSO
	bool "Google Calypso reference board"
	help
	  Build Google Calypso reference board. The board uses Nuvoton
	  NPCX9 chip as the EC.

config BOARD_MENSA
	bool "Google Mensa board"
	help
	  Build Google Mensa board. The board uses Nuvoton
	  NPCX9 chip as the EC.

module = Calypso
module-str = Calypso board-specific code
source "subsys/logging/Kconfig.template.log_config"

source "Kconfig.zephyr"
```

## zephyr/shim/chip/it8xxx2/Kconfig.it8xxx2
```kconfig
# Copyright 2026 The ChromiumOS Authors
# Use of this source code is governed by a BSD-style license that can be
# found in the LICENSE file.

if PLATFORM_EC

config CROS_SYSTEM_IT8XXX2_PRE_INIT_PRIORITY
	int "System pre-initialization priority"
	default 60
	depends on SOC_FAMILY_ITE_EC
	help
	  This sets the priority of the ITE it8xxx2 chip system initialization.
	  The chip system initialization verifies the integrity of the BBRAM
	  must be a lower priority than CONFIG_BBRAM_INIT_PRIORITY and

endif # PLATFORM_EC
```

## zephyr/subsys/ascp/Kconfig
```kconfig
# Copyright 2026 The ChromiumOS Authors
# Use of this source code is governed by a BSD-style license that can be
# found in the LICENSE file.

config ASCP
	bool "Enable ASCP support"
	help
	  Enables support for ASCP (Authentication Service Control Protocol).

config ASCP_MEM_PLATFORM
	bool "Enable ASCP memory based platform"
	help
	  Enables support for ASCP HW platforms where ASCP data is available in memory.
	select ASCP

choice
	prompt "Select ASCP HW platform"
	optional
	help
	  Selects the ASCP HW platform.

config ASCP_ET171
	bool "Enable ASCP for ET171"
	help
	  Enables ASCP support for ET171.
	select ASCP_MEM_PLATFORM

endchoice
```

## zephyr/subsys/chre/Kconfig
```kconfig
# Copyright 2026 The ChromiumOS Authors
# Use of this source code is governed by a BSD-style license that can be
# found in the LICENSE file.

config ISH_CHRE
	bool "Use CHRE on ISH"
	help
	  Enable the Context Hub Runtime Environment (CHRE) on Intel ISH.
	  CHRE is an event-driven runtime architecture designed for low-power,
	  always-on contextual computing such as sensor fusion, activity
	  recognition, and nanoapps.

if ISH_CHRE

config CHRE_DYNAMIC_MEMORY_SIZE
	int "CHRE memory pool size"
	default 65536
	help
	  Size of the CHRE dynamic memory pool in bytes.

config ISH_CHRE_STACK_SIZE
	int "CHRE thread stack size"
	default 4096
	help
	  Stack size for the CHRE event loop thread in bytes.

config ISH_CHRE_PRIORITY
	int "CHRE thread priority"
	default 5
	help
	  Preemptible priority for the CHRE event loop thread.

config CHRE_TIMER_WORLD
	bool "Load TimerWorld static nanoapp"
	default n
	help
	  Statically link and run the CHRE TimerWorld example nanoapp
	  at boot to verify the CHRE event loop, timers, and nanoapp runtime.

config CHRE_HELLO_WORLD
	bool "Load HelloWorld static nanoapp"
	default n
	help
	  Statically link and run the CHRE HelloWorld example nanoapp
	  at boot to verify the CHRE event loop and nanoapp runtime.

config CHRE_DYNAMIC_NANOAPPS
	bool "Build dynamic nanoapps alongside ISH image"
	default y
	help
	  Build dynamic nanoapps (.so) targeting ISH alongside the ISH image.
	  The resulting nanoapps are output under nanoapps/ in the build
	  directory, ready for loading via ectool chreload.

config CHRE_HOST_TUNNEL
	bool "Enable bidirectional FlatBuffer tunneling for CHRE host daemon"
	default y
	help
	  Enable EC_CMD_CHRE_HOST_TO_TARGET and EC_CMD_CHRE_TARGET_TO_HOST
	  commands for bidirectional CHRE FlatBuffer communication with the
	  host chre_daemon_cros over /dev/cros_ish.

endif # ISH_CHRE
```

## zephyr/subsys/emul/charge/Kconfig
```kconfig
# Copyright 2026 The ChromiumOS Authors
# Use of this source code is governed by a BSD-style license that can be
# found in the LICENSE file.

config PLATFORM_EC_CHARGE_EMUL
	bool "Emulator charge module"
	help
	  Enables the emulator charge module, allowing
	  the LED driver to use it for LED detection without the full charge manager.

if PLATFORM_EC_CHARGE_EMUL

config PLATFORM_EC_CHARGE_EMUL_CONSOLE_COMMAND
	bool "Console command for charge emulator"
	default n
	help
	  Enables the 'emul_charge' console command for manual control
	  of the charge emulator.

module = PLATFORM_EC_CHARGE_EMUL
module-str = charge_emul
source "subsys/logging/Kconfig.template.log_config"

endif # PLATFORM_EC_CHARGE_EMUL
```

## zephyr/subsys/hdlc_router/Kconfig
```kconfig
# Copyright 2026 The ChromiumOS Authors
# Use of this source code is governed by a BSD-style license that can be
# found in the LICENSE file.

config PLATFORM_EC_HDLC_ROUTER
	bool "Enable HDLC Router subsystem"
	depends on CPP
	select PIGWEED_BYTES
	select PIGWEED_CHECKSUM
	select PIGWEED_HDLC
	select PIGWEED_RESULT
	select PIGWEED_STATUS
	select PIGWEED_STREAM
	select PIGWEED_VARINT
	help
	  Enables the ChromeOS EC Pigweed HDLC Router subsystem for
	  multiplexing and demultiplexing Host Commands, console logs,
	  and RPC channels over HDLC serial streams.

config PLATFORM_EC_HDLC_ROUTER_SHELL
	bool "Enable HDLC Router Shell integration"
	depends on PLATFORM_EC_HDLC_ROUTER
	depends on SHELL
	default y
	help
	  Enables console commands and UART shell bypass mode for interactive
	  and automated HDLC communication over the main EC UART console.
```

## zephyr/subsys/hdlc_transport/Kconfig
```kconfig
# Copyright 2026 The ChromiumOS Authors
# Use of this source code is governed by a BSD-style license that can be
# found in the LICENSE file.

menuconfig HDLC_TRANSPORT
	bool "HDLC Transport over UART"
	select CPP
	select REQUIRES_FULL_LIBCPP
	select PIGWEED_BYTES
	select PIGWEED_CHECKSUM
	select PIGWEED_RESULT
	select PIGWEED_SPAN
	select PIGWEED_STATUS
	select PIGWEED_STREAM
	help
	  Enables HDLC frame encapsulation over the EC UART interface using
	  Pigweed (pw_hdlc). Multiplexes shell, log, and RPC channels.

if HDLC_TRANSPORT

config HDLC_TRANSPORT_MAX_FRAME_SIZE
	int "Maximum HDLC frame size in bytes"
	default 1024
	help
	  Maximum size of unescaped frame payload that the decoder can process.

config HDLC_TRANSPORT_RX_BUF_SIZE
	int "HDLC UART RX ring buffer size in bytes"
	default 512
	help
	  Size of ring buffer between UART ISR and HDLC RX decoder thread.

config HDLC_TRANSPORT_RX_STACK_SIZE
	int "HDLC RX thread stack size"
	default 2048
	help
	  Stack size for the HDLC RX decoder worker thread.

config HDLC_TRANSPORT_RX_PRIORITY
	int "HDLC RX thread priority (preemptive)"
	default 1
	help
	  Priority of the HDLC RX thread.

config HDLC_TRANSPORT_INIT_PRIORITY
	int "HDLC transport initialization priority"
	default 60
	help
	  Init priority for HDLC transport (runs during POST_KERNEL).

config SHELL_BACKEND_HDLC
	bool "HDLC shell backend"
	depends on SHELL
	default y if !SHELL_BACKEND_SERIAL
	help
	  Enable HDLC-encapsulated Zephyr shell on channel HDLC_ADDR_SHELL (2).

if SHELL_BACKEND_HDLC

config SHELL_PROMPT_HDLC
	string "HDLC shell prompt"
	default "uart:~$ "
	help
	  Command prompt for HDLC shell backend.

config SHELL_BACKEND_HDLC_RX_RING_BUFFER_SIZE
	int "HDLC shell RX ring buffer size"
	default 256
	help
	  Size of ring buffer for incoming shell keystrokes/data.

config SHELL_BACKEND_HDLC_LOG_MESSAGE_QUEUE_TIMEOUT
	int "Log message queue timeout in ms"
	default 100

config SHELL_BACKEND_HDLC_LOG_MESSAGE_QUEUE_SIZE
	int "Log message queue size"
	default 10

config SHELL_BACKEND_HDLC_INIT_PRIORITY
	int "HDLC shell backend init priority"
	default 90
	help
	  Init priority for HDLC shell backend.

endif # SHELL_BACKEND_HDLC

config LOG_BACKEND_HDLC
	bool "HDLC logging backend"
	depends on LOG && !LOG_MODE_MINIMAL
	select LOG_OUTPUT
	default y
	help
	  Enable dedicated HDLC logging backend on channel HDLC_ADDR_LOG (1).

if LOG_BACKEND_HDLC

config LOG_BACKEND_HDLC_AUTOSTART
	bool "Automatically start HDLC logging backend"
	default y

config LOG_BACKEND_HDLC_BUFFER_SIZE
	int "HDLC log line buffer size"
	default 256
	help
	  Size of formatted log line buffer before HDLC encapsulation.

config LOG_BACKEND_HDLC_OUTPUT_DEFAULT
	int "Default log output format"
	default 0
	help
	  Log format (0 = standard text).

endif # LOG_BACKEND_HDLC

endif # HDLC_TRANSPORT
```

## zephyr/subsys/virtual/charge/Kconfig
```kconfig
# Copyright 2026 The ChromiumOS Authors
# Use of this source code is governed by a BSD-style license that can be
# found in the LICENSE file.

config PLATFORM_EC_CHARGE_VIRTUAL
	bool "Virtual charge module"
	help
	  Enables the virtual charge module, allowing
	  the LED driver to use it for LED detection without the full charge manager.

if PLATFORM_EC_CHARGE_VIRTUAL

config PLATFORM_EC_CHARGE_VIRTUAL_CONSOLE_COMMAND
	bool "Console command for charge virtual module"
	default n
	help
	  Enables the 'virtual_charge' console command for manual control
	  of the charge virtual module.

module = PLATFORM_EC_CHARGE_VIRTUAL
module-str = charge_virtual
source "subsys/logging/Kconfig.template.log_config"

endif # PLATFORM_EC_CHARGE_VIRTUAL
```

## zephyr/test/atria/testcase.yaml
```yaml
# Copyright 2026 The ChromiumOS Authors
# Use of this source code is governed by a BSD-style license that can be
# found in the LICENSE file.

common:
  platform_allow:
    - native_sim
tests:
  atria.atriarvp-rtk:
    extra_configs:
      - CONFIG_PDC_RUNTIME_PORT_CONFIG=y
    extra_dtc_overlay_files:
      - "boards/native_sim.overlay"
  atria.penghu.keyboard:
    extra_configs:
      - CONFIG_TEST_BOARD_PENGHU=y
      - CONFIG_TEST_BOARD_PENGHU_KEYBOARD=y
      - CONFIG_PLATFORM_EC_KEYBOARD_CUSTOMIZATION=y
      - CONFIG_PLATFORM_EC_KEYBOARD_DEBUG=y
      - CONFIG_POSIX_ARCH_CONSOLE_INIT_PRIORITY=98
      - CONFIG_PLATFORM_EC_CONSOLE_INIT_PRIORITY=99
      - CONFIG_LOG=y
      - CONFIG_LOG_MODE_MINIMAL=y
    extra_dtc_overlay_files:
      - "boards/penghu/keyboard.dtsi"
  atria.penghu.fan:
    extra_configs:
      - CONFIG_TEST_BOARD_PENGHU=y
      - CONFIG_TEST_BOARD_PENGHU_FAN=y
      - CONFIG_PLATFORM_EC_CUSTOM_FAN_CONTROL=y
      - CONFIG_POSIX_ARCH_CONSOLE_INIT_PRIORITY=98
      - CONFIG_PLATFORM_EC_CONSOLE_INIT_PRIORITY=99
    extra_dtc_overlay_files:
      - "boards/penghu/fan.dtsi"
```

## zephyr/test/drivers/board_id_intel_rvp/testcase.yaml
```yaml
common:
  platform_allow:
    - native_sim
tests:
  drivers.board_id_intel_rvp:
    extra_dtc_overlay_files:
      - boards/native_sim.overlay
```

## zephyr/test/drivers/input_ite_it8801_kbd/testcase.yaml
```yaml
common:
  platform_allow:
    - native_sim
tests:
  input_ite_it8801_kbd.default: {}
```
