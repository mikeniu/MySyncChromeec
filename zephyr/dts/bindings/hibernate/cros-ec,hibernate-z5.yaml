## zephyr/dts/bindings/switchcap/cros-ec,switchcap-comparator.yaml
```yaml
# Copyright 2026 The ChromiumOS Authors
# Use of this source code is governed by a BSD-style license that can be
# found in the LICENSE file.

description: |
  ChromiumOS Switchcap Driver with GPIO enable and comparator power-good

compatible: "cros-ec,switchcap-comparator"

properties:
  enable-gpios:
    type: phandle-array
    required: true
    description: Output GPIO used to enable the switchcap.

  power-good-comp:
    type: phandle
    required: true
    description: |
      Phandle to a Zephyr comparator device used to read switchcap
      power-good status.

  power-off-delay-ms:
    type: int
    description: Additional power-off delay in milliseconds.
```

## zephyr/dts/bindings/switchcap/cros-ec,switchcap.yaml
```yaml
# Copyright 2026 The ChromiumOS Authors
# Use of this source code is governed by a BSD-style license that can be
# found in the LICENSE file.

description: ChromiumOS Switchcap driver

compatible: "cros-ec,switchcap"

include: base.yaml

properties:
  enable-gpios:
    type: phandle-array
    required: true
    description: GPIO used to enable the switchcap converter.

  power-good-gpios:
    type: phandle-array
    description: GPIO used to monitor the power-good status of the switchcap.

  power-good-comp:
    type: phandle
    description:
      Comparator device used to monitor the power-good status of the switchcap.

  power-off-delay-ms:
    type: int
    description:
      Optional delay in milliseconds to wait after disabling the switchcap
      before returning.
```
