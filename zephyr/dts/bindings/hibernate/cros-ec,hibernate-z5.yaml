## zephyr/dts/bindings/i2c/cros-ec-i2c-passthru.yaml
```yaml
# Copyright 2026 The ChromiumOS Authors
# Use of this source code is governed by a BSD-style license that can be
# found in the LICENSE file.

description: |
  I2C passthru configuration parent and child node binding.

  Example:
        i2c-passthru {
                compatible = "cros-ec,i2c-passthru";
                #address-cells = <1>;
                #size-cells = <0>;

                i2c_passthru_c0: port0@0 {
                        reg = <0>;
                        i2c-port = <&i2c_c0>;
                };
        };

compatible: "cros-ec,i2c-passthru"

include: base.yaml

properties:
  "#address-cells":
    required: true
    const: 1
  "#size-cells":
    required: true
    const: 0

child-binding:
  description: I2C passthru port configuration
  include:
    - name: base.yaml
      property-allowlist:
        - reg
  properties:
    i2c-port:
      type: phandle
      description: |
        Handle to the I2C port.
    devices:
      type: uint8-array
      description: |
        List of permissible 7-bit I2C device addresses for passthru on this port.
        If empty or omitted, all addresses on this port are allowed.
    allow-type:
      type: string
      enum:
        - "ALLOW_IF_UNPROTECTED_BY_AP"
        - "VIRTUAL_BATTERY"
      description: |
        Passthru check type for this port. The default is
        "ALLOW_IF_UNPROTECTED_BY_AP", which protects the port only if
        system_is_locked() is true and port protection has been enabled by the
        AP invoking the EC_CMD_I2C_PASSTHRU_PROTECT command.
```

## zephyr/dts/bindings/i2c/cros-ec-i2c-port-base.yaml
```yaml
# Copyright 2021 The ChromiumOS Authors
# SPDX-License-Identifier: Apache-2.0

description: I2C port base properties

properties:
  i2c-port:
    type: phandle
    required: true
  remote-port:
    type: int
    description:
      A port number used by remote components like Kernel via the I2C_PASSTHRU
      Host Command
  enum-names:
    type: string-array
    required: true
    description:
      Enum values used in the source code to refer to the i2c port
  dynamic-speed:
    type: boolean
    description:
      Enables run-time speed configuration.
  protect-type:
    type: string
    default: I2C_PROTECT_TYPE_NONE
    description:
      Protection type for the I2C port.
    enum:
      - I2C_PROTECT_TYPE_NONE
      - PROTECT_IF_SYSTEM_IS_LOCKED
      - NO_PROTECT_UNTIL_ENABLED
  allow-passthru:
    type: string
    description:
      Function name of the allow-passthru function, which returns false if the
      i2c sequence is not allowed to passthru.
```

## zephyr/dts/bindings/imvp/richtek,rtq3700fh.yaml
```yaml
# Copyright 2026 The ChromiumOS Authors
# Use of this source code is governed by a BSD-style license that can be
# found in the LICENSE file.

description: Richtek RTQ3700FH IMVP9.3 Controller

include: i2c-device.yaml

compatible: "richtek,rtq3700fh"

properties:
  enable-gpios:
    type: phandle-array
    required: true
    description:
      Power supply control for RTQ3700FH (zephyr standard GPIO format)
  update-data:
    type: array
    required: true
    description:
      Array of NVM update entries generated using the dt-bindings macros.
      RTQ_WRITE_BYTE(), RTQ_WRITE_WORD(), or RTQ_WRITE_BLOCK().
      The driver sequentially parses the array as [page, reg, length, data...]
      to support variable-length PMBus block writes.
  update-crc:
    type: int
    required: false
    description: Expected NVM Checksum.
```

## zephyr/dts/bindings/input/cros-ec,boot-keys.yaml
```yaml
# Copyright 2024 Google LLC
# Use of this source code is governed by a BSD-style license that can be
# found in the LICENSE file.

description: |
  Boot keys definition.

  This can be used to define the key combinations that trigger boot key events:
  recovery mode, force memory retraining and boot without starting the AP.

  Example configuration:

  kbd {
      boot-keys {
          compatible = "cros-ec,boot-keys";
          down-arrow-rc = <KBD_RC(6, 11)>;
          esc-rc = <KBD_RC(1, 1)>;
          left-shift-rc = <KBD_RC(5, 7)>;
          refresh-rc = <KBD_RC(3, 2)>;
      };
  };

  If the board supports multiple keyboard layouts, the keys can be specified
  in one child node per layout instead, the active one is then selected by
  implementing board_boot_keys_idx(), for example:

  kbd {
      boot-keys {
          compatible = "cros-ec,boot-keys";

          boot_keys_0: boot-keys-0 {
              down-arrow-rc = <KBD_RC(6, 11)>;
              esc-rc = <KBD_RC(1, 1)>;
              left-shift-rc = <KBD_RC(5, 7)>;
              refresh-rc = <KBD_RC(3, 2)>;
          };

          boot_keys_1: boot-keys-1 {
              down-arrow-rc = <KBD_RC(5, 16)>;
              esc-rc = <KBD_RC(1, 1)>;
              left-shift-rc = <KBD_RC(1, 0)>;
              refresh-rc = <KBD_RC(3, 2)>;
          };
      };
  };

compatible: "cros-ec,boot-keys"

include: base.yaml

properties:
  down-arrow-rc:
    type: int
    description: |
      Row-column position of the "down arrow" key, required if no child nodes
      are defined.

  esc-rc:
    type: int
    description: |
      Row-column position of the "esc" key, required if no child nodes are
      defined.

  left-shift-rc:
    type: int
    description: |
      Row-column position of the "left shift" key, required if no child nodes
      are defined.

  refresh-rc:
    type: int
    description: |
      Row-column position of the "refresh" key, required if no child nodes are
      defined.

child-binding:
  description: Boot keys configuration for a specific keyboard layout.
  properties:
    down-arrow-rc:
      type: int
      required: true
      description: Row-column position of the "down arrow" key.

    esc-rc:
      type: int
      required: true
      description: Row-column position of the "esc" key.

    left-shift-rc:
      type: int
      required: true
      description: Row-column position of the "left shift" key.

    refresh-rc:
      type: int
      required: true
      description: Row-column position of the "refresh" key.
```

## zephyr/dts/bindings/input/cros-ec,fn-keys.yaml
```yaml
# Copyright 2025 Google LLC
# Use of this source code is governed by a BSD-style license that can be
# found in the LICENSE file.

description: |
  Fn keys definition

  This can be used to TODO TODO TODO

  Example configuration:

  kbd {
      fn-keys {
          compatible = "cros-ec,fn-keys";

          fn-rc = <KBD_RC(2, 0)>;
          keymap = <
            MATRIX_KEY(1, 1, KBD_SCANCODE_F1)
            MATRIX_KEY(0, 2, KBD_SCANCODE_F2)
            ...
            MATRIX_KEY(0, 4, KBD_SCANCODE_F11)
            MATRIX_KEY(3, 9, KBD_SCANCODE_F12)
          >;
      };
  };

compatible: "cros-ec,fn-keys"

include: base.yaml

properties:
  fn-rc:
    type: int
    required: true
    description: Row-column position of the "Fn" key.

  keymap:
    type: array
    required: true
    description: |
      List of row, key and codes, using the MATRIX_KEY() macro.

  alt-fn-rc:
    type: int
    description: |
      Row-column position of the "Fn" key after
      fn_keys_use_alternate(), defaults to fn-rc.

  alt-keymap:
    type: array
    description: |
      Keymap used after fn_keys_use_alternate(), must have the same number
      of entries as keymap.
```

## zephyr/dts/bindings/input/cros-ec,irq-gpio.yaml
```yaml
# Copyright 2024 Google LLC
# Use of this source code is governed by a BSD-style license that can be
# found in the LICENSE file.

description: |
  GPIO IRQ bindinggs.

compatible: "cros-ec,irq-gpio"

child-binding:
  description: GPIO IRQ definition.

  properties:
    gpios:
      type: phandle-array
      required: true
      description: |
        GPIO that will detect interruption.

    flags:
      type: int
      description: The zephyr gpio interrupt config flags.

    debounce-ms:
      type: int
      default: 0
      description: |
        Debounce time in milliseconds.

    enable-on-init:
      type: boolean
      description: |
        Defines if this irq is enabled once initialized..

    fire-on-init:
      type: boolean
      description: |
        Defines if this irq is fired one time after it has been initialized.
```

## zephyr/dts/bindings/input/cros-ec,runtime-keys.yaml
```yaml
# Copyright 2024 Google LLC
# Use of this source code is governed by a BSD-style license that can be
# found in the LICENSE file.

description: |
  Runtime keys definition.

  This can be used to define the key combinations that trigger runtime key
  events for reboot and hibernate. Note that the volume up key combination is
  obtained automatically from the Vivaldi configuration node, which allows
  selecting different mappings at boot time..

  Example configuration:

  kbd {
      runtime-keys {
          compatible = "cros-ec,runtime-keys";
          left-alt-rc = <KBD_RC(0, 10)>;
          right-alt-rc = <KBD_RC(6, 10)>;
          h-rc = <KBD_RC(1, 6)>;
          r-rc = <KBD_RC(7, 3)>;
      };
  };

compatible: "cros-ec,runtime-keys"

include: base.yaml

properties:
  left-alt-rc:
    type: int
    required: true
    description: Row-column position of the "left alt" key.

  right-alt-rc:
    type: int
    required: true
    description: Row-column position of the "right alt" key.

  h-rc:
    type: int
    required: true
    description: Row-column position of the "h" key.

  r-rc:
    type: int
    required: true
    description: Row-column position of the "r" key.

  vol-up-rc:
    type: int
    description: |
      Row-column position of the "volume up" key, only required when using the
      MKBP keyboard protocol.

  alt-left-alt-rc:
    type: int
    description: |
      Row-column position of the "left alt" key after
      runtime_keys_use_alternate(), defaults to left-alt-rc.

  alt-right-alt-rc:
    type: int
    description: |
      Row-column position of the "right alt" key after
      runtime_keys_use_alternate(), defaults to right-alt-rc.

  alt-h-rc:
    type: int
    description: |
      Row-column position of the "h" key after
      runtime_keys_use_alternate(), defaults to h-rc.

  alt-r-rc:
    type: int
    description: |
      Row-column position of the "r" key after
      runtime_keys_use_alternate(), defaults to r-rc.
```

## zephyr/dts/bindings/intel/intel,dtt-sensors.yaml
```yaml
# Copyright (c) 2026
# SPDX-License-Identifier: Apache-2.0

description: Intel DTT (Dynamic Tuning Technology) sensors configuration

compatible: "intel,dtt-sensors"

include: base.yaml

properties:
  interface:
    type: phandle
    required: true
    description: |
      Phandle to the PECI interface controller used to communicate with sensors.
      Example: interface = &ec_peci;

child-binding:
  description: |
    A DTT sensor channel configuration. Each child node represents one thermal
    channel (e.g., skin temperature sensor).
  properties:
    type:
      type: string
      required: true
      description: Sensor category/type used by DTT policy.
      enum:
        - TEMP_SKIN
        - TEMP_DDR

    sensor:
      type: phandle
      required: true
      description: |
        Phandle to the underlying sensor device (e.g., an ADC, thermal sensor,
        or virtual sensor node).

    target:
      type: int
      required: true
      description: Target temperature threshold (unit defined by the consumer, typically °C).

    gain:
      type: int
      required: true
      description: Gain factor used in DTT control loop.

    min-perf-level:
      type: int
      required: true
      description: Minimum performance level to maintain.

    period-s0:
      type: int
      required: true
      description: Polling/control period in milliseconds for S0 (active) state.

    period-s5:
      type: int
      required: true
      description: Polling/control period in milliseconds for S5 (soft-off) state.
```

## zephyr/dts/bindings/intel/intel,stc-sensors.yaml
```yaml
# Copyright (c) 2026
# SPDX-License-Identifier: Apache-2.0

description: Intel STC (Skin Temperature Control) sensors configuration

compatible: "intel,stc-sensors"

include: base.yaml

properties:
  interface:
    type: phandle
    required: true
    description: |
      Phandle to the PECI interface controller used to communicate with sensors.
      Example: interface = &ec_peci;

child-binding:
  description: |
    A STC sensor channel configuration. Each child node represents one thermal
    channel (e.g., skin temperature sensor).
  properties:
    sensor:
      type: phandle
      required: true
      description: |
        Phandle to the underlying sensor device (e.g., an ADC, thermal sensor,
        or virtual sensor node).

    target:
      type: int
      required: true
      description: Target temperature threshold (unit defined by the consumer, typically °C).

    gain:
      type: int
      required: true
      description: Gain factor used in STC control loop.

    min-perf-level:
      type: int
      required: true
      description: Minimum performance level to maintain.

    period-s0:
      type: int
      required: true
      description: Polling/control period in milliseconds for S0 (active) state.

    period-s5:
      type: int
      required: true
      description: Polling/control period in milliseconds for S5 (soft-off) state.
```

## zephyr/dts/bindings/power/cros-ec,gpio-suspend-resume.yaml
```yaml
# Copyright 2026 The ChromiumOS Authors
# Use of this source code is governed by a BSD-style license that can be
# found in the LICENSE file.

description: |
  Driver to control GPIOs based on AP power state.
  GPIOs referenced by their named-gpio node phandles are asserted
  (set active) on AP POWER_STARTUP / POWER_PRE_INIT and de-asserted
  (set inactive) on AP POWER_HARD_OFF.

  The driver reads GPIO specs from the referenced named-gpio nodes,
  using the same flags and pin configuration already defined there.

compatible: "cros-ec,gpio-suspend-resume"

properties:
  gpio-list:
    type: phandles
    required: true
    description: |
      Array of phandles to named-gpio nodes. These GPIOs are asserted
      (set active) on POWER_STARTUP and de-asserted (set inactive) on
      POWER_HARD_OFF.
```

## zephyr/dts/bindings/pwrmon/pwrmon.yaml
```yaml
description: EC Power Monitoring subsystem

compatible: "cros,pwrmon"

properties:
  sample-rate:
    type: int
    required: true
    description: Default sampling rate in Hz

  power-monitors:
    type: phandles
    required: true
    description: List of phandles pointing to power monitors sensors

  gpios:
    type: phandle-array
    description: GPIO used to switch the I2C bus to the EC
```

## zephyr/dts/bindings/switchcap/cros-ec,switchcap-adc.yaml
```yaml
# Copyright 2026 The ChromiumOS Authors
# Use of this source code is governed by a BSD-style license that can be
# found in the LICENSE file.

description: ChromiumOS Switchcap Driver with ADC power-good monitoring

compatible: "cros-ec,switchcap-adc"

properties:
  enable-gpios:
    type: phandle-array
    required: true
    description: Output GPIO used to enable the switchcap.

  power-good-adc:
    type: phandle
    required: true
    description: Named ADC channel node used to read switchcap voltage (mV).

  power-good-threshold-mv:
    type: int
    default: 2000
    description: Voltage threshold in mV above which switchcap is power-good.

  power-reset-threshold-mv:
    type: int
    default: 10
    description: |
      Voltage threshold in mV at or below which switchcap is in reset state.

  power-off-delay-ms:
    type: int
    description: Additional power-off delay in milliseconds.
```
