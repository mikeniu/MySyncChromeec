## CMakeLists.txt
```
# Copyright 2026 The ChromiumOS Authors
# Use of this source code is governed by a BSD-style license that can be
# found in the LICENSE file.

cmake_minimum_required(VERSION 3.13.1)
find_package(Zephyr REQUIRED HINTS "${ZEPHYR_BASE}")
project(switchcap)

target_sources(app PRIVATE src/main.c src/test_comparator.c)
```

## prj.conf
```kconfig
# Copyright 2026 The ChromiumOS Authors
# Use of this source code is governed by a BSD-style license that can be
# found in the LICENSE file.

CONFIG_ZTEST=y
CONFIG_GPIO=y
CONFIG_GPIO_EMUL=y
CONFIG_COMPARATOR=y
CONFIG_CROS_SWITCHCAP=y
```

## boards/adc.overlay
```dts
/* Copyright 2026 The ChromiumOS Authors
 * Use of this source code is governed by a BSD-style license that can be
 * found in the LICENSE file.
 */

#include <board-overlays/native_sim.dts>
#include <zephyr/dt-bindings/gpio/gpio.h>

/ {
	switchcap: switchcap {
		compatible = "cros-ec,switchcap";
		enable-gpios = <&gpio0 0 GPIO_ACTIVE_HIGH>;
		io-channels = <&adc0 0>;
		power-good-threshold-mv = <2000>;
		power-off-delay-ms = <10>;
	};
};

&adc0 {
	ref-internal-mv = <3300>;
	#address-cells = <1>;
	#size-cells = <0>;

	channel@0 {
		reg = <0>;
		zephyr,gain = "ADC_GAIN_1";
		zephyr,reference = "ADC_REF_INTERNAL";
		zephyr,acquisition-time = <ADC_ACQ_TIME_DEFAULT>;
		zephyr,resolution = <10>;
	};
};
```

## boards/comparator.overlay
```dts
/* Copyright 2026 The ChromiumOS Authors
 * Use of this source code is governed by a BSD-style license that can be
 * found in the LICENSE file.
 */

#include <board-overlays/native_sim.dts>
#include <zephyr/dt-bindings/gpio/gpio.h>

/ {
	fake_comp: fake-comp {
		compatible = "zephyr,fake-comp";
	};

	switchcap: switchcap {
		compatible = "cros-ec,switchcap";
		enable-gpios = <&gpio0 0 GPIO_ACTIVE_HIGH>;
		power-good-comp = <&fake_comp>;
		power-off-delay-ms = <10>;
	};
};
```

## boards/native_sim.overlay
```dts
/* Copyright 2026 The ChromiumOS Authors
 * Use of this source code is governed by a BSD-style license that can be
 * found in the LICENSE file.
 */

#include <board-overlays/native_sim.dts>
#include <zephyr/dt-bindings/gpio/gpio.h>

/ {
	fake_comp: fake-comp {
		compatible = "zephyr,fake-comp";
	};

	switchcap: switchcap {
		compatible = "cros-ec,switchcap";
		enable-gpios = <&gpio0 0 GPIO_ACTIVE_HIGH>;
		power-good-gpios = <&gpio0 1 GPIO_ACTIVE_HIGH>;
		power-off-delay-ms = <10>;
	};

	switchcap_comp: switchcap-comp {
		compatible = "cros-ec,switchcap-comparator";
		enable-gpios = <&gpio0 2 GPIO_ACTIVE_HIGH>;
		power-good-comp = <&fake_comp>;
		power-off-delay-ms = <10>;
	};
};
```

## src/main.c
```c
/* Copyright 2026 The ChromiumOS Authors
 * Use of this source code is governed by a BSD-style license that can be
 * found in the LICENSE file.
 */

#include <zephyr/device.h>
#include <zephyr/devicetree.h>
#include <zephyr/drivers/gpio.h>
#include <zephyr/drivers/gpio/gpio_emul.h>
#include <zephyr/ztest.h>

#include <drivers/cros_switchcap.h>

#define SWITCHCAP_NODE DT_NODELABEL(switchcap)

static const struct device *const switchcap_dev = DEVICE_DT_GET(SWITCHCAP_NODE);
static const struct gpio_dt_spec enable_gpio =
	GPIO_DT_SPEC_GET(SWITCHCAP_NODE, enable_gpios);
static const struct gpio_dt_spec power_good_gpio =
	GPIO_DT_SPEC_GET(SWITCHCAP_NODE, power_good_gpios);

ZTEST(switchcap, test_init)
{
	gpio_flags_t flags;

	zassert_true(device_is_ready(switchcap_dev));

	zassert_ok(
		gpio_emul_flags_get(enable_gpio.port, enable_gpio.pin, &flags));
	zassert_true(flags & GPIO_OUTPUT);

	zassert_ok(gpio_emul_flags_get(power_good_gpio.port,
				       power_good_gpio.pin, &flags));
	zassert_true(flags & GPIO_INPUT);
}

ZTEST(switchcap, test_is_enabled_true)
{
	/* GPIO_INPUT is needed for the testing framework to set initial value
	 */
	zassert_ok(
		gpio_pin_configure_dt(&enable_gpio, GPIO_OUTPUT | GPIO_INPUT));
	zassert_ok(gpio_emul_input_set(enable_gpio.port, enable_gpio.pin, 1));
	zassert_true(cros_switchcap_is_enabled(switchcap_dev));
}

ZTEST(switchcap, test_is_enabled_false)
{
	/* GPIO_INPUT is needed for the testing framework to set initial value
	 */
	zassert_ok(
		gpio_pin_configure_dt(&enable_gpio, GPIO_OUTPUT | GPIO_INPUT));
	zassert_ok(gpio_emul_input_set(enable_gpio.port, enable_gpio.pin, 0));
	zassert_false(cros_switchcap_is_enabled(switchcap_dev));
}

ZTEST(switchcap, test_is_power_good_true)
{
	zassert_ok(gpio_emul_input_set(power_good_gpio.port,
				       power_good_gpio.pin, 1));
	zassert_true(cros_switchcap_is_power_good(switchcap_dev));
	zassert_false(cros_switchcap_is_power_reset(switchcap_dev));
}

ZTEST(switchcap, test_is_power_good_false)
{
	zassert_ok(gpio_emul_input_set(power_good_gpio.port,
				       power_good_gpio.pin, 0));
	zassert_false(cros_switchcap_is_power_good(switchcap_dev));
	zassert_true(cros_switchcap_is_power_reset(switchcap_dev));
}

ZTEST(switchcap, test_set_power_enable)
{
	zassert_ok(gpio_pin_set_dt(&enable_gpio, 0));
	zassert_ok(cros_switchcap_set_power(switchcap_dev, true));
	zassert_equal(gpio_emul_output_get(enable_gpio.port, enable_gpio.pin),
		      1);
}

ZTEST(switchcap, test_set_power_disable)
{
	zassert_ok(gpio_pin_set_dt(&enable_gpio, 1));
	zassert_ok(cros_switchcap_set_power(switchcap_dev, false));
	zassert_equal(gpio_emul_output_get(enable_gpio.port, enable_gpio.pin),
		      0);
}

ZTEST_SUITE(switchcap, NULL, NULL, NULL, NULL, NULL);
```

## src/test_adc.c
```c
/* Copyright 2026 The ChromiumOS Authors
 * Use of this source code is governed by a BSD-style license that can be
 * found in the LICENSE file.
 */

#include <zephyr/device.h>
#include <zephyr/devicetree.h>
#include <zephyr/drivers/adc.h>
#include <zephyr/drivers/adc/adc_emul.h>
#include <zephyr/drivers/gpio.h>
#include <zephyr/drivers/gpio/gpio_emul.h>
#include <zephyr/ztest.h>

#include <drivers/cros_switchcap.h>

#define SWITCHCAP_NODE DT_NODELABEL(switchcap)

static const struct device *const switchcap_dev = DEVICE_DT_GET(SWITCHCAP_NODE);
static const struct gpio_dt_spec enable_gpio =
	GPIO_DT_SPEC_GET(SWITCHCAP_NODE, enable_gpios);
static const struct adc_dt_spec power_good_adc =
	ADC_DT_SPEC_GET(SWITCHCAP_NODE);

static int adc_error_func(const struct device *dev, unsigned int chan,
			  void *data, uint32_t *result)
{
	return -EIO;
}

ZTEST(switchcap_adc, test_init)
{
	gpio_flags_t flags;

	zassert_true(device_is_ready(switchcap_dev));

	zassert_ok(
		gpio_emul_flags_get(enable_gpio.port, enable_gpio.pin, &flags));
	zassert_true(flags & GPIO_OUTPUT);

	zassert_true(adc_is_ready_dt(&power_good_adc));
}

ZTEST(switchcap_adc, test_is_power_good_true)
{
	zassert_ok(adc_emul_const_value_set(power_good_adc.dev,
					    power_good_adc.channel_id, 2500));
	zassert_true(cros_switchcap_is_power_good(switchcap_dev));
}

ZTEST(switchcap_adc, test_is_power_good_false)
{
	zassert_ok(adc_emul_const_value_set(power_good_adc.dev,
					    power_good_adc.channel_id, 1500));
	zassert_false(cros_switchcap_is_power_good(switchcap_dev));

	zassert_ok(adc_emul_const_value_set(power_good_adc.dev,
					    power_good_adc.channel_id, 2000));
	zassert_false(cros_switchcap_is_power_good(switchcap_dev));
}

ZTEST(switchcap_adc, test_is_power_good_adc_error)
{
	zassert_ok(adc_emul_value_func_set(power_good_adc.dev,
					   power_good_adc.channel_id,
					   adc_error_func, NULL));
	zassert_false(cros_switchcap_is_power_good(switchcap_dev));
}

ZTEST_SUITE(switchcap_adc, NULL, NULL, NULL, NULL, NULL);
```

## src/test_comparator.c
```c
/* Copyright 2026 The ChromiumOS Authors
 * Use of this source code is governed by a BSD-style license that can be
 * found in the LICENSE file.
 */

#include <zephyr/device.h>
#include <zephyr/devicetree.h>
#include <zephyr/drivers/comparator/fake_comp.h>
#include <zephyr/drivers/gpio.h>
#include <zephyr/drivers/gpio/gpio_emul.h>
#include <zephyr/fff.h>
#include <zephyr/ztest.h>

#include <drivers/cros_switchcap.h>

DEFINE_FFF_GLOBALS;

#define SWITCHCAP_COMP_NODE DT_NODELABEL(switchcap_comp)
#define COMP_NODE DT_NODELABEL(fake_comp)

static const struct device *const switchcap_dev =
	DEVICE_DT_GET(SWITCHCAP_COMP_NODE);
static const struct device *const comp_dev = DEVICE_DT_GET(COMP_NODE);
static const struct gpio_dt_spec enable_gpio =
	GPIO_DT_SPEC_GET(SWITCHCAP_COMP_NODE, enable_gpios);

ZTEST(switchcap_comp, test_init)
{
	gpio_flags_t flags;

	zassert_true(device_is_ready(switchcap_dev));
	zassert_true(device_is_ready(comp_dev));

	zassert_ok(
		gpio_emul_flags_get(enable_gpio.port, enable_gpio.pin, &flags));
	zassert_true(flags & GPIO_OUTPUT);
}

ZTEST(switchcap_comp, test_is_enabled_true)
{
	/* GPIO_INPUT is needed for the testing framework to set initial value
	 */
	zassert_ok(
		gpio_pin_configure_dt(&enable_gpio, GPIO_OUTPUT | GPIO_INPUT));
	zassert_ok(gpio_emul_input_set(enable_gpio.port, enable_gpio.pin, 1));
	zassert_true(cros_switchcap_is_enabled(switchcap_dev));
}

ZTEST(switchcap_comp, test_is_enabled_false)
{
	/* GPIO_INPUT is needed for the testing framework to set initial value
	 */
	zassert_ok(
		gpio_pin_configure_dt(&enable_gpio, GPIO_OUTPUT | GPIO_INPUT));
	zassert_ok(gpio_emul_input_set(enable_gpio.port, enable_gpio.pin, 0));
	zassert_false(cros_switchcap_is_enabled(switchcap_dev));
}

ZTEST(switchcap_comp, test_is_power_good_true)
{
	comp_fake_comp_get_output_fake.return_val = 1;
	zassert_true(cros_switchcap_is_power_good(switchcap_dev));
	zassert_equal(comp_fake_comp_get_output_fake.call_count, 1);
	zassert_equal(comp_fake_comp_get_output_fake.arg0_val, comp_dev);
}

ZTEST(switchcap_comp, test_is_power_good_false)
{
	comp_fake_comp_get_output_fake.return_val = 0;
	zassert_false(cros_switchcap_is_power_good(switchcap_dev));
	zassert_equal(comp_fake_comp_get_output_fake.call_count, 1);
	zassert_equal(comp_fake_comp_get_output_fake.arg0_val, comp_dev);
}

ZTEST(switchcap_comp, test_is_power_good_error)
{
	comp_fake_comp_get_output_fake.return_val = -EIO;
	zassert_false(cros_switchcap_is_power_good(switchcap_dev));
	zassert_equal(comp_fake_comp_get_output_fake.call_count, 1);
	zassert_equal(comp_fake_comp_get_output_fake.arg0_val, comp_dev);
}

ZTEST(switchcap_comp, test_set_power_enable)
{
	zassert_ok(gpio_pin_set_dt(&enable_gpio, 0));
	zassert_ok(cros_switchcap_set_power(switchcap_dev, true));
	zassert_equal(gpio_emul_output_get(enable_gpio.port, enable_gpio.pin),
		      1);
}

ZTEST(switchcap_comp, test_set_power_disable)
{
	zassert_ok(gpio_pin_set_dt(&enable_gpio, 1));
	zassert_ok(cros_switchcap_set_power(switchcap_dev, false));
	zassert_equal(gpio_emul_output_get(enable_gpio.port, enable_gpio.pin),
		      0);
}

ZTEST_SUITE(switchcap_comp, NULL, NULL, NULL, NULL, NULL);
```
