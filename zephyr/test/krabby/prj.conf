## prj.conf
```kconfig
<<<<<<< HEAD   (453fd99d5363bf9651b2fb0d3ffbbab7386a6376 program,zmake: drop cmsis references)
# Copyright 2022 The ChromiumOS Authors
# Use of this source code is governed by a BSD-style license that can be
# found in the LICENSE file.

CONFIG_ZTEST=y
CONFIG_ZTEST_ASSERT_VERBOSE=1

CONFIG_ASSERT=y
CONFIG_ADC=y
CONFIG_CROS_EC=y
CONFIG_EMUL=y

CONFIG_SHIMMED_TASKS=n

CONFIG_PLATFORM_EC=y
CONFIG_PLATFORM_EC_BACKLIGHT_LID=n
CONFIG_PLATFORM_EC_BATTERY_FUEL_GAUGE=y
CONFIG_PLATFORM_EC_CHARGER=y
CONFIG_PLATFORM_EC_CHARGER_SENSE_RESISTOR=10
CONFIG_PLATFORM_EC_CHARGER_SENSE_RESISTOR_AC=20
CONFIG_PLATFORM_EC_CHARGE_MANAGER=y
CONFIG_PLATFORM_EC_CHARGE_RAMP_HW=y
CONFIG_PLATFORM_EC_GPIO_INIT_PRIORITY=49
CONFIG_PLATFORM_EC_HOOKS=y
CONFIG_PLATFORM_EC_HOSTCMD=y
CONFIG_PLATFORM_EC_LID_SWITCH=y
CONFIG_PLATFORM_EC_POWERSEQ_HOST_SLEEP=y
CONFIG_PLATFORM_EC_POWER_BUTTON=y
CONFIG_PLATFORM_EC_POWER_SLEEP_FAILURE_DETECTION=y
CONFIG_PLATFORM_EC_SWITCH=n
CONFIG_PLATFORM_EC_USBC=y
CONFIG_PLATFORM_EC_USB_CHARGER=y
CONFIG_PLATFORM_EC_USB_DRP_ACC_TRYSRC=y
CONFIG_PLATFORM_EC_USB_PD_DISCHARGE=y
CONFIG_PLATFORM_EC_USB_PD_DISCHARGE_PPC=y
CONFIG_PLATFORM_EC_USB_PD_VBUS_MEASURE_ADC_EACH_PORT=y
CONFIG_PLATFORM_EC_USB_POWER_DELIVERY=y
CONFIG_PLATFORM_EC_VBOOT_HASH=n
CONFIG_PLATFORM_EC_PP3700_DISCHARGE_TIME_MS=100

CONFIG_PLATFORM_EC_USBC_PPC=y

CONFIG_UART_NATIVE_PTY_0_ON_STDINOUT=y
||||||| BASE   (0cb93ccd933607defa9592c423c9a9fb4946fd4d anakin: Set PDC source PDO overcurrent capability)
# Copyright 2022 The ChromiumOS Authors
# Use of this source code is governed by a BSD-style license that can be
# found in the LICENSE file.

CONFIG_ZTEST=y
CONFIG_ZTEST_ASSERT_VERBOSE=1

CONFIG_ASSERT=y
CONFIG_ADC=y
CONFIG_CROS_EC=y
CONFIG_EMUL=y

CONFIG_SHIMMED_TASKS=n

CONFIG_PLATFORM_EC=y
CONFIG_PLATFORM_EC_BACKLIGHT_LID=n
CONFIG_PLATFORM_EC_BATTERY_FUEL_GAUGE=y
CONFIG_PLATFORM_EC_CHARGER=y
CONFIG_PLATFORM_EC_CHARGER_SENSE_RESISTOR=10
CONFIG_PLATFORM_EC_CHARGER_SENSE_RESISTOR_AC=20
CONFIG_PLATFORM_EC_CHARGE_MANAGER=y
CONFIG_PLATFORM_EC_CHARGE_RAMP_HW=y
CONFIG_PLATFORM_EC_GPIO_INIT_PRIORITY=49
CONFIG_PLATFORM_EC_HOOKS=y
CONFIG_PLATFORM_EC_HOSTCMD=y
CONFIG_PLATFORM_EC_LID_SWITCH=y
CONFIG_PLATFORM_EC_POWERSEQ_HOST_SLEEP=y
CONFIG_PLATFORM_EC_POWER_BUTTON=y
CONFIG_PLATFORM_EC_POWER_SLEEP_FAILURE_DETECTION=y
CONFIG_PLATFORM_EC_SWITCH=n
CONFIG_PLATFORM_EC_USBC=y
CONFIG_PLATFORM_EC_USB_CHARGER=y
CONFIG_PLATFORM_EC_USB_DRP_ACC_TRYSRC=y
CONFIG_PLATFORM_EC_USB_PD_DISCHARGE=y
CONFIG_PLATFORM_EC_USB_PD_DISCHARGE_PPC=y
CONFIG_PLATFORM_EC_USB_PD_VBUS_MEASURE_ADC_EACH_PORT=y
CONFIG_PLATFORM_EC_USB_POWER_DELIVERY=y
CONFIG_PLATFORM_EC_VBOOT_HASH=n
CONFIG_PLATFORM_EC_PP3700_DISCHARGE_TIME_MS=100

CONFIG_PLATFORM_EC_USBC_PPC=y

CONFIG_NATIVE_UART_0_ON_STDINOUT=y
=======
>>>>>>> BRANCH (86da3bbeafeffe5727f5bfec7d9eed87995f2661 UPSTREAM: driver: add new ALS CM36781 driver code)
```

## include/test_state.h
```c
/* Copyright 2022 The ChromiumOS Authors
 * Use of this source code is governed by a BSD-style license that can be
 * found in the LICENSE file.
 */

#ifndef ZEPHYR_TEST_KRABBY_INCLUDE_TEST_STATE_H_
#define ZEPHYR_TEST_KRABBY_INCLUDE_TEST_STATE_H_

#include <stdbool.h>

struct test_state {
	bool ec_app_main_run;
};

bool krabby_predicate_post_main(const void *state);

#endif /* ZEPHYR_TEST_KRABBY_INCLUDE_TEST_STATE_H_ */
```

## src/base_detect.c
```c
/* Copyright 2024 The ChromiumOS Authors
 * Use of this source code is governed by a BSD-style license that can be
 * found in the LICENSE file.
 */

#include "ap_power/ap_power_events.h"
#include "base_state.h"
#include "chipset.h"
#include "gpio/gpio_int.h"
#include "hooks.h"
#include "host_command.h"
#include "power.h"
#include "tablet_mode.h"
#include "task.h"

#include <zephyr/drivers/adc/adc_emul.h>
#include <zephyr/drivers/gpio.h>
#include <zephyr/drivers/gpio/gpio_emul.h>
#include <zephyr/kernel.h>
#include <zephyr/ztest.h>

#define ATTACH_MAX_THRESHOLD_MV 300
#define UNATTACH_THRESHOLD_MV 1800

extern bool is_held;

static void set_signal_state(enum power_state state)
{
	const struct gpio_dt_spec *ap_ec_sysrst_odl =
		gpio_get_dt_spec(GPIO_AP_EC_SYSRST_ODL);
	const struct gpio_dt_spec *ap_in_sleep_l =
		gpio_get_dt_spec(GPIO_AP_IN_SLEEP_L);

	if (state == POWER_S0) {
		gpio_emul_input_set(ap_in_sleep_l->port, ap_in_sleep_l->pin, 1);
		gpio_emul_input_set(ap_ec_sysrst_odl->port,
				    ap_ec_sysrst_odl->pin, 1);
	}

	/* reset is_held flag */
	is_held = false;
	power_thread_wake();
	k_sleep(K_SECONDS(1));
}

static void *base_detect_setup(void)
{
	/* G3 -> S0 */
	power_set_state(POWER_G3);
	set_signal_state(POWER_S0);

	return NULL;
}

ZTEST_SUITE(base_detect, NULL, base_detect_setup, NULL, NULL, NULL);

ZTEST(base_detect, test_init_attach_detach)
{
	const struct device *adc_dev = DEVICE_DT_GET(DT_NODELABEL(adc0));
	const uint8_t adc_channel =
		DT_IO_CHANNELS_INPUT(DT_NODELABEL(adc_base_det));

	zassert_ok(adc_emul_const_value_set(adc_dev, adc_channel,
					    ATTACH_MAX_THRESHOLD_MV));
	k_sleep(K_MSEC(1000));
	hook_notify(HOOK_INIT);
	zassert_true(base_get_state());

	zassert_ok(adc_emul_const_value_set(adc_dev, adc_channel,
					    UNATTACH_THRESHOLD_MV));
	k_sleep(K_MSEC(1000));
	hook_notify(HOOK_INIT);
	zassert_false(base_get_state());
}

ZTEST(base_detect, test_base_detect_startup)
{
	const struct device *adc_dev = DEVICE_DT_GET(DT_NODELABEL(adc0));
	const uint8_t adc_channel =
		DT_IO_CHANNELS_INPUT(DT_NODELABEL(adc_base_det));

	/* Verify power on when keyboard is plugged in or out */
	hook_notify(HOOK_INIT);
	zassert_ok(adc_emul_const_value_set(adc_dev, adc_channel,
					    ATTACH_MAX_THRESHOLD_MV));
	k_sleep(K_MSEC(1000));

	ap_power_ev_send_callbacks(AP_POWER_STARTUP);
	zassert_equal(0, tablet_get_mode(), NULL);

	zassert_ok(adc_emul_const_value_set(adc_dev, adc_channel,
					    UNATTACH_THRESHOLD_MV));
	k_sleep(K_MSEC(1000));
	ap_power_ev_send_callbacks(AP_POWER_STARTUP);
	k_sleep(K_MSEC(100));
	zassert_equal(1, tablet_get_mode());
}

ZTEST(base_detect, test_base_detect_shutdown)
{
	/* Verify shutdown when keyboard is plugged in or out */
	hook_notify(HOOK_INIT);
	ap_power_ev_send_callbacks(AP_POWER_SHUTDOWN);
	zassert_equal(1, tablet_get_mode(), NULL);
}

ZTEST(base_detect, test_base_detect_interrupt)
{
	const struct device *adc_dev = DEVICE_DT_GET(DT_NODELABEL(adc0));
	const uint8_t adc_channel =
		DT_IO_CHANNELS_INPUT(DT_NODELABEL(adc_base_det));

	/*
	 * Verify that an interrupt is triggered when the keyboard is
	 * inserted or removed
	 */
	hook_notify(HOOK_INIT);
	zassert_ok(adc_emul_const_value_set(adc_dev, adc_channel,
					    ATTACH_MAX_THRESHOLD_MV));
	k_sleep(K_MSEC(1000));
	zassert_equal(0, tablet_get_mode(), NULL);

	zassert_ok(adc_emul_const_value_set(adc_dev, adc_channel,
					    UNATTACH_THRESHOLD_MV));
	k_sleep(K_MSEC(1000));
	zassert_equal(1, tablet_get_mode(), NULL);
}

ZTEST_SUITE(console_cmd_setbasestate, NULL, NULL, NULL, NULL, NULL);

ZTEST_USER(console_cmd_setbasestate, test_sb_setbasestate)
{
	int rv;

	const struct device *adc_dev = DEVICE_DT_GET(DT_NODELABEL(adc0));
	const uint8_t adc_channel =
		DT_IO_CHANNELS_INPUT(DT_NODELABEL(adc_base_det));

	/* command to basestate attach*/
	rv = shell_execute_cmd(get_ec_shell(), "basestate attach");
	zassert_equal(EC_RES_SUCCESS, rv, "Expected %d, but got %d",
		      EC_RES_SUCCESS, rv);
	k_sleep(K_MSEC(500));
	zassert_equal(0, tablet_get_mode(), NULL);

	/* command to basestate detach*/
	rv = shell_execute_cmd(get_ec_shell(), "basestate detach");
	zassert_equal(EC_RES_SUCCESS, rv, "Expected %d, but got %d",
		      EC_RES_SUCCESS, rv);
	k_sleep(K_MSEC(500));
	zassert_equal(1, tablet_get_mode(), NULL);

	/* command to basestate resaet*/
	zassert_ok(adc_emul_const_value_set(adc_dev, adc_channel,
					    ATTACH_MAX_THRESHOLD_MV));
	rv = shell_execute_cmd(get_ec_shell(), "basestate reset");
	zassert_equal(EC_RES_SUCCESS, rv, "Expected %d, but got %d",
		      EC_RES_SUCCESS, rv);
	k_sleep(K_MSEC(1000));
	zassert_equal(0, tablet_get_mode(), NULL);

	zassert_ok(adc_emul_const_value_set(adc_dev, adc_channel,
					    UNATTACH_THRESHOLD_MV));
	rv = shell_execute_cmd(get_ec_shell(), "basestate reset");
	zassert_equal(EC_RES_SUCCESS, rv, "Expected %d, but got %d",
		      EC_RES_SUCCESS, rv);
	k_sleep(K_MSEC(1000));
	zassert_equal(1, tablet_get_mode(), NULL);
}
```

## src/power_seq.c
```c
/* Copyright 2022 The ChromiumOS Authors
 * Use of this source code is governed by a BSD-style license that can be
 * found in the LICENSE file.
 */

#include "common.h"
#include "ec_tasks.h"
#include "gpio.h"
#include "hooks.h"
#include "host_command.h"
#include "power.h"
#include "power_button.h"
#include "system.h"
#include "task.h"
#include "test_state.h"
#include "timer.h"

#include <zephyr/devicetree.h>
#include <zephyr/drivers/gpio.h>
#include <zephyr/drivers/gpio/gpio_emul.h>
#include <zephyr/fff.h>
#include <zephyr/kernel.h>
#include <zephyr/ztest.h>

FAKE_VOID_FUNC(chipset_pre_init_hook);
DECLARE_HOOK(HOOK_CHIPSET_PRE_INIT, chipset_pre_init_hook, HOOK_PRIO_DEFAULT);
FAKE_VOID_FUNC(chipset_startup_hook);
DECLARE_HOOK(HOOK_CHIPSET_STARTUP, chipset_startup_hook, HOOK_PRIO_DEFAULT);
FAKE_VOID_FUNC(chipset_resume_hook);
DECLARE_HOOK(HOOK_CHIPSET_RESUME, chipset_resume_hook, HOOK_PRIO_DEFAULT);
FAKE_VALUE_FUNC(int, system_jumped_late);
FAKE_VALUE_FUNC(int, system_can_boot_ap);

#define S5_INACTIVE_SEC 11
/* S5_INACTIVE_SEC + PMIC_HARD_OFF_DELAY 9.6 sec + 1 sec buffer */
#define POWER_OFF_DELAY_SEC 21

/* mt8186 is_held flag */
extern bool is_held;

static void set_signal_state(enum power_state state)
{
	const struct gpio_dt_spec *ap_ec_sysrst_odl =
		gpio_get_dt_spec(GPIO_AP_EC_SYSRST_ODL);
	const struct gpio_dt_spec *ap_in_sleep_l =
		gpio_get_dt_spec(GPIO_AP_IN_SLEEP_L);

	switch (state) {
	case POWER_S0:
		gpio_emul_input_set(ap_in_sleep_l->port, ap_in_sleep_l->pin, 1);
		gpio_emul_input_set(ap_ec_sysrst_odl->port,
				    ap_ec_sysrst_odl->pin, 1);
		break;
	case POWER_S3:
		gpio_emul_input_set(ap_in_sleep_l->port, ap_in_sleep_l->pin, 0);
		gpio_emul_input_set(ap_ec_sysrst_odl->port,
				    ap_ec_sysrst_odl->pin, 1);
		break;
	case POWER_G3:
		gpio_emul_input_set(ap_in_sleep_l->port, ap_in_sleep_l->pin, 0);
		gpio_emul_input_set(ap_ec_sysrst_odl->port,
				    ap_ec_sysrst_odl->pin, 0);
		break;
	default:
		zassert_unreachable("state %d not supported", state);
	}

	/* reset is_held flag */
	is_held = false;
	power_thread_wake();
	k_sleep(K_SECONDS(1));
}

#ifdef CONFIG_AP_ARM_MTK_MT8188
static void pp4200_handler(const struct device *port, struct gpio_callback *cb,
			   gpio_port_pins_t pins)
{
	const struct gpio_dt_spec *en_pp4200_s5 =
		GPIO_DT_FROM_NODELABEL(en_pp4200_s5);
	const struct gpio_dt_spec *pg_pp4200_s5_od =
		GPIO_DT_FROM_NODELABEL(pg_pp4200_s5_od);
	int en = gpio_emul_output_get(en_pp4200_s5->port, en_pp4200_s5->pin);

	gpio_emul_input_set(pg_pp4200_s5_od->port, pg_pp4200_s5_od->pin, en);
}

static struct gpio_callback pp4200_callback = {
	.handler = pp4200_handler,
	.pin_mask = BIT(DT_GPIO_PIN(DT_NODELABEL(en_pp4200_s5), gpios)),
};

static void *power_seq_setup(void)
{
	zassert_ok(gpio_add_callback_dt(GPIO_DT_FROM_NODELABEL(en_pp4200_s5),
					&pp4200_callback));

	return NULL;
}

static void power_seq_teardown(void *f)
{
	zassert_ok(gpio_remove_callback_dt(GPIO_DT_FROM_NODELABEL(en_pp4200_s5),
					   &pp4200_callback));
}

ZTEST(power_seq, test_pp4200_pg_timeout)
{
	const struct gpio_dt_spec *pg_pp4200_s5_od =
		GPIO_DT_FROM_NODELABEL(pg_pp4200_s5_od);

	zassert_ok(gpio_remove_callback_dt(GPIO_DT_FROM_NODELABEL(en_pp4200_s5),
					   &pp4200_callback));
	gpio_emul_input_set(pg_pp4200_s5_od->port, pg_pp4200_s5_od->pin, 0);
	power_signal_interrupt(GPIO_PG_PP4200_S5_OD);

	chipset_power_on();
	task_wake(TASK_ID_CHIPSET);
	k_sleep(K_MSEC(300));

	zassert_ok(gpio_add_callback_dt(GPIO_DT_FROM_NODELABEL(en_pp4200_s5),
					&pp4200_callback));
	zassert_equal(power_get_state(), POWER_G3);
	zassert_equal(chipset_pre_init_hook_fake.call_count, 0);
	zassert_equal(0, gpio_pin_get_dt(GPIO_DT_FROM_NODELABEL(en_pp4200_s5)));

	gpio_emul_input_set(pg_pp4200_s5_od->port, pg_pp4200_s5_od->pin, 1);
	power_signal_interrupt(GPIO_PG_PP4200_S5_OD);
}
#else
static void *power_seq_setup(void)
{
	return NULL;
}

static void power_seq_teardown(void *f)
{
}
#endif /* CONFIG_AP_ARM_MTK_MT8188 */

static void power_seq_before(void *f)
{
	/* Required for deferred callbacks to work */
	set_test_runner_tid();

	/* Start from G3 */
	set_signal_state(POWER_G3);
	power_set_state(POWER_G3);
	k_sleep(K_SECONDS(POWER_OFF_DELAY_SEC));

	RESET_FAKE(chipset_pre_init_hook);
	RESET_FAKE(chipset_startup_hook);
	RESET_FAKE(chipset_resume_hook);
	RESET_FAKE(system_jumped_late);
	RESET_FAKE(system_can_boot_ap);
	system_can_boot_ap_fake.return_val = 1;
	FFF_RESET_HISTORY();
}

/* Normal boot sequence, G3 -> S3 -> S0 */
ZTEST(power_seq, test_power_state_machine)
{
	/* G3 -> S3 */
	power_set_state(POWER_G3);
	set_signal_state(POWER_S3);
	if (IS_ENABLED(CONFIG_PLATFORM_EC_POWERSEQ_MTK_FW_SUSPEND)) {
		zassert_equal(power_get_state(), POWER_S0);
		task_wake(TASK_ID_CHIPSET);
		k_sleep(K_SECONDS(1));
		zassert_equal(power_get_state(), POWER_S3);
	} else {
		zassert_equal(power_get_state(), POWER_S3);
	}

	/* S3 -> S0 */
	power_set_state(POWER_S3);
	set_signal_state(POWER_S0);
	zassert_equal(power_get_state(), POWER_S0);

	/* S0 -> G3 */
	power_set_state(POWER_S0);
	set_signal_state(POWER_G3);
	zassert_equal(power_get_state(), POWER_S5);
	k_sleep(K_SECONDS(S5_INACTIVE_SEC));
	zassert_equal(power_get_state(), POWER_G3);
}

/* Verify power btn short press can boot the device */
ZTEST(power_seq, test_power_btn_short_press)
{
	zassert_equal(power_get_state(), POWER_G3);

	power_button_simulate_press(100);
	k_sleep(K_SECONDS(1));

	/* Verify that power state machine is able to reach S5S3, and back to G3
	 * because power signal is not changed
	 */
	zassert_equal(chipset_pre_init_hook_fake.call_count, 1);
	zassert_equal(chipset_startup_hook_fake.call_count, 0);
	k_sleep(K_SECONDS(POWER_OFF_DELAY_SEC));
	zassert_equal(power_get_state(), POWER_G3);
}

/* Verify lid open can boot the device */
ZTEST(power_seq, test_lid_open)
{
	const struct gpio_dt_spec *lid_open = gpio_get_dt_spec(GPIO_LID_OPEN);

	gpio_emul_input_set(lid_open->port, lid_open->pin, 0);
	k_sleep(K_SECONDS(1));
	zassert_equal(power_get_state(), POWER_G3);

	gpio_emul_input_set(lid_open->port, lid_open->pin, 1);
	k_sleep(K_SECONDS(1));

	/* Verify that power state machine is able to reach S5S3, and back to G3
	 * because power signal is not changed
	 */
	zassert_equal(chipset_pre_init_hook_fake.call_count, 1);
	zassert_equal(chipset_startup_hook_fake.call_count, 0);
	k_sleep(K_SECONDS(POWER_OFF_DELAY_SEC));
	zassert_equal(power_get_state(), POWER_G3);
}

/* Suspend, S0 -> S3 -> S0 */
ZTEST(power_seq, test_host_sleep_success)
{
	host_clear_events(EC_HOST_EVENT_MASK(EC_HOST_EVENT_HANG_DETECT));

	/* Boot AP */
	set_signal_state(POWER_S0);
	zassert_equal(power_get_state(), POWER_S0);

	/* Suspend for 30 seconds */
	zassert_ok(ec_cmd_host_sleep_event(
		NULL, &(struct ec_params_host_sleep_event){
			      .sleep_event = HOST_SLEEP_EVENT_S3_SUSPEND }));
	k_sleep(K_MSEC(1));
	set_signal_state(POWER_S3);
	k_sleep(K_SECONDS(30));
	zassert_equal(power_get_state(), POWER_S3);

	/* Resume */
	set_signal_state(POWER_S0);
	zassert_ok(ec_cmd_host_sleep_event(
		NULL, &(struct ec_params_host_sleep_event){
			      .sleep_event = HOST_SLEEP_EVENT_S3_RESUME }));
	zassert_equal(power_get_state(), POWER_S0);

	/* Verify that EC_HOST_EVENT_HANG_DETECT is not triggered */
	zassert_false(host_is_event_set(EC_HOST_EVENT_HANG_DETECT));
}

/* Sleep hang, send EC_HOST_EVENT_HANG_DETECT */
ZTEST(power_seq, test_host_sleep_hang)
{
	host_clear_events(EC_HOST_EVENT_MASK(EC_HOST_EVENT_HANG_DETECT));

	/* Boot AP */
	set_signal_state(POWER_S0);
	zassert_equal(power_get_state(), POWER_S0);

	/* Send HOST_SLEEP_EVENT_S3_SUSPEND and hang for 30 seconds */
	zassert_ok(ec_cmd_host_sleep_event(
		NULL, &(struct ec_params_host_sleep_event){
			      .sleep_event = HOST_SLEEP_EVENT_S3_SUSPEND }));
	k_sleep(K_SECONDS(30));

#if defined(CONFIG_CROS_EC_RW)
	/* Verify that EC_HOST_EVENT_HANG_DETECT is triggered */
	zassert_true(host_is_event_set(EC_HOST_EVENT_HANG_DETECT));
#endif /* CONFIG_CROS_EC_RW */
}

/* Shutdown from EC, S0 -> power key press (8 secs) -> S3S5 (8 secs) -> S5 -> G3
 */
ZTEST(power_seq, test_force_shutdown)
{
	const struct gpio_dt_spec *sys_rst_odl =
		gpio_get_dt_spec(GPIO_SYS_RST_ODL);
	const struct gpio_dt_spec *ec_pmic_en_odl =
		gpio_get_dt_spec(GPIO_EC_PMIC_EN_ODL);

	gpio_set_level(GPIO_SYS_RST_ODL, 1);
	gpio_set_level(GPIO_EC_PMIC_EN_ODL, 1);

	/* Boot AP */
	set_signal_state(POWER_S0);
	zassert_equal(power_get_state(), POWER_S0);

	/* Verify that ec resets ap and holds power button */
	chipset_force_shutdown(CHIPSET_SHUTDOWN_CONSOLE_CMD);
	k_sleep(K_SECONDS(1));
	zassert_equal(gpio_emul_output_get(sys_rst_odl->port, sys_rst_odl->pin),
		      0);

	/* Emulate AP power down (hw state G3, sw state unchanged),
	 * Verify power state stops at S5
	 */
	set_signal_state(POWER_G3);
	zassert_equal(power_get_state(), POWER_S3S5);
	zassert_equal(gpio_emul_output_get(ec_pmic_en_odl->port,
					   ec_pmic_en_odl->pin),
		      0);

	/* Wait 10 seconds for EC_PMIC_EN_ODL release and drop to S5 then G3 */
	k_sleep(K_SECONDS(10));
	zassert_equal(gpio_emul_output_get(sys_rst_odl->port, sys_rst_odl->pin),
		      0);
	zassert_equal(gpio_emul_output_get(ec_pmic_en_odl->port,
					   ec_pmic_en_odl->pin),
		      1);
	zassert_equal(power_get_state(), POWER_S5);
	k_sleep(K_SECONDS(S5_INACTIVE_SEC));
	zassert_equal(power_get_state(), POWER_G3);
}

/* Shutdown from AP, S0 -> powerkey hold (8 secs) -> S3S5 (8 secs) -> G3 */
ZTEST(power_seq, test_force_shutdown_button)
{
	const struct gpio_dt_spec *sys_rst_odl =
		gpio_get_dt_spec(GPIO_SYS_RST_ODL);
	const struct gpio_dt_spec *ec_pmic_en_odl =
		gpio_get_dt_spec(GPIO_EC_PMIC_EN_ODL);

	gpio_set_level(GPIO_SYS_RST_ODL, 1);
	gpio_set_level(GPIO_EC_PMIC_EN_ODL, 1);

	/* Boot AP */
	set_signal_state(POWER_S0);
	zassert_equal(power_get_state(), POWER_S0);

	power_button_simulate_press(10000); /* 10 seconds */
	zassert_equal(power_get_state(), POWER_S0);
	k_sleep(K_SECONDS(9)); /* AP off after 8 seconds */
	zassert_equal(gpio_emul_output_get(sys_rst_odl->port, sys_rst_odl->pin),
		      0);
	zassert_equal(gpio_emul_output_get(ec_pmic_en_odl->port,
					   ec_pmic_en_odl->pin),
		      0);

	zassert_equal(power_get_state(), POWER_S3S5);
	zassert_equal(gpio_emul_output_get(sys_rst_odl->port, sys_rst_odl->pin),
		      0);
	zassert_equal(gpio_emul_output_get(ec_pmic_en_odl->port,
					   ec_pmic_en_odl->pin),
		      0);

	k_sleep(K_SECONDS(5)); /* Wait for power button release */
	/* Signal has dropped, but PMIC_EN is still held */
	set_signal_state(POWER_G3);
	zassert_equal(power_get_state(), POWER_S3S5);
	zassert_equal(gpio_emul_output_get(ec_pmic_en_odl->port,
					   ec_pmic_en_odl->pin),
		      0);

	k_sleep(K_SECONDS(3)); /* Wait for S5 */

	/* PMIC_EN released */
	zassert_equal(power_get_state(), POWER_S5);
	zassert_equal(gpio_emul_output_get(ec_pmic_en_odl->port,
					   ec_pmic_en_odl->pin),
		      1);
	k_sleep(K_SECONDS(S5_INACTIVE_SEC)); /* Wait for G3 */
	zassert_equal(power_get_state(), POWER_G3);
}

/* AP reset (S0 -> S0).
 * Verify power state doesn't change during reset.
 */
ZTEST(power_seq, test_chipset_reset)
{
	const struct gpio_dt_spec *ap_ec_warm_rst_req =
		gpio_get_dt_spec(GPIO_AP_EC_WARM_RST_REQ);
	const struct gpio_dt_spec *ap_ec_sysrst_odl =
		gpio_get_dt_spec(GPIO_AP_EC_SYSRST_ODL);

	/* Boot AP */
	set_signal_state(POWER_S0);
	zassert_equal(power_get_state(), POWER_S0);
	RESET_FAKE(chipset_resume_hook);
	/* Clear reset reason */
	report_ap_reset(CHIPSET_RESET_UNKNOWN);

	/* Trigger AP reboot */
	gpio_emul_input_set(ap_ec_warm_rst_req->port, ap_ec_warm_rst_req->pin,
			    0);
	gpio_emul_input_set(ap_ec_warm_rst_req->port, ap_ec_warm_rst_req->pin,
			    1);

	/* Simulate sysrst toggle */
	gpio_emul_input_set(ap_ec_sysrst_odl->port, ap_ec_sysrst_odl->pin, 0);
	gpio_emul_input_set(ap_ec_sysrst_odl->port, ap_ec_sysrst_odl->pin, 1);
	k_sleep(K_SECONDS(1));

	/* Back to S0, verify that resume hook is not triggered */
	zassert_equal(power_get_state(), POWER_S0);
	zassert_equal(chipset_resume_hook_fake.call_count, 0);
	/* Also verify that chipset_reset_request_interrupt is called by
	 * checking its side-effect
	 */
	zassert_equal(chipset_get_shutdown_reason(), CHIPSET_RESET_AP_REQ);
}

/* AP reset during suspend (S3 -> S0).
 * Verify state reaches S0 with resume hook triggered.
 */
ZTEST(power_seq, test_chipset_reset_in_s3)
{
	const struct gpio_dt_spec *ap_ec_warm_rst_req =
		gpio_get_dt_spec(GPIO_AP_EC_WARM_RST_REQ);
	const struct gpio_dt_spec *ap_ec_sysrst_odl =
		gpio_get_dt_spec(GPIO_AP_EC_SYSRST_ODL);

	/* Boot AP */
	set_signal_state(POWER_S3);
	if (IS_ENABLED(CONFIG_PLATFORM_EC_POWERSEQ_MTK_FW_SUSPEND)) {
		task_wake(TASK_ID_CHIPSET);
		k_sleep(K_SECONDS(1));
	}
	zassert_equal(power_get_state(), POWER_S3);
	RESET_FAKE(chipset_resume_hook);
	/* Clear reset reason */
	report_ap_reset(CHIPSET_RESET_UNKNOWN);

	/* Trigger AP reboot */
	gpio_emul_input_set(ap_ec_warm_rst_req->port, ap_ec_warm_rst_req->pin,
			    0);
	gpio_emul_input_set(ap_ec_warm_rst_req->port, ap_ec_warm_rst_req->pin,
			    1);

	/* Simulate sysrst toggle */
	gpio_emul_input_set(ap_ec_sysrst_odl->port, ap_ec_sysrst_odl->pin, 0);
	gpio_emul_input_set(ap_ec_sysrst_odl->port, ap_ec_sysrst_odl->pin, 1);
	set_signal_state(POWER_S0);

	/* Back to S0, verify that resume hook is triggered */
	zassert_equal(power_get_state(), POWER_S0);
	zassert_equal(chipset_resume_hook_fake.call_count, 1);
	/* Also verify that chipset_reset_request_interrupt is called by
	 * checking its side-effect
	 */
	zassert_equal(chipset_get_shutdown_reason(), CHIPSET_RESET_AP_REQ);
}

static void power_chipset_init_subtest(enum power_state signal_state,
				       bool jumped_late, uint32_t reset_flags,
				       enum power_state expected_state,
				       int line)
{
	const struct gpio_dt_spec *sys_rst_odl =
		gpio_get_dt_spec(GPIO_SYS_RST_ODL);

	set_signal_state(signal_state);

	system_jumped_late_fake.return_val = jumped_late;
	system_common_reset_state();
	system_set_reset_flags(reset_flags);

	power_set_state(power_chipset_init());

	RESET_FAKE(chipset_pre_init_hook);
	power_thread_wake();
	k_sleep(K_SECONDS(1));

	if (signal_state == expected_state) {
		/* need 10 seconds to drop from s5 to g3 */
		k_sleep(K_SECONDS(S5_INACTIVE_SEC));

		/* Expect nothing changed */
		zassert_equal(chipset_pre_init_hook_fake.call_count, 0,
			      "test_power_chipset_init line %d failed", line);
		zassert_equal(power_get_state(), expected_state);
	} else if (expected_state == POWER_S0 && signal_state == POWER_G3) {
		/* Expect boot to S0 and fail at S5->S3 */
		k_sleep(K_SECONDS(POWER_OFF_DELAY_SEC));
		zassert_equal(chipset_pre_init_hook_fake.call_count, 1,
			      "test_power_chipset_init line %d failed", line);
	} else if (expected_state == POWER_G3 && signal_state == POWER_S0) {
		zassert_equal(gpio_emul_output_get(sys_rst_odl->port,
						   sys_rst_odl->pin),
			      0, "test_power_chipset_init line %d failed",
			      line);
	} else {
		zassert_unreachable();
	}
}

/* Verify initial state decision logic.
 * Combination that don't make sense (e.g. wake from hibernate but signal
 * state is already S0) are skipped.
 */
ZTEST(power_seq, test_power_chipset_init)
{
	const struct gpio_dt_spec *ac_present =
		gpio_get_dt_spec(GPIO_AC_PRESENT);

	/* system_jumped_late => ignore all flags and boot to S0 */
	power_chipset_init_subtest(POWER_G3, true, 0, POWER_S0, __LINE__);
	power_chipset_init_subtest(POWER_S0, true, 0, POWER_S0, __LINE__);
	power_chipset_init_subtest(POWER_G3, true, EC_RESET_FLAG_AP_OFF,
				   POWER_S0, __LINE__);
	power_chipset_init_subtest(POWER_S0, true, EC_RESET_FLAG_AP_OFF,
				   POWER_S0, __LINE__);
	power_chipset_init_subtest(POWER_G3, true, EC_RESET_FLAG_HIBERNATE,
				   POWER_S0, __LINE__);
	power_chipset_init_subtest(POWER_S0, true, EC_RESET_FLAG_HIBERNATE,
				   POWER_S0, __LINE__);
	power_chipset_init_subtest(POWER_G3, true, EC_RESET_FLAG_AP_IDLE,
				   POWER_G3, __LINE__);
	power_chipset_init_subtest(POWER_S0, true, EC_RESET_FLAG_AP_IDLE,
				   POWER_S0, __LINE__);

	/* No reset flag => always boot to S0 */
	power_chipset_init_subtest(POWER_G3, false, 0, POWER_S0, __LINE__);
	power_chipset_init_subtest(POWER_S0, false, 0, POWER_S0, __LINE__);

	/* AP off => stay at G3 */
	power_chipset_init_subtest(POWER_G3, false, EC_RESET_FLAG_AP_OFF,
				   POWER_G3, __LINE__);
	power_chipset_init_subtest(POWER_S0, false, EC_RESET_FLAG_AP_OFF,
				   POWER_G3, __LINE__);

	/* AC insert from hibernate => boot to S0 */
	gpio_emul_input_set(ac_present->port, ac_present->pin, 1);
	power_chipset_init_subtest(POWER_G3, false, EC_RESET_FLAG_HIBERNATE,
				   POWER_S0, __LINE__);

	/* AP_IDLE => keep current state */
	power_chipset_init_subtest(POWER_G3, false, EC_RESET_FLAG_AP_IDLE,
				   POWER_G3, __LINE__);
	power_chipset_init_subtest(POWER_S0, false, EC_RESET_FLAG_AP_IDLE,
				   POWER_S0, __LINE__);
}

ZTEST(power_seq, test_low_battery_boot)
{
	system_can_boot_ap_fake.return_val = 0;
	/* Don't boot AP if system_can_boot_ap says no */
	power_chipset_init_subtest(POWER_G3, false, 0, POWER_G3, __LINE__);
}

ZTEST_SUITE(power_seq, krabby_predicate_post_main, power_seq_setup,
	    power_seq_before, NULL, power_seq_teardown);
```

## src/temp_skitty.c
```c
/* Copyright 2024 The ChromiumOS Authors
 * Use of this source code is governed by a BSD-style license that can be
 * found in the LICENSE file.
 */

#include "charge_state.h"
#include "charger.h"
#include "charger_profile_override.h"
#include "common.h"
#include "hooks.h"
#include "temp_sensor.h"
#include "temp_sensor/temp_sensor.h"
#include "util.h"

#include <zephyr/drivers/adc.h>
#include <zephyr/drivers/adc/adc_emul.h>
#include <zephyr/kernel.h>
#include <zephyr/ztest.h>

#define ADC_DEVICE_NODE DT_NODELABEL(adc0)
#define CHARGER_TEMP TEMP_SENSOR_ID(DT_NODELABEL(temp_charger))
#define ORIGINAL_CURRENT 2400
#define LOW_CURRENT 365

struct charge_state_data curr;
static int fake_voltage;
int count;

/* Limit charging current table : 2400/1400/365
 * note this should be in descending order.
 */

struct current_table_struct {
	int temperature;
	int current;
};

static const struct current_table_struct current_table[] = {
	{ 0, 2400 },
	{ 55, 1400 },
	{ 57, 365 },
};

#define CURRENT_LEVELS ARRAY_SIZE(current_table)

static void heating_device(void)
{
	for (int i = 0; i < 55; i++) {
		hook_notify(HOOK_SECOND);
		curr.requested_current = ORIGINAL_CURRENT;
		charger_profile_override(&curr);
	}
}

static void cool_down_device(void)
{
	for (int i = 0; i < 55; i++) {
		hook_notify(HOOK_SECOND);
		curr.requested_current = LOW_CURRENT;
		charger_profile_override(&curr);
	}
}

int setup_faketemp(int fake_voltage)
{
	const struct device *adc_dev = DEVICE_DT_GET(ADC_DEVICE_NODE);
	const uint8_t channel_id =
		DT_IO_CHANNELS_INPUT(DT_NODELABEL(adc_charger));
	int emul_temp;

	emul_temp = adc_emul_const_value_set(adc_dev, channel_id, fake_voltage);
	return emul_temp;
}

ZTEST(temp_skitty, test_decrease_current_level)
{
	fake_voltage = 350;
	curr.batt.flags |= BATT_FLAG_RESPONSIVE;
	count = 0;

	setup_faketemp(fake_voltage);
	heating_device();
	zassert_equal(curr.requested_current, current_table[count].current);
	for (int uptime_time = 0; uptime_time < 13; uptime_time++) {
		hook_notify(HOOK_SECOND);
		curr.requested_current = ORIGINAL_CURRENT;
		charger_profile_override(&curr);
		if (uptime_time % 6 == 0) {
			if (curr.requested_current != ORIGINAL_CURRENT) {
				count++;
				zassert_equal(curr.requested_current,
					      current_table[count].current);
			}
		}
	}
}

ZTEST(temp_skitty, test_increase_current)
{
	fake_voltage = 400;
	curr.batt.flags |= BATT_FLAG_RESPONSIVE;
	count = 2;

	setup_faketemp(fake_voltage);
	cool_down_device();
	zassert_equal(curr.requested_current, current_table[count].current);

	for (int uptime_time = 0; uptime_time < 60; uptime_time++) {
		hook_notify(HOOK_SECOND);
		curr.requested_current = ORIGINAL_CURRENT;
		charger_profile_override(&curr);
		if (uptime_time % 6 == 0) {
			if (curr.requested_current != ORIGINAL_CURRENT) {
				count--;
				zassert_equal(curr.requested_current,
					      current_table[count].current);
			}
		}
	}
}

ZTEST(temp_skitty, test_battery_no_response)
{
	int rv;

	curr.batt.flags &= ~BATT_FLAG_RESPONSIVE;
	rv = charger_profile_override(&curr);
	zassert_equal(rv, 0);
}

ZTEST(temp_skitty, test_charger_profile_override_get_param)
{
	int rv;

	rv = charger_profile_override_get_param(0, 0);

	zassert_equal(rv, 3);
}

ZTEST(temp_skitty, test_charger_profile_override_set_param)
{
	int rv;

	rv = charger_profile_override_set_param(0, 0);

	zassert_equal(rv, 3);
}

ZTEST_SUITE(temp_skitty, NULL, NULL, NULL, NULL, NULL);
```

## src/temp_tentacruel.c
```c
/* Copyright 2022 The ChromiumOS Authors
 * Use of this source code is governed by a BSD-style license that can be
 * found in the LICENSE file.
 */

#include "charge_state.h"
#include "charger.h"
#include "charger_profile_override.h"
#include "common.h"
#include "hooks.h"
#include "temp_sensor.h"
#include "temp_sensor/temp_sensor.h"
#include "util.h"

#include <zephyr/drivers/adc.h>
#include <zephyr/drivers/adc/adc_emul.h>
#include <zephyr/kernel.h>
#include <zephyr/ztest.h>

#define ADC_DEVICE_NODE DT_NODELABEL(adc0)
#define CHARGER_TEMP TEMP_SENSOR_ID(DT_NODELABEL(temp_charger))
#define ORIGINAL_CURRENT 5000

struct charge_state_data curr;
static int fake_voltage;
int count;

/* Limit charging current table : 3600/3000/2400/1800
 * note this should be in descending order.
 */
static uint16_t current_table[] = {
	3600,
	3000,
	2400,
	1600,
};

int setup_faketemp(int fake_voltage)
{
	const struct device *adc_dev = DEVICE_DT_GET(ADC_DEVICE_NODE);
	const uint8_t channel_id =
		DT_IO_CHANNELS_INPUT(DT_NODELABEL(adc_charger));
	int emul_temp;

	emul_temp = adc_emul_const_value_set(adc_dev, channel_id, fake_voltage);
	return emul_temp;
}

static void ignore_first_minute(void)
{
	for (int i = 0; i < 60; i++) {
		hook_notify(HOOK_SECOND);
	}
}

ZTEST(temp_tentacruel, test_decrease_current)
{
	fake_voltage = 411;
	curr.batt.flags |= BATT_FLAG_RESPONSIVE;
	count = 0;

	setup_faketemp(fake_voltage);
	/* Calculate per minute temperature.
	 * It's expected low temperature when the first 60 seconds.
	 */
	ignore_first_minute();
	for (int i = 1; i < 26; i++) {
		hook_notify(HOOK_SECOND);
		curr.requested_current = ORIGINAL_CURRENT;
		charger_profile_override(&curr);
		if (i % 6 == 0) {
			zassert_equal(current_table[count],
				      curr.requested_current, NULL);
			count++;
		}
	}
	zassert_equal(count, 4, NULL);
}

ZTEST(temp_tentacruel, test_increase_current)
{
	fake_voltage = 446;
	curr.batt.flags |= BATT_FLAG_RESPONSIVE;
	count = 3;

	setup_faketemp(fake_voltage);
	for (int i = 1; i < 26; i++) {
		hook_notify(HOOK_SECOND);
		curr.requested_current = ORIGINAL_CURRENT;
		charger_profile_override(&curr);
		if (i % 5 == 0) {
			if (curr.requested_current == ORIGINAL_CURRENT) {
				zassert_equal(ORIGINAL_CURRENT,
					      curr.requested_current, NULL);
			} else {
				zassert_equal(current_table[count],
					      curr.requested_current, NULL);
				count--;
			}
		}
	}
	zassert_equal(count, -1, NULL);
}

ZTEST_SUITE(temp_tentacruel, NULL, NULL, NULL, NULL, NULL);
```

## src/temp_veluza.c
```c
/* Copyright 2024 The ChromiumOS Authors
 * Use of this source code is governed by a BSD-style license that can be
 * found in the LICENSE file.
 */

#include "charge_state.h"
#include "charger.h"
#include "charger_profile_override.h"
#include "common.h"
#include "extpower.h"
#include "hooks.h"
#include "temp_sensor.h"
#include "temp_sensor/temp_sensor.h"
#include "util.h"

#include <zephyr/drivers/adc.h>
#include <zephyr/drivers/adc/adc_emul.h>
#include <zephyr/kernel.h>
#include <zephyr/ztest.h>

#define ADC_DEVICE_NODE DT_NODELABEL(adc0)
#define CHARGER_TEMP TEMP_SENSOR_ID(DT_NODELABEL(temp_charger))
#define ORIGINAL_CURRENT 2554
#define LOW_CURRENT 365

struct charge_state_data curr;
static int fake_voltage;
int count;

/* Limit charging current table : 3600/3000/2400/1800
 * note this should be in descending order.
 */

struct current_table_struct {
	int temperature;
	int current;
};

static const struct current_table_struct current_table[] = {
	{ 0, 2554 },
	{ 55, 1400 },
	{ 57, 365 },
};

#define CURRENT_LEVELS ARRAY_SIZE(current_table)

static void heating_device(void)
{
	for (int i = 0; i < 55; i++) {
		hook_notify(HOOK_SECOND);
		curr.requested_current = ORIGINAL_CURRENT;
		charger_profile_override(&curr);
	}
}

static void cool_down_device(void)
{
	for (int i = 0; i < 55; i++) {
		hook_notify(HOOK_SECOND);
		curr.requested_current = LOW_CURRENT;
		charger_profile_override(&curr);
	}
}

int setup_faketemp(int fake_voltage)
{
	const struct device *adc_dev = DEVICE_DT_GET(ADC_DEVICE_NODE);
	const uint8_t channel_id =
		DT_IO_CHANNELS_INPUT(DT_NODELABEL(adc_charger));
	int emul_temp;

	emul_temp = adc_emul_const_value_set(adc_dev, channel_id, fake_voltage);
	return emul_temp;
}

ZTEST(temp_veluza, test_decrease_current_level)
{
	fake_voltage = 350;
	curr.batt.flags |= BATT_FLAG_RESPONSIVE;
	count = 0;

	setup_faketemp(fake_voltage);
	heating_device();
	zassert_equal(curr.requested_current, current_table[count].current);
	for (int uptime_time = 0; uptime_time < 13; uptime_time++) {
		hook_notify(HOOK_SECOND);
		curr.requested_current = ORIGINAL_CURRENT;
		charger_profile_override(&curr);
		if (uptime_time % 6 == 0) {
			if (curr.requested_current != ORIGINAL_CURRENT) {
				count++;
				zassert_equal(curr.requested_current,
					      current_table[count].current);
			}
		}
	}
}

ZTEST(temp_veluza, test_increase_current)
{
	fake_voltage = 400;
	curr.batt.flags |= BATT_FLAG_RESPONSIVE;
	count = 2;

	setup_faketemp(fake_voltage);
	cool_down_device();
	zassert_equal(curr.requested_current, current_table[count].current);

	for (int uptime_time = 0; uptime_time < 60; uptime_time++) {
		hook_notify(HOOK_SECOND);
		curr.requested_current = ORIGINAL_CURRENT;
		charger_profile_override(&curr);
		if (uptime_time % 6 == 0) {
			if (curr.requested_current != ORIGINAL_CURRENT) {
				count--;
				zassert_equal(curr.requested_current,
					      current_table[count].current);
			}
		}
	}
}

ZTEST(temp_veluza, test_battery_no_response)
{
	int rv;

	curr.batt.flags &= ~BATT_FLAG_RESPONSIVE;
	rv = charger_profile_override(&curr);
	zassert_equal(rv, 0);
}

ZTEST(temp_veluza, test_charger_profile_override_get_param)
{
	int rv;

	rv = charger_profile_override_get_param(0, 0);

	zassert_equal(rv, 3);
}

ZTEST(temp_veluza, test_charger_profile_override_set_param)
{
	int rv;

	rv = charger_profile_override_set_param(0, 0);

	zassert_equal(rv, 3);
}

ZTEST_SUITE(temp_veluza, NULL, NULL, NULL, NULL, NULL);
```
