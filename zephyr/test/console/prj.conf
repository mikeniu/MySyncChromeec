## prj.conf
```kconfig
# Copyright 2024 The ChromiumOS Authors
# Use of this source code is governed by a BSD-style license that can be
# found in the LICENSE file.

CONFIG_ZTEST=y
CONFIG_PLATFORM_EC=y
CONFIG_CROS_EC=y

# Dummy shell backend for restricted console testing
CONFIG_SHELL=y
CONFIG_SHELL_BACKEND_DUMMY=y
CONFIG_SHELL_BACKEND_DUMMY_BUF_SIZE=1000
```

## console_output.conf
```kconfig
<<<<<<< HEAD   (453fd99d5363bf9651b2fb0d3ffbbab7386a6376 program,zmake: drop cmsis references)
# Copyright 2024 The ChromiumOS Authors
# Use of this source code is governed by a BSD-style license that can be
# found in the LICENSE file.

CONFIG_ZTEST=y
CONFIG_PLATFORM_EC=y
CONFIG_CROS_EC=y
CONFIG_EMUL=y

CONFIG_SHELL=y
CONFIG_SHELL_BACKEND_SERIAL=y

# Print logs from Zephyr LOG_MODULE to stdout
CONFIG_UART_NATIVE_PTY_0_ON_STDINOUT=y

CONFIG_SHIMMED_TASKS=y
CONFIG_PLATFORM_EC_VBOOT_HASH=n
CONFIG_PLATFORM_EC_SWITCH=n

# Set up the logging mode to match the typical Zephyr EC.
CONFIG_LOG_MODE_IMMEDIATE=n
CONFIG_LOG_MODE_MINIMAL=y

# Ensure that posix console support initializes before our
# EC console shim so we can properly override the printk() hook.
CONFIG_POSIX_ARCH_CONSOLE_INIT_PRIORITY=60

# By default, ZTEST output is sent to printk(), but the console output
# tests send printk() output to the emulator UART.  Override so that ZTEST
# output is sent directly to the STDOUT filehandle.
CONFIG_ZTEST_TC_UTIL_USER_OVERRIDE=y
||||||| BASE   (0cb93ccd933607defa9592c423c9a9fb4946fd4d anakin: Set PDC source PDO overcurrent capability)
# Copyright 2024 The ChromiumOS Authors
# Use of this source code is governed by a BSD-style license that can be
# found in the LICENSE file.

CONFIG_ZTEST=y
CONFIG_PLATFORM_EC=y
CONFIG_CROS_EC=y
CONFIG_EMUL=y

CONFIG_SHELL=y
CONFIG_SHELL_BACKEND_SERIAL=y

# Print logs from Zephyr LOG_MODULE to stdout
CONFIG_NATIVE_UART_0_ON_STDINOUT=y

CONFIG_SHIMMED_TASKS=y
CONFIG_PLATFORM_EC_VBOOT_HASH=n
CONFIG_PLATFORM_EC_SWITCH=n

# Set up the logging mode to match the typical Zephyr EC.
CONFIG_LOG_MODE_IMMEDIATE=n
CONFIG_LOG_MODE_MINIMAL=y

# Ensure that posix console support initializes before our
# EC console shim so we can properly override the printk() hook.
CONFIG_POSIX_ARCH_CONSOLE_INIT_PRIORITY=60

# By default, ZTEST output is sent to printk(), but the console output
# tests send printk() output to the emulator UART.  Override so that ZTEST
# output is sent directly to the STDOUT filehandle.
CONFIG_ZTEST_TC_UTIL_USER_OVERRIDE=y
=======
>>>>>>> BRANCH (86da3bbeafeffe5727f5bfec7d9eed87995f2661 UPSTREAM: driver: add new ALS CM36781 driver code)
```

## src/console_output.c
```c
/* Copyright 2024 The ChromiumOS Authors
 * Use of this source code is governed by a BSD-style license that can be
 * found in the LICENSE file.
 */

#include "common.h"
#include "console.h"
#include "ec_app_main.h"
#include "zephyr/kernel.h"

#include <zephyr/drivers/serial/uart_emul.h>
#include <zephyr/drivers/uart.h>
#include <zephyr/interrupt_util.h>
#include <zephyr/irq.h>
#include <zephyr/logging/log.h>
#include <zephyr/shell/shell.h>
#include <zephyr/shell/shell_backend.h>
#include <zephyr/shell/shell_uart.h>
#include <zephyr/ztest.h>

LOG_MODULE_REGISTER(test_console_out, LOG_LEVEL_DBG);

#define EMUL_UART_NODE DT_NODELABEL(euart0)
#define EMUL_UART_RX_FIFO_SIZE DT_PROP(EMUL_UART_NODE, rx_fifo_size)
#define EMUL_UART_TX_FIFO_SIZE DT_PROP(EMUL_UART_NODE, tx_fifo_size)

#define SAMPLE_DATA_SIZE MIN(EMUL_UART_RX_FIFO_SIZE, EMUL_UART_TX_FIFO_SIZE) - 1

#ifdef CONFIG_SHELL_BACKEND_SERIAL_API_INTERRUPT_DRIVEN
#define SHELL_SLEEP() k_sleep(K_MSEC(5))
#else
#define SHELL_SLEEP()
#endif

struct console_output_fixture {
	const struct device *dev;
};

static void *setup(void)
{
	static struct console_output_fixture fixture = {
		.dev = DEVICE_DT_GET(EMUL_UART_NODE),
	};

	zassert_not_null(fixture.dev);

	return &fixture;
}

static void before(void *f)
{
	struct console_output_fixture *fixture = f;

	uart_emul_flush_tx_data(fixture->dev);

	uart_irq_tx_enable(fixture->dev);
	uart_irq_rx_enable(fixture->dev);

	zassert_ok(uart_err_check(fixture->dev));

	console_channel_enable("system");
	console_channel_enable("zephyr_log");
}

ZTEST_SUITE(console_output, NULL, setup, before, NULL, NULL);

static const char *cputs_message = "cputs() test output";
static const char *cprints_message = "cprints() test output";
static const char *cprintf_message = "cprintf() test output";

/**
 * @brief Test non-shell output from the legacy EC.
 */
ZTEST_F(console_output, test_legacy_debug_output)
{
	uint8_t tx_content[SAMPLE_DATA_SIZE];
	uint32_t tx_bytes;

	/* All legacy output is sent to the shell backend which inserts
	 * a prompt and other control characters.
	 * Just look for our substring in the output.
	 */
	uart_emul_flush_tx_data(fixture->dev);
	memset(tx_content, 0, sizeof(tx_content));
	cputs(CC_SYSTEM, cputs_message);
	SHELL_SLEEP();
	tx_bytes = uart_emul_get_tx_data(fixture->dev, tx_content,
					 sizeof(tx_content));
	zassert_true(tx_bytes >= strlen(cputs_message));
	zassert_not_null(strstr((char *)tx_content, cputs_message));

	uart_emul_flush_tx_data(fixture->dev);
	memset(tx_content, 0, sizeof(tx_content));
	cprints(CC_SYSTEM, "%s", cprints_message);
	SHELL_SLEEP();
	tx_bytes = uart_emul_get_tx_data(fixture->dev, tx_content,
					 sizeof(tx_content));
	zassert_true(tx_bytes >= strlen(cprints_message));
	zassert_not_null(strstr((char *)tx_content, cprints_message));

	uart_emul_flush_tx_data(fixture->dev);
	memset(tx_content, 0, sizeof(tx_content));
	cprintf(CC_SYSTEM, "%s", cprintf_message);
	SHELL_SLEEP();
	tx_bytes = uart_emul_get_tx_data(fixture->dev, tx_content,
					 sizeof(tx_content));
	zassert_true(tx_bytes >= strlen(cprintf_message));
	zassert_not_null(strstr((char *)tx_content, cprintf_message));

	/* Filter out CC_SYSTEM, no output should be generated. */
	uart_emul_flush_tx_data(fixture->dev);
	memset(tx_content, 0, sizeof(tx_content));

	console_channel_disable("system");
	cputs(CC_SYSTEM, cputs_message);
	cprints(CC_SYSTEM, "%s", cprints_message);
	cprintf(CC_SYSTEM, "%s", cprintf_message);
	tx_bytes = uart_emul_get_tx_data(fixture->dev, tx_content,
					 sizeof(tx_content));
	zassert_equal(tx_bytes, 0);
}

static const char *cputs_system_message = "cputs(CC_SYSTEM) test output";
static const char *shell_invalid_param = "Parameter 1 invalid";
static const char *shell_help_output = "Usage:";

/* Verify that filtering Zephyr log messages still allows legacy
 * EC output through.
 */
ZTEST_F(console_output, test_legacy_output_with_log_filtered)
{
	uint8_t tx_content[SAMPLE_DATA_SIZE];
	uint32_t tx_bytes;

	/* Disable all legacy channels to simulate how FAFT is typically run. */
	zassert_ok(shell_execute_cmd(get_ec_shell(), "chan 0"));
	k_sleep(K_MSEC(1));

	/* Enable just the CC_SYSTEM channel. */
	console_channel_enable("system");

	uart_emul_flush_tx_data(fixture->dev);
	memset(tx_content, 0, sizeof(tx_content));
	cputs(CC_SYSTEM, cputs_system_message);
	SHELL_SLEEP();
	tx_bytes = uart_emul_get_tx_data(fixture->dev, tx_content,
					 sizeof(tx_content));
	zassert_true(tx_bytes >= strlen(cputs_system_message));
	zassert_not_null(strstr((char *)tx_content, cputs_system_message));

	/* Running a legacy shell command with a parameter error should still
	 * generate output.
	 */
	uart_emul_flush_tx_data(fixture->dev);
	memset(tx_content, 0, sizeof(tx_content));

	zassert_equal(shell_execute_cmd(get_ec_shell(),
					"chan not_a_valid_name"),
		      EC_ERROR_PARAM1);
	k_sleep(K_MSEC(1));

	tx_bytes = uart_emul_get_tx_data(fixture->dev, tx_content,
					 sizeof(tx_content));
	zassert_true(tx_bytes >= strlen(shell_invalid_param));
	zassert_not_null(strstr((char *)tx_content, shell_invalid_param));

	/* Running help on a legacy shell command should generate output. */
	uart_emul_flush_tx_data(fixture->dev);
	memset(tx_content, 0, sizeof(tx_content));
	zassert_ok(shell_execute_cmd(get_ec_shell(), "chan help"));
	k_sleep(K_MSEC(1));
	tx_bytes = uart_emul_get_tx_data(fixture->dev, tx_content,
					 sizeof(tx_content));
	zassert_true(tx_bytes >= strlen(shell_help_output));
	zassert_not_null(strstr((char *)tx_content, shell_help_output));

	zassert_ok(shell_execute_cmd(get_ec_shell(), "chan restore"));
	k_sleep(K_MSEC(1));
}

ZTEST_F(console_output, test_legacy_shell_output)
{
	uint8_t tx_content[SAMPLE_DATA_SIZE];
	uint32_t tx_bytes;

	/* Disable "all" legacy channels.  The CC_COMMAND channel
	 * Should remain enabled.
	 */
	zassert_ok(shell_execute_cmd(get_ec_shell(), "chan 0"));
	k_sleep(K_MSEC(1));

	/* The shell backend inserts a prompt and other control characters.
	 * Just look for our substring in the output.
	 */
	uart_emul_flush_tx_data(fixture->dev);
	memset(tx_content, 0, sizeof(tx_content));
	cputs(CC_COMMAND, cputs_message);
	SHELL_SLEEP();
	tx_bytes = uart_emul_get_tx_data(fixture->dev, tx_content,
					 sizeof(tx_content));
	zassert_true(tx_bytes >= strlen(cputs_message));
	zassert_not_null(strstr((char *)tx_content, cputs_message));

	/* Test cprints() to the shell. */
	uart_emul_flush_tx_data(fixture->dev);
	memset(tx_content, 0, sizeof(tx_content));
	cprints(CC_COMMAND, "%s", cprints_message);
	SHELL_SLEEP();
	tx_bytes = uart_emul_get_tx_data(fixture->dev, tx_content,
					 sizeof(tx_content));
	zassert_true(tx_bytes >= strlen(cprints_message));
	zassert_not_null(strstr((char *)tx_content, cprints_message));

	/* Test cprintf() to the shell. */
	uart_emul_flush_tx_data(fixture->dev);
	memset(tx_content, 0, sizeof(tx_content));
	cprintf(CC_COMMAND, "%s", cprintf_message);
	SHELL_SLEEP();
	tx_bytes = uart_emul_get_tx_data(fixture->dev, tx_content,
					 sizeof(tx_content));
	zassert_true(tx_bytes >= strlen(cprintf_message));
	zassert_not_null(strstr((char *)tx_content, cprintf_message));

	zassert_ok(shell_execute_cmd(get_ec_shell(), "chan restore"));
	k_sleep(K_MSEC(1));
}

static const char *log_raw_message = "LOG_RAW test output";
static const char *log_err_message = "LOG_ERR test output";
static const char *log_inf_message = "LOG_INF test output";
static const char *log_dbg_message = "LOG_DBG test output";

ZTEST_F(console_output, test_log_output)
{
	uint8_t tx_content[SAMPLE_DATA_SIZE];
	uint32_t tx_bytes;

	/* We expect an exact match with LOG_RAW() output. */
	uart_emul_flush_tx_data(fixture->dev);
	memset(tx_content, 0, sizeof(tx_content));
	LOG_RAW("%s", log_raw_message);
	tx_bytes = uart_emul_get_tx_data(fixture->dev, tx_content,
					 sizeof(tx_content));
	zassert_equal(tx_bytes, strlen(log_raw_message));
	zassert_mem_equal(tx_content, log_raw_message, strlen(tx_content));

	/* LOG_ERR prepends the output, so an exact match isn't possible. */
	uart_emul_flush_tx_data(fixture->dev);
	memset(tx_content, 0, sizeof(tx_content));
	LOG_ERR("%s", log_err_message);
	tx_bytes = uart_emul_get_tx_data(fixture->dev, tx_content,
					 sizeof(tx_content));
	zassert_true(tx_bytes >= strlen(log_err_message));
	zassert_not_null(strstr((char *)tx_content, log_err_message));

	/* LOG_INF prepends the output, so an exact match isn't possible. */
	uart_emul_flush_tx_data(fixture->dev);
	memset(tx_content, 0, sizeof(tx_content));
	LOG_INF("%s", log_inf_message);
	tx_bytes = uart_emul_get_tx_data(fixture->dev, tx_content,
					 sizeof(tx_content));
	zassert_true(tx_bytes >= strlen(log_inf_message));
	zassert_not_null(strstr((char *)tx_content, log_inf_message));

	/* LOG_DBG prepends the output, so an exact match isn't possible. */
	uart_emul_flush_tx_data(fixture->dev);
	memset(tx_content, 0, sizeof(tx_content));
	LOG_DBG("%s", log_dbg_message);
	tx_bytes = uart_emul_get_tx_data(fixture->dev, tx_content,
					 sizeof(tx_content));
	zassert_true(tx_bytes >= strlen(log_dbg_message));
	zassert_not_null(strstr((char *)tx_content, log_dbg_message));

	/* Filter out CC_ZEPHYR_LOG, no output should be generated. */
	console_channel_disable("zephyr_log");
	LOG_RAW("%s", log_raw_message);
	LOG_ERR("%s", log_err_message);
	LOG_INF("%s", log_inf_message);
	LOG_DBG("%s", log_dbg_message);
	tx_bytes = uart_emul_get_tx_data(fixture->dev, tx_content,
					 sizeof(tx_content));
	zassert_equal(tx_bytes, 0);
}

static const char *shell_message = "Zephyr shell test output";

ZTEST_F(console_output, test_shell_output)
{
	uint8_t tx_content[SAMPLE_DATA_SIZE];
	uint32_t tx_bytes;
	const struct shell *ec_sh;

	/* Disable "all" legacy channels.  Output from the shell subsystem
	 * should remain enabled.
	 */
	ec_sh = get_ec_shell();
	zassert_ok(shell_execute_cmd(ec_sh, "chan 0"));
	k_sleep(K_MSEC(1));

	uart_emul_flush_tx_data(fixture->dev);
	memset(tx_content, 0, sizeof(tx_content));
	shell_fprintf(ec_sh, SHELL_NORMAL, "%s", shell_message);
	k_sleep(K_MSEC(1));

	/* The shell backend inserts a prompt and other control characters.
	 * Just look for our substring in the output.
	 */
	tx_bytes = uart_emul_get_tx_data(fixture->dev, tx_content,
					 sizeof(tx_content));
	zassert_true(tx_bytes >= strlen(shell_message));
	zassert_not_null(strstr((char *)tx_content, shell_message));

	zassert_ok(shell_execute_cmd(get_ec_shell(), "chan restore"));
	k_sleep(K_MSEC(1));
}

#define TEST_IRQ_LINE_1 27
#define TEST_IRQ_LINE_2 28
#define TEST_IRQ_LINE_3 29

#define TEST_IRQ_PRIO 2

enum output_type {
	OUTPUT_CPUTS,
	OUTPUT_CPRINTS,
	OUTPUT_CPRINTF,
};

static const char *isr_cputs = "cputs from ISR";
static const char *isr_cprints = "cprints from ISR";
static const char *isr_cprintf = "cprintf from ISR";

static bool cputs_isr_called;
static bool cprints_isr_called;
static bool cprintf_isr_called;

void test_isr(const void *param)
{
	enum output_type type = (enum output_type)param;

	switch (type) {
	case OUTPUT_CPUTS:
		cputs_isr_called = true;
		cputs(CC_SYSTEM, isr_cputs);
		break;
	case OUTPUT_CPRINTS:
		cprints_isr_called = true;
		cprints(CC_SYSTEM, "%s", isr_cprints);
		break;
	case OUTPUT_CPRINTF:
		cprintf_isr_called = true;
		cprintf(CC_SYSTEM, "%s", isr_cprintf);
		break;
	}
}

ZTEST_F(console_output, test_isr_output)
{
	uint8_t tx_content[SAMPLE_DATA_SIZE];
	uint32_t tx_bytes;

	IRQ_CONNECT(TEST_IRQ_LINE_1, TEST_IRQ_PRIO, test_isr,
		    (void *)OUTPUT_CPUTS, 0);
	IRQ_CONNECT(TEST_IRQ_LINE_2, TEST_IRQ_PRIO, test_isr,
		    (void *)OUTPUT_CPRINTS, 0);
	IRQ_CONNECT(TEST_IRQ_LINE_3, TEST_IRQ_PRIO, test_isr,
		    (void *)OUTPUT_CPRINTF, 0);

	irq_enable(TEST_IRQ_LINE_1);
	irq_enable(TEST_IRQ_LINE_2);
	irq_enable(TEST_IRQ_LINE_3);

	SHELL_SLEEP();
	uart_emul_flush_tx_data(fixture->dev);

	trigger_irq(TEST_IRQ_LINE_1);
	zassert_true(cputs_isr_called);
	SHELL_SLEEP();

	tx_bytes = uart_emul_get_tx_data(fixture->dev, tx_content,
					 sizeof(tx_content));

	if (IS_ENABLED(CONFIG_PLATFORM_EC_ISR_CONSOLE_OUTPUT)) {
		/*
		 * Verify that "[ISR]" prefix appears before the message
		 * payload. Note: Channel names/timestamps may be inserted
		 * between
		 * "[ISR]" and the payload, so compare pointer positions
		 * rather than checking for a contiguous substring.
		 */
		char *isr_prefix = strstr((char *)tx_content, "[ISR]");
		char *msg_ptr = strstr((char *)tx_content, isr_cputs);

		zassert_true(tx_bytes >= strlen(isr_cputs));
		zassert_not_null(isr_prefix);
		zassert_not_null(msg_ptr);
		zassert_true(isr_prefix < msg_ptr);
	} else {
		zassert_true(tx_bytes == 0);
	}

	uart_emul_flush_tx_data(fixture->dev);
	trigger_irq(TEST_IRQ_LINE_2);
	zassert_true(cprints_isr_called);
	SHELL_SLEEP();

	tx_bytes = uart_emul_get_tx_data(fixture->dev, tx_content,
					 sizeof(tx_content));

	if (IS_ENABLED(CONFIG_PLATFORM_EC_ISR_CONSOLE_OUTPUT)) {
		char *isr_prefix = strstr((char *)tx_content, "[ISR]");
		char *msg_ptr = strstr((char *)tx_content, isr_cprints);

		zassert_true(tx_bytes >= strlen(isr_cprints));
		zassert_not_null(isr_prefix);
		zassert_not_null(msg_ptr);
		zassert_true(isr_prefix < msg_ptr);
	} else {
		zassert_true(tx_bytes == 0);
	}

	uart_emul_flush_tx_data(fixture->dev);
	trigger_irq(TEST_IRQ_LINE_3);
	zassert_true(cprintf_isr_called);
	SHELL_SLEEP();

	tx_bytes = uart_emul_get_tx_data(fixture->dev, tx_content,
					 sizeof(tx_content));

	if (IS_ENABLED(CONFIG_PLATFORM_EC_ISR_CONSOLE_OUTPUT)) {
		char *isr_prefix = strstr((char *)tx_content, "[ISR]");
		char *msg_ptr = strstr((char *)tx_content, isr_cprintf);

		zassert_true(tx_bytes >= strlen(isr_cprintf));
		zassert_not_null(isr_prefix);
		zassert_not_null(msg_ptr);
		zassert_true(isr_prefix < msg_ptr);
	} else {
		zassert_true(tx_bytes == 0);
	}
}

ZTEST_F(console_output, test_console_panic)
{
	const struct shell *ec_sh = get_ec_shell();
	struct shell_uart_common *sh_uart =
		(struct shell_uart_common *)ec_sh->iface->ctx;

	uart_emul_flush_tx_data(fixture->dev);
	if (IS_ENABLED(CONFIG_SHELL_BACKEND_SERIAL_API_INTERRUPT_DRIVEN)) {
		struct shell_uart_int_driven *sh_uart_int =
			(struct shell_uart_int_driven *)ec_sh->iface->ctx;

		ring_buf_reset(&sh_uart_int->tx_ringbuf);
		ring_buf_put(&sh_uart_int->tx_ringbuf,
			     (const uint8_t *)cputs_message,
			     strlen(cputs_message));
		zassert_false(ring_buf_is_empty(&sh_uart_int->tx_ringbuf));
	}

	zassert_false(sh_uart->blocking_tx);
	zephyr_console_panic();
	zassert_true(sh_uart->blocking_tx);

	if (IS_ENABLED(CONFIG_SHELL_BACKEND_SERIAL_API_INTERRUPT_DRIVEN)) {
		struct shell_uart_int_driven *sh_uart_int =
			(struct shell_uart_int_driven *)ec_sh->iface->ctx;
		uint8_t tx_content[SAMPLE_DATA_SIZE] = { 0 };
		uint32_t tx_bytes;

		zassert_true(ring_buf_is_empty(&sh_uart_int->tx_ringbuf));
		tx_bytes = uart_emul_get_tx_data(fixture->dev, tx_content,
						 sizeof(tx_content));
		zassert_equal(tx_bytes, strlen(cputs_message));
		zassert_mem_equal(tx_content, cputs_message,
				  strlen(cputs_message));
	}

	(void)ec_sh->iface->api->enable(ec_sh->iface, false);
}

ZTEST_F(console_output, test_no_yield_output)
{
	uint8_t tx_content[SAMPLE_DATA_SIZE] = { 0 };
	uint32_t tx_bytes;
	unsigned int key;

	uart_emul_flush_tx_data(fixture->dev);

	key = irq_lock();
	zassert_false(k_is_in_isr());
	zassert_false(k_can_yield());
	cputs(CC_SYSTEM, cputs_message);
	irq_unlock(key);

	tx_bytes = uart_emul_get_tx_data(fixture->dev, tx_content,
					 sizeof(tx_content));
	zassert_true(tx_bytes >= strlen(cputs_message));
	zassert_not_null(strstr((char *)tx_content, cputs_message));
}

void test_main(void)
{
	ec_app_main();

	/* Allow Zephyr defined threads a chance to run. */
	k_sleep(K_MSEC(10));

	/* Run all the suites that depend on main being called */
	ztest_run_test_suites(NULL, false, 1, 1);

	/* Check that every suite ran */
	ztest_verify_all_test_suites_ran();
}
```

## src/console_restricted.c
```c
/* Copyright 2024 The ChromiumOS Authors
 * Use of this source code is governed by a BSD-style license that can be
 * found in the LICENSE file.
 */

#include "common.h"
#include "console.h"

#include <stdio.h>

#include <zephyr/shell/shell_dummy.h>
#include <zephyr/ztest.h>

static int is_locked;

int system_is_locked(void)
{
	return is_locked;
}

ZTEST_SUITE(restricted_console, NULL, NULL, NULL, NULL, NULL);

ZTEST(restricted_console, test_command_mem_dump)
{
	int rv;
	/* This word will be read by the md command. */
	const volatile uint32_t valid_word = 0x1badd00d;
	/* Compose the md console command to read |valid_word|. */
	char console_input[] = "md 0x01234567";

	snprintf(console_input, sizeof(console_input), "md %p", &valid_word);

	is_locked = 0;
	rv = shell_execute_cmd(shell_backend_dummy_get_ptr(), console_input);
	zassert_equal(rv, EC_SUCCESS);

	is_locked = 1;
	rv = shell_execute_cmd(shell_backend_dummy_get_ptr(), console_input);
	zassert_equal(rv, EC_ERROR_ACCESS_DENIED);
}

ZTEST(restricted_console, test_command_read_write_word)
{
	int rv;
	const uint32_t old_value = 0x1badd00d;
	/* This word will be read/written by the rw command. */
	volatile uint32_t valid_word = old_value;
	/* Compose the rw console command to write |valid_word| with a value
	 * of 5. */
	char console_input[] = "rw 0x01234567 0x05";
	const uint32_t new_value = 0x05;

	snprintf(console_input, sizeof(console_input), "rw %p 0x%02x",
		 &valid_word, new_value);

	is_locked = 0;
	rv = shell_execute_cmd(shell_backend_dummy_get_ptr(), console_input);
	zassert_equal(rv, EC_SUCCESS);
	zassert_equal(new_value, valid_word);

	is_locked = 1;
	/* Reset valid word */
	valid_word = old_value;
	rv = shell_execute_cmd(shell_backend_dummy_get_ptr(), console_input);
	zassert_equal(rv, EC_ERROR_ACCESS_DENIED);
	zassert_equal(old_value, valid_word);
}
```

## src/test_pw_log_tokenized.cc
```c
/* Copyright 2026 The ChromiumOS Authors
 * Use of this source code is governed by a BSD-style license that can be
 * found in the LICENSE file.
 */

#include "console.h"

#include <zephyr/fatal.h>
#include <zephyr/kernel.h>
#include <zephyr/ztest.h>
#include <zephyr/ztest_error_hook.h>

#include <pw_log/levels.h>
#include <pw_log_tokenized/metadata.h>

#ifdef CONFIG_PLATFORM_EC_HOSTCMD_CONSOLE_DROPPED_LOGS
extern "C" int format_dropped_logs_msg(char *dest, size_t dest_size,
				       uint32_t drops_isr, uint32_t drops_mutex,
				       uint32_t drops_overflow);
#endif
extern "C" void pw_log_tokenized_HandleLog(uint32_t metadata,
					   const uint8_t log_buffer[],
					   size_t size_bytes);

#define THREAD_STACK_SIZE 2048
static K_THREAD_STACK_DEFINE(fatal_thread_stack, THREAD_STACK_SIZE);
static struct k_thread fatal_thread_data;

static volatile bool fatal_hook_called;
static volatile unsigned int fatal_reason;

void ztest_post_fatal_error_hook(unsigned int reason,
				 const struct arch_esf *esf)
{
	ARG_UNUSED(esf);
	fatal_hook_called = true;
	fatal_reason = reason;
}

static void test_before(void *fixture)
{
	ARG_UNUSED(fixture);
	fatal_hook_called = false;
	fatal_reason = 0;
	console_channel_enable("system");
}

ZTEST_SUITE(pw_log_tokenized, NULL, NULL, test_before, NULL, NULL);

#ifdef CONFIG_PLATFORM_EC_HOSTCMD_CONSOLE_DROPPED_LOGS
ZTEST(pw_log_tokenized, test_format_dropped_logs_msg)
{
	char buf[128];
	int len = format_dropped_logs_msg(buf, sizeof(buf), 1, 2, 3);

	zassert_true(len > 0);
	zassert_equal(buf[0], '$');
}
#endif

ZTEST(pw_log_tokenized, test_handle_log_normal)
{
	uint32_t metadata =
		pw::log_tokenized::Metadata::Set<PW_LOG_LEVEL_INFO, 0, 0, 0>()
			.value();
	const uint8_t test_token[4] = { 0x12, 0x34, 0x56, 0x78 };

	pw_log_tokenized_HandleLog(metadata, test_token, sizeof(test_token));
	zassert_false(fatal_hook_called);
}

struct fatal_thread_args {
	uint32_t metadata;
	const uint8_t *token;
	size_t size;
};

static void fatal_thread_entry(void *p1, void *p2, void *p3)
{
	ARG_UNUSED(p2);
	ARG_UNUSED(p3);
	auto *args = static_cast<struct fatal_thread_args *>(p1);

	ztest_set_fault_valid(true);
	pw_log_tokenized_HandleLog(args->metadata, args->token, args->size);
	/* Should never be reached if pw_log_tokenized_HandleLog panicked */
	ztest_test_fail();
}

static void run_fatal_log_test(uint32_t metadata, const uint8_t *token,
			       size_t size)
{
	fatal_hook_called = false;
	struct fatal_thread_args args = {
		.metadata = metadata,
		.token = token,
		.size = size,
	};

	k_tid_t tid = k_thread_create(&fatal_thread_data, fatal_thread_stack,
				      THREAD_STACK_SIZE, fatal_thread_entry,
				      &args, NULL, NULL, K_PRIO_PREEMPT(5), 0,
				      K_NO_WAIT);

	k_thread_join(tid, K_FOREVER);
	zassert_true(fatal_hook_called, "Fatal error hook was not called");
	zassert_equal(fatal_reason, K_ERR_KERNEL_PANIC);
}

ZTEST(pw_log_tokenized, test_handle_log_fatal)
{
	uint32_t metadata =
		pw::log_tokenized::Metadata::Set<PW_LOG_LEVEL_FATAL, 0, 0, 0>()
			.value();
	const uint8_t test_token[4] = { 0x12, 0x34, 0x56, 0x78 };

	run_fatal_log_test(metadata, test_token, sizeof(test_token));
}

ZTEST(pw_log_tokenized, test_handle_log_fatal_disabled_channel)
{
	/* Set channel to SYSTEM (1) offset by 1 -> flag 2 */
	uint32_t metadata =
		pw::log_tokenized::Metadata::Set<PW_LOG_LEVEL_FATAL, 0, 0,
						 CC_SYSTEM + 1>()
			.value();
	const uint8_t test_token[4] = { 0x12, 0x34, 0x56, 0x78 };

	console_channel_disable("system");
	run_fatal_log_test(metadata, test_token, sizeof(test_token));
}

ZTEST(pw_log_tokenized, test_handle_log_fatal_empty_payload)
{
	uint32_t metadata =
		pw::log_tokenized::Metadata::Set<PW_LOG_LEVEL_FATAL, 0, 0, 0>()
			.value();

	/* Empty buffer generates base64_string of size <= 1 */
	run_fatal_log_test(metadata, nullptr, 0);
}
```
