## CMakeLists.txt
```
# Copyright 2026 The ChromiumOS Authors
# Use of this source code is governed by a BSD-style license that can be
# found in the LICENSE file.

cmake_minimum_required(VERSION 3.13.1)
find_package(Zephyr REQUIRED HINTS "${ZEPHYR_BASE}")
project(adc_comparator)

target_sources(app PRIVATE src/main.c)
```

## prj.conf
```kconfig
# Copyright 2026 The ChromiumOS Authors
# Use of this source code is governed by a BSD-style license that can be
# found in the LICENSE file.

CONFIG_ZTEST=y
CONFIG_ADC=y
CONFIG_ADC_EMUL=y
CONFIG_COMPARATOR=y
CONFIG_CROS_ADC_COMPARATOR=y
```

## boards/native_sim.overlay
```dts
/* Copyright 2026 The ChromiumOS Authors
 * Use of this source code is governed by a BSD-style license that can be
 * found in the LICENSE file.
 */

#include <board-overlays/native_sim.dts>

/ {
	vph_pwr_comp: vph-pwr-comp {
		compatible = "cros-ec,adc-comparator";
		io-channels = <&adc0 0>;
		output-ohms = <470000>;
		full-ohms = <(100000 + 470000)>;
		threshold-mv = <2400>;
	};
};

&adc0 {
	ref-internal-mv = <3300>;
	#address-cells = <1>;
	#size-cells = <0>;

	channel@0 {
		reg = <0>;
		zephyr,gain = "ADC_GAIN_1";
		zephyr,reference = "ADC_REF_INTERNAL";
		zephyr,acquisition-time = <ADC_ACQ_TIME_DEFAULT>;
		zephyr,resolution = <10>;
	};
};
```

## src/main.c
```c
/* Copyright 2026 The ChromiumOS Authors
 * Use of this source code is governed by a BSD-style license that can be
 * found in the LICENSE file.
 */

#include <zephyr/device.h>
#include <zephyr/devicetree.h>
#include <zephyr/drivers/adc.h>
#include <zephyr/drivers/adc/adc_emul.h>
#include <zephyr/drivers/comparator.h>
#include <zephyr/ztest.h>

#define COMP_NODE DT_NODELABEL(vph_pwr_comp)

static const struct device *const comp_dev = DEVICE_DT_GET(COMP_NODE);
static const struct adc_dt_spec comp_adc = ADC_DT_SPEC_GET(COMP_NODE);

static int adc_error_func(const struct device *dev, unsigned int chan,
			  void *data, uint32_t *result)
{
	return -EIO;
}

ZTEST(adc_comparator, test_init)
{
	zassert_true(device_is_ready(comp_dev));
	zassert_true(adc_is_ready_dt(&comp_adc));
}

ZTEST(adc_comparator, test_get_output_above_threshold)
{
	/* 2500 mV at ADC pin scales to ~3031 mV > 2400 mV threshold */
	zassert_ok(adc_emul_const_value_set(comp_adc.dev, comp_adc.channel_id,
					    2500));
	zassert_equal(comparator_get_output(comp_dev), 1);
}

ZTEST(adc_comparator, test_get_output_below_threshold)
{
	/* 1500 mV at ADC pin scales to ~1819 mV <= 2400 mV threshold */
	zassert_ok(adc_emul_const_value_set(comp_adc.dev, comp_adc.channel_id,
					    1500));
	zassert_equal(comparator_get_output(comp_dev), 0);
}

ZTEST(adc_comparator, test_get_output_adc_error)
{
	zassert_ok(adc_emul_value_func_set(comp_adc.dev, comp_adc.channel_id,
					   adc_error_func, NULL));
	zassert_equal(comparator_get_output(comp_dev), -EIO);
}

ZTEST(adc_comparator, test_triggers_unsupported)
{
	zassert_ok(comparator_set_trigger(comp_dev, COMPARATOR_TRIGGER_NONE));
	zassert_equal(comparator_set_trigger(comp_dev,
					     COMPARATOR_TRIGGER_RISING_EDGE),
		      -ENOTSUP);
	zassert_equal(comparator_set_trigger_callback(comp_dev, NULL, NULL),
		      -ENOTSUP);
	zassert_equal(comparator_trigger_is_pending(comp_dev), 0);
}

ZTEST_SUITE(adc_comparator, NULL, NULL, NULL, NULL, NULL);
```
