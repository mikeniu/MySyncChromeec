/* Copyright 2026 The ChromiumOS Authors.
 * Use of this source code is governed by a BSD-style license that can be
 * found in the LICENSE file.
 */

/delete-node/ &otp;

/ {
	otp: otp {
		compatible = "zephyr,otp-emul";
		size = <0x800>;
		status = "okay";
	};
};
