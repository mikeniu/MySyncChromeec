## zephyr/test/dsp_comms/testcase.yaml
```yaml
tests:
  cros.dsp.level_trigger.buffered_i2c:
    harness: gtest
    extra_dtc_overlay_files:
      - boards/native_sim.overlay
      - boards/native_sim.buffered_i2c.overlay
    extra_args:
      - TEST_LIB=cros.dsp.test
    platform_allow:
      - native_sim
  cros.dsp.level_trigger.pio_i2c:
    harness: gtest
    extra_dtc_overlay_files:
      - boards/native_sim.overlay
    extra_args:
      - TEST_LIB=cros.dsp.test
    platform_allow:
      - native_sim
  cros.dsp.edge_trigger.buffered_i2c:
    harness: gtest
    extra_dtc_overlay_files:
      - boards/native_sim.overlay
      - boards/native_sim.buffered_i2c.overlay
      - boards/native_sim.edge_trigger.overlay
    extra_args:
      - TEST_LIB=cros.dsp.test
    platform_allow:
      - native_sim
  cros.dsp.edge_trigger.pio_i2c:
    harness: gtest
    extra_dtc_overlay_files:
      - boards/native_sim.overlay
      - boards/native_sim.edge_trigger.overlay
    extra_args:
      - TEST_LIB=cros.dsp.test
    platform_allow:
      - native_sim
  pw_fsm.state_machine:
    harness: gtest
    extra_args:
      - TEST_LIB=pw_fsm.fsm_test
    platform_allow:
      - native_sim
  pw_transport.service:
    harness: gtest
    extra_args:
      - TEST_LIB=pw_transport.service_test
      - PW_TRANSPORT_STATUS_FLAGS_SIZE=2
    platform_allow:
      - native_sim
  pw_host_command.service:
    harness: gtest
    extra_configs:
      - CONFIG_PLATFORM_EC_PW_HOST_COMMAND=y
    extra_args:
      - TEST_LIB=pw_host_command.service_test
    platform_allow:
      - native_sim
```

## zephyr/test/hooks/testcase.yaml
```yaml
common:
  platform_allow:
    - native_sim
tests:
  hooks.default: {}
  hooks.dedicated_workqueue:
    extra_configs:
      - CONFIG_PLATFORM_EC_HOOK_DEDICATED_WORKQUEUE=y
```

## zephyr/test/intelrvp/Kconfig
```kconfig
# Copyright 2024 The ChromiumOS Authors
# Use of this source code is governed by a BSD-style license that can be
# found in the LICENSE file.

choice TEST_PROJECT_TYPE
	prompt "Select Intel RVP board variant for tests"
	default TEST_PROJECT_OCELOTRVP if BOARD_OCELOTRVP_ITE || BOARD_OCELOTRVP_NPCX
	help
	  Choose the board variant for which the tests will be compiled and run.

config TEST_PROJECT_MTLRVPP_COMMON
	bool "Enable tests for board mtlrvp common source code"
	help
	  Enable tests specific to the mtlrvp common source code.

config TEST_PROJECT_MTLRVPP_NPCX
	bool "Enable tests for board mtlrvp_npcx"
	help
	  Enable tests specific to the mtlrvp_npcx variant.

config TEST_PROJECT_MTLRVPP_MCHP
	bool "Enable tests for board mtlrvp_mchp"
	help
	  Enable tests specific to the mtlrvp_mchp variant.

config TEST_PROJECT_PTLRVP_MCHP
	bool "Enable ptlrvp_mchp-specific tests"
	help
	  Enable tests specific to the ptlrvp_mchp variant.

config TEST_PROJECT_OCELOTRVP
	bool "Enable ocelotrvp-specific tests"
	help
	  Enable tests specific to the ocelotrvp variants.

endchoice

config TEST_PROJECT_MTL_BOARD_POWER
	bool "Run tests for board_power.c"
	select AP_POWER_EVENTS_MOCK if TEST_PROJECT_OCELOTRVP
	select POWER_SIGNALS_MOCK if TEST_PROJECT_OCELOTRVP
	select CHIPSET_API_MOCK if TEST_PROJECT_OCELOTRVP
	help
	  Include board_power.c into the binary and test its functions.

config TEST_AP_PWRSEQ_PP5500
        bool "Enable PP5500 rail tests"
        default n
        help
          Enable PP5500 rail tests for board power.

config TEST_AP_PWRSEQ_DEASSERT_PWROK
	bool "Expect PCH_PWROK and SYS_PWROK deassertion on force shutdown"
	default y if TEST_PROJECT_OCELOTRVP
	help
	  Expect board_ap_power_shutdown to deassert PWR_PCH_PWROK and
	  PWR_EC_PCH_SYS_PWROK before RSMRST and PP3300_A.

config TEST_PROJECT_INTELRVP_TCPC
	bool "Run tests for tcpc.c"
	help
	  Include tcpc.c into the binary and test its functions.

config TEST_PROJECT_INTELRVP_CHG_USB_PD_MECC
	bool "Run tests for chg_usb_pd_mecc_1_1.c"
	help
	  Include chg_usb_pd_mecc_1_1.c into the binary and test its functions.

config TEST_PROJECT_INTELRVP_DC_JACK
	bool "Run tests for dc_jack.c"
	default y if TEST_PROJECT_OCELOTRVP && PLATFORM_EC_DEDICATED_CHARGE_PORT && !TEST_PROJECT_MTL_BOARD_POWER
	help
	  Include dc_jack.c into the binary and test its functions.

config TEST_PROJECT_INTELRVP_BOARD_ID
	bool "Run INTELRVP board id test"
	default y if TEST_PROJECT_OCELOTRVP && PLATFORM_EC_CBI && !TEST_PROJECT_MTL_BOARD_POWER
	help
	  Run board ID test for INTELRVP.

config TEST_PROJECT_INTELRVP_BOARD_ID_VAL
	int "Value to be used for board ID test"
	depends on TEST_PROJECT_INTELRVP_BOARD_ID
	default 1051 if TEST_PROJECT_MTLRVPP_COMMON
	default 1078 if TEST_PROJECT_PTLRVP_MCHP
	default 33 if TEST_PROJECT_OCELOTRVP
	help
	  Value to be used for board ID test.

config TEST_PROJECT_PTL_BOARD_POWER
	bool "Run tests for board_power.c"
	depends on TEST_PROJECT_PTLRVP_MCHP
	help
	  Include board_power.c into the binary and test its functions.

config TEST_PROJECT_PTL_PDC_RUNTIME_PORT_CFG
	bool "Run tests pdc runtime port config"
	depends on TEST_PROJECT_PTLRVP_MCHP || TEST_PROJECT_OCELOTRVP
	default y if TEST_PROJECT_OCELOTRVP && PDC_RUNTIME_PORT_CONFIG && !TEST_PROJECT_MTL_BOARD_POWER
	help
	  Include usbc_runtime.c into the binary and test its functions.

rsource "../../program/ocelot/Kconfig"
```

## zephyr/test/ocelot/Kconfig
```kconfig
# Copyright 2026 The ChromiumOS Authors
# Use of this source code is governed by a BSD-style license that can be
# found in the LICENSE file.

choice TEST_PROJECT_TYPE
	prompt "Select Ocelot board variant for tests"
	help
	  Choose the board variant for which the tests will be compiled and run.

config TEST_PROJECT_OCELOTRVP_NPCX
	bool "Enable tests for board ocelotrvp_npcx"
	help
	  Enable tests specific to the ocelotrvp_npcx variant.

endchoice

config TEST_PROJECT_OCELOT_BOARD_POWER
	bool "Run tests for rvp_board_power.c"
	help
	  Include rvp_board_power.c into the binary and test its functions.

source "Kconfig.zephyr"
```

## zephyr/test/ocelot/testcase.yaml
```yaml
# Copyright 2026 The ChromiumOS Authors
# Use of this source code is governed by a BSD-style license that can be
# found in the LICENSE file.

common:
  platform_allow:
    - native_sim
tests:
  ocelot.ocelotrvp_npcx.board_power:
    extra_dtc_overlay_files:
      - boards/ocelot.dtsi
      - boards/ocelotrvp_npcx/ocelotrvp_npcx.dtsi
    extra_conf_files:
      - boards/ocelotrvp_npcx/ocelotrvp_npcx.conf
    extra_configs:
      - CONFIG_TEST_PROJECT_OCELOTRVP_NPCX=y
      - CONFIG_TEST_PROJECT_OCELOT_BOARD_POWER=y
      - CONFIG_AP_POWER_EVENTS_MOCK=y
      - CONFIG_POWER_SIGNALS_MOCK=y
      - CONFIG_CHIPSET_API_MOCK=y
      - CONFIG_AP_EVENTS=n
```

## zephyr/test/usb_typec_drp_acc_trysrc/testcase.yaml
```yaml
# Copyright 2026 The ChromiumOS Authors
# Use of this source code is governed by a BSD-style license that can be
# found in the LICENSE file.

tests:
  usb_typec_drp_acc_trysrc.default:
    platform_allow:
      - native_sim
      - native_sim/native
    harness: ztest
    harness_config:
      type: one_line
      regex:
        - "PASS - usb_typec_drp_acc_trysrc.test_dbg_acc_dts_supported"
        - "PASS - usb_typec_drp_acc_trysrc.test_dbg_acc_no_dts_force_sink"
        - "PASS - usb_typec_drp_acc_trysrc.test_dbg_acc_no_dts_remain_wait"
        - "PASS - usb_typec_drp_acc_trysrc.test_ufp_attached"
```
