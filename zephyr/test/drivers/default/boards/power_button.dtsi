/* Copyright 2023 The ChromiumOS Authors
 * Use of this source code is governed by a BSD-style license that can be
 * found in the LICENSE file.
 */
#include <zephyr/dt-bindings/input/input-event-codes.h>

/ {
	cros_buttons: gpio-keys {
		compatible = "gpio-keys";
		debounce-interval-ms = <30>;
		power_button: power_button {
			gpios = <&gpio0 25 (GPIO_ACTIVE_LOW | GPIO_PULL_UP)>;
			zephyr,code = <INPUT_KEY_POWER>;
		};
	};

};
