/* Auto-generated by generate_ufsc.py */

&ufsc_keyboard_layout {
	ufsc_keyboard_layout_proto: keyboard-layout-proto {
		compatible = "cros-ec,cbi-ufsc-value";
		status = "okay";
		value = <0>;
	};
	ufsc_keyboard_layout_default: keyboard-layout-default {
		compatible = "cros-ec,cbi-ufsc-value";
		status = "okay";
		value = <1>;
	};
};
