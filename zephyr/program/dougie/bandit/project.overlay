/* Copyright 2026 The ChromiumOS Authors
 * Use of this source code is governed by a BSD-style license that can be
 * found in the LICENSE file.
 */

#include "binman.dtsi"

/* Dougie program common DTS includes */
#include "../generated.dtsi"
#include "../dougie.dtsi"
#include "../usbc.dtsi"
#include "../interrupts.dtsi"
#include "../i2c.dtsi"

/* Bandit project DTS includes*/

/* Bandit overrides follow... */

/ {
	batteries {
		default_battery: wf36_0821br {
			compatible = "todo,wf36-0821br", "battery-smart";
		};
	};
};
