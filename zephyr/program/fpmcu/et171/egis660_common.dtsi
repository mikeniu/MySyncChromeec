/* Copyright 2026 The ChromiumOS Authors.
 * Use of this source code is governed by a BSD-style license that can be
 * found in the LICENSE file.
 */

/* Common DTSI for ET171 projects using EGIS660 sensor.
 * Contains partitions specific to EGIS660 (e.g. apns_data).
 */

&p25q16 {
	partitions {
		egis660_apns_data: partition@100000 {
			label = "egis660_apns_data";
			reg = <0x100000 DT_SIZE_K(52)>;
		};
	};
};
