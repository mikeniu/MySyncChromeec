/* Copyright 2026 The ChromiumOS Authors
 * Use of this source code is governed by a BSD-style license that can be
 * found in the LICENSE file.
 */

#include <usbc-policy.dtsi>

 /{
	usbc {
		#address-cells = <1>;
		#size-cells = <0>;
		ppm-driver {
			compatible = "ucsi-ppm";
			b-num-alt-modes = <2>;
		};
	};
};
