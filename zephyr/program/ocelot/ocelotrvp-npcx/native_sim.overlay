/* Copyright 2026 The ChromiumOS Authors
 * Use of this source code is governed by a BSD-style license that can be
 * found in the LICENSE file.
 */

#include <board-overlays/npcx_native_sim.dts>

#include "board.dtsi"
#include "../rvp_native_sim.dtsi"

&gpio_mech_pwr_btn_odl {
	gpios = <&gpio0 0 (GPIO_INPUT | GPIO_PULL_UP)>;
};

&gpio_lid_open {
	gpios = <&gpio0 1 (GPIO_INPUT | GPIO_PULL_UP)>;
};
