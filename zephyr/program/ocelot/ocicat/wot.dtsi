/ {
        wot {
                compatible = "cros-ec,wot";

                report-en-gpios = <&gpioc 4 GPIO_ACTIVE_HIGH>;

                wot-l-gpios = <&gpioj 6 (GPIO_ACTIVE_LOW | GPIO_OPEN_DRAIN)>;

                bl-detect-gpios = <&gpiof 2 GPIO_ACTIVE_HIGH>;

                tchscr-int-gpios = <&gpiob 3 GPIO_ACTIVE_LOW>;
        };
};