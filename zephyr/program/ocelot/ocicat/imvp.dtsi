/* Copyright 2026 The ChromiumOS Authors
 * Use of this source code is governed by a BSD-style license that can be
 * found in the LICENSE file.
 */

#include <dt-bindings/imvp/rtq3700fh.h>

&imvp_rtq3700fh {
	update-data = <
		RTQ_WRITE_BYTE(0x50, 0x01, 0x10)
		RTQ_WRITE_BYTE(0x50, 0x02, 0x30)
		RTQ_WRITE_BYTE(0x50, 0x03, 0x21)
		RTQ_WRITE_BYTE(0x50, 0x04, 0x00)
		RTQ_WRITE_BYTE(0x50, 0x05, 0x71)
		RTQ_WRITE_BYTE(0x50, 0x06, 0x72)
		RTQ_WRITE_BYTE(0x50, 0x07, 0x70)
		RTQ_WRITE_BYTE(0x50, 0x08, 0x70)
		RTQ_WRITE_BYTE(0x50, 0x09, 0x71)
		RTQ_WRITE_BYTE(0x50, 0x0A, 0x10)
		RTQ_WRITE_BYTE(0x50, 0x0B, 0x20)
		RTQ_WRITE_BYTE(0x50, 0x0C, 0x30)
		RTQ_WRITE_BYTE(0x50, 0x0D, 0x70)
		RTQ_WRITE_BYTE(0x50, 0x0E, 0x70)
		RTQ_WRITE_BYTE(0x50, 0x0F, 0x70)
		RTQ_WRITE_BYTE(0x50, 0x10, 0x00)
		RTQ_WRITE_BYTE(0x50, 0x11, 0x0F)
		RTQ_WRITE_BYTE(0x50, 0x12, 0x00)
		RTQ_WRITE_BYTE(0x50, 0x13, 0x12)
		RTQ_WRITE_BYTE(0x50, 0x14, 0x03)
		RTQ_WRITE_BYTE(0x50, 0x18, 0x14)
		RTQ_WRITE_BYTE(0x50, 0x19, 0x24)
		RTQ_WRITE_BYTE(0x50, 0x1A, 0x00)
		RTQ_WRITE_BYTE(0x50, 0x1B, 0x01)
		RTQ_WRITE_WORD(0x50, 0x1C, 0x00, 0x00)
		RTQ_WRITE_WORD(0x50, 0x1D, 0x00, 0x00)
		RTQ_WRITE_BYTE(0x50, 0x1E, 0x2D)
		RTQ_WRITE_BYTE(0x50, 0x1F, 0x00)
		RTQ_WRITE_BYTE(0x50, 0x22, 0x01)
		RTQ_WRITE_WORD(0x50, 0x23, 0x80, 0x00)
		RTQ_WRITE_BYTE(0x50, 0x24, 0x00)
		RTQ_WRITE_BYTE(0x50, 0x26, 0x00)
		RTQ_WRITE_BYTE(0x50, 0x27, 0x00)
		RTQ_WRITE_BYTE(0x50, 0x28, 0x00)
		RTQ_WRITE_BYTE(0x50, 0x29, 0x00)
		RTQ_WRITE_BYTE(0x50, 0x2A, 0x00)
		RTQ_WRITE_BYTE(0x50, 0x2B, 0x01)
		RTQ_WRITE_BYTE(0x50, 0x2C, 0x02)
		RTQ_WRITE_BYTE(0x50, 0x2D, 0x01)
		RTQ_WRITE_WORD(0x50, 0x2E, 0x54, 0x24)
		RTQ_WRITE_BYTE(0x50, 0x2F, 0x33)
		RTQ_WRITE_BYTE(0x50, 0x30, 0x01)
		RTQ_WRITE_BYTE(0x50, 0x31, 0x00)
		RTQ_WRITE_BYTE(0x50, 0x32, 0x00)
		RTQ_WRITE_BLOCK(0x51, 0x01, 0x05, 0x04 0x08 0x2F 0x01 0x00)
		RTQ_WRITE_WORD(0x51, 0x02, 0x08, 0x02)
		RTQ_WRITE_BYTE(0x51, 0x03, 0x34)
		RTQ_WRITE_WORD(0x51, 0x04, 0x16, 0x0D)
		RTQ_WRITE_WORD(0x51, 0x05, 0x12, 0x0E)
		RTQ_WRITE_BYTE(0x51, 0x06, 0x85)
		RTQ_WRITE_BYTE(0x51, 0x07, 0x24)
		RTQ_WRITE_BYTE(0x51, 0x08, 0x14)
		RTQ_WRITE_BYTE(0x51, 0x09, 0x14)
		RTQ_WRITE_BYTE(0x51, 0x0A, 0x20)
		RTQ_WRITE_BYTE(0x51, 0x0B, 0x20)
		RTQ_WRITE_BYTE(0x51, 0x0C, 0x20)
		RTQ_WRITE_BYTE(0x51, 0x0D, 0x20)
		RTQ_WRITE_BYTE(0x51, 0x0E, 0x20)
		RTQ_WRITE_BYTE(0x51, 0x0F, 0x20)
		RTQ_WRITE_BYTE(0x51, 0x10, 0x20)
		RTQ_WRITE_BYTE(0x51, 0x11, 0x20)
		RTQ_WRITE_BYTE(0x51, 0x12, 0x20)
		RTQ_WRITE_BYTE(0x51, 0x13, 0x20)
		RTQ_WRITE_BYTE(0x51, 0x14, 0x20)
		RTQ_WRITE_BYTE(0x51, 0x15, 0x20)
		RTQ_WRITE_BYTE(0x51, 0x16, 0x20)
		RTQ_WRITE_BYTE(0x51, 0x17, 0x20)
		RTQ_WRITE_BYTE(0x51, 0x19, 0x14)
		RTQ_WRITE_BYTE(0x51, 0x1A, 0x14)
		RTQ_WRITE_BYTE(0x51, 0x1B, 0x14)
		RTQ_WRITE_BYTE(0x51, 0x1C, 0x20)
		RTQ_WRITE_BYTE(0x51, 0x1E, 0x03)
		RTQ_WRITE_BYTE(0x51, 0x1F, 0x01)
		RTQ_WRITE_BYTE(0x51, 0x21, 0x00)
		RTQ_WRITE_BYTE(0x51, 0x22, 0x00)
		RTQ_WRITE_BYTE(0x51, 0x23, 0x00)
		RTQ_WRITE_BYTE(0x51, 0x24, 0x00)
		RTQ_WRITE_BYTE(0x51, 0x25, 0x00)
		RTQ_WRITE_BYTE(0x51, 0x26, 0x00)
		RTQ_WRITE_BYTE(0x51, 0x27, 0x01)
		RTQ_WRITE_BYTE(0x51, 0x28, 0x01)
		RTQ_WRITE_BYTE(0x51, 0x29, 0x01)
		RTQ_WRITE_BYTE(0x51, 0x2A, 0x01)
		RTQ_WRITE_BYTE(0x51, 0x2B, 0x01)
		RTQ_WRITE_BYTE(0x51, 0x2C, 0x01)
		RTQ_WRITE_BYTE(0x51, 0x2F, 0x01)
		RTQ_WRITE_BYTE(0x51, 0x30, 0x09)
		RTQ_WRITE_BYTE(0x51, 0x31, 0x03)
		RTQ_WRITE_BYTE(0x51, 0x32, 0x03)
		RTQ_WRITE_BLOCK(0x51, 0x33, 0x06, 0x05 0x08 0x21 0x84 0x10 0x42)
		RTQ_WRITE_BLOCK(0x51, 0x34, 0x06, 0x05 0x08 0x21 0x84 0x10 0x42)
		RTQ_WRITE_BLOCK(0x51, 0x35, 0x06, 0x05 0x18 0x8F 0xF7 0x14 0x42)
		RTQ_WRITE_BLOCK(0x51, 0x36, 0x06, 0x05 0x18 0x63 0x8C 0x31 0xC6)
		RTQ_WRITE_BLOCK(0x51, 0x37, 0x06, 0x05 0x00 0x63 0x8C 0x31 0xC6)
		RTQ_WRITE_BYTE(0x51, 0x38, 0x18)
		RTQ_WRITE_BYTE(0x51, 0x39, 0x18)
		RTQ_WRITE_BYTE(0x51, 0x3A, 0x18)
		RTQ_WRITE_BYTE(0x51, 0x3B, 0x18)
		RTQ_WRITE_BYTE(0x51, 0x3C, 0x00)
		RTQ_WRITE_BYTE(0x51, 0x3D, 0x00)
		RTQ_WRITE_BYTE(0x51, 0x3E, 0x00)
		RTQ_WRITE_BYTE(0x51, 0x3F, 0x00)
		RTQ_WRITE_BYTE(0x51, 0x40, 0x00)
		RTQ_WRITE_BYTE(0x51, 0x41, 0x00)
		RTQ_WRITE_BYTE(0x51, 0x42, 0x00)
		RTQ_WRITE_BYTE(0x51, 0x43, 0x00)
		RTQ_WRITE_BYTE(0x51, 0x44, 0x00)
		RTQ_WRITE_BYTE(0x51, 0x45, 0x00)
		RTQ_WRITE_BYTE(0x51, 0x46, 0x00)
		RTQ_WRITE_BYTE(0x51, 0x47, 0x00)
		RTQ_WRITE_BYTE(0x51, 0x48, 0x00)
		RTQ_WRITE_BYTE(0x51, 0x49, 0x00)
		RTQ_WRITE_BYTE(0x51, 0x4A, 0x00)
		RTQ_WRITE_BYTE(0x51, 0x4B, 0x00)
		RTQ_WRITE_BYTE(0x51, 0x4C, 0x00)
		RTQ_WRITE_BYTE(0x51, 0x4D, 0x00)
		RTQ_WRITE_BYTE(0x51, 0x4E, 0x00)
		RTQ_WRITE_BYTE(0x51, 0x4F, 0x00)
		RTQ_WRITE_BYTE(0x51, 0x50, 0x00)
		RTQ_WRITE_BYTE(0x51, 0x51, 0x00)
		RTQ_WRITE_BYTE(0x51, 0x52, 0x00)
		RTQ_WRITE_BYTE(0x51, 0x53, 0x00)
		RTQ_WRITE_BYTE(0x51, 0x54, 0x00)
		RTQ_WRITE_BYTE(0x51, 0x55, 0x00)
		RTQ_WRITE_BYTE(0x51, 0x56, 0x00)
		RTQ_WRITE_BYTE(0x51, 0x57, 0x00)
		RTQ_WRITE_BYTE(0x51, 0x58, 0x00)
		RTQ_WRITE_BYTE(0x51, 0x59, 0x00)
		RTQ_WRITE_BYTE(0x51, 0x5A, 0x00)
		RTQ_WRITE_BYTE(0x51, 0x5B, 0x00)
		RTQ_WRITE_BYTE(0x51, 0x5C, 0x00)
		RTQ_WRITE_BYTE(0x51, 0x5D, 0x00)
		RTQ_WRITE_BYTE(0x51, 0x5E, 0x00)
		RTQ_WRITE_BYTE(0x51, 0x5F, 0x00)
		RTQ_WRITE_BYTE(0x51, 0x60, 0x00)
		RTQ_WRITE_BYTE(0x51, 0x61, 0x00)
		RTQ_WRITE_BYTE(0x51, 0x62, 0x00)
		RTQ_WRITE_BYTE(0x51, 0x63, 0x00)
		RTQ_WRITE_BYTE(0x51, 0x64, 0x00)
		RTQ_WRITE_BYTE(0x51, 0x65, 0x00)
		RTQ_WRITE_BYTE(0x51, 0x66, 0x00)
		RTQ_WRITE_BYTE(0x51, 0x67, 0x00)
		RTQ_WRITE_WORD(0x51, 0x68, 0x50, 0x10)
		RTQ_WRITE_BYTE(0x51, 0x69, 0x1F)
		RTQ_WRITE_BYTE(0x51, 0x6A, 0x1F)
		RTQ_WRITE_BYTE(0x51, 0x6B, 0x1F)
		RTQ_WRITE_BYTE(0x51, 0x6C, 0x04)
		RTQ_WRITE_BYTE(0x51, 0x6D, 0x10)
		RTQ_WRITE_BYTE(0x51, 0x6E, 0x98)
		RTQ_WRITE_BYTE(0x51, 0x6F, 0x18)
		RTQ_WRITE_WORD(0x51, 0x70, 0x80, 0x01)
		RTQ_WRITE_WORD(0x51, 0x71, 0x20, 0x00)
		RTQ_WRITE_BYTE(0x51, 0x72, 0x1F)
		RTQ_WRITE_BYTE(0x51, 0x73, 0x0F)
		RTQ_WRITE_BYTE(0x51, 0x74, 0x07)
		RTQ_WRITE_BYTE(0x51, 0x75, 0x1E)
		RTQ_WRITE_BYTE(0x51, 0x76, 0x0E)
		RTQ_WRITE_BYTE(0x51, 0x77, 0x06)
		RTQ_WRITE_BYTE(0x51, 0x78, 0x20)
		RTQ_WRITE_BYTE(0x51, 0x79, 0x10)
		RTQ_WRITE_BYTE(0x51, 0x7A, 0x08)
		RTQ_WRITE_BYTE(0x51, 0x7B, 0x10)
		RTQ_WRITE_BYTE(0x51, 0x7C, 0x10)
		RTQ_WRITE_BYTE(0x51, 0x7D, 0x0F)
		RTQ_WRITE_BYTE(0x51, 0x7E, 0x1E)
		RTQ_WRITE_BYTE(0x51, 0x7F, 0x1E)
		RTQ_WRITE_BYTE(0x51, 0x80, 0x0E)
		RTQ_WRITE_BYTE(0x51, 0x81, 0x40)
		RTQ_WRITE_BYTE(0x51, 0x82, 0x10)
		RTQ_WRITE_BYTE(0x51, 0x83, 0x10)
		RTQ_WRITE_BYTE(0x51, 0x84, 0x23)
		RTQ_WRITE_BYTE(0x51, 0x85, 0x1F)
		RTQ_WRITE_BYTE(0x51, 0x86, 0x88)
		RTQ_WRITE_BYTE(0x51, 0x87, 0x07)
		RTQ_WRITE_BYTE(0x51, 0x88, 0x11)
		RTQ_WRITE_BYTE(0x51, 0x89, 0x0C)
		RTQ_WRITE_WORD(0x51, 0x8A, 0x72, 0xFC)
		RTQ_WRITE_BLOCK(0x51, 0x8B, 0x05, 0x04 0x00 0x00 0x07 0x00)
		RTQ_WRITE_BLOCK(0x51, 0x8C, 0x04, 0x03 0x1E 0x0F 0x00)
		RTQ_WRITE_BLOCK(0x51, 0x8D, 0x04, 0x03 0x00 0x00 0x00)
		RTQ_WRITE_BLOCK(0x51, 0x8E, 0x04, 0x03 0x00 0x00 0x00)
		RTQ_WRITE_BLOCK(0x51, 0x9A, 0x05, 0x04 0x00 0x00 0xFE 0x07)
		RTQ_WRITE_BLOCK(0x51, 0x9B, 0x05, 0x04 0x00 0x00 0x04 0x04)
		RTQ_WRITE_BYTE(0x51, 0x9C, 0x17)
		RTQ_WRITE_BYTE(0x51, 0x9D, 0x80)
		RTQ_WRITE_BYTE(0x51, 0x9E, 0xF8)
		RTQ_WRITE_BYTE(0x51, 0x9F, 0x80)
		RTQ_WRITE_BYTE(0x51, 0xA0, 0x2F)
		RTQ_WRITE_BYTE(0x51, 0xA1, 0x2F)
		RTQ_WRITE_BYTE(0x51, 0xA2, 0x2F)
		RTQ_WRITE_BYTE(0x51, 0xA3, 0x2F)
		RTQ_WRITE_BYTE(0x51, 0xA4, 0x55)
		RTQ_WRITE_BYTE(0x51, 0xA5, 0x11)
		RTQ_WRITE_BYTE(0x51, 0xA6, 0x11)
		RTQ_WRITE_BYTE(0x51, 0xA7, 0x1F)
		RTQ_WRITE_BYTE(0x51, 0xA8, 0x7D)
		RTQ_WRITE_BYTE(0x51, 0xA9, 0x1F)
		RTQ_WRITE_BYTE(0x51, 0xAA, 0x7D)
		RTQ_WRITE_BYTE(0x51, 0xAB, 0x1F)
		RTQ_WRITE_BYTE(0x51, 0xAC, 0x9A)
		RTQ_WRITE_BYTE(0x51, 0xAD, 0x1F)
		RTQ_WRITE_BYTE(0x51, 0xAE, 0x7D)
		RTQ_WRITE_BYTE(0x51, 0xAF, 0x1F)
		RTQ_WRITE_BYTE(0x51, 0xB0, 0x9A)
		RTQ_WRITE_BYTE(0x51, 0xB1, 0x1F)
		RTQ_WRITE_BYTE(0x51, 0xB2, 0x6E)
		RTQ_WRITE_BYTE(0x51, 0xB3, 0x6E)
		RTQ_WRITE_WORD(0x51, 0xB4, 0x84, 0x0E)
		RTQ_WRITE_BYTE(0x51, 0xB5, 0x55)
		RTQ_WRITE_BYTE(0x51, 0xB6, 0x55)
		RTQ_WRITE_BYTE(0x51, 0xB7, 0x55)
		RTQ_WRITE_BYTE(0x51, 0xB8, 0x55)
		RTQ_WRITE_BYTE(0x51, 0xB9, 0x55)
		RTQ_WRITE_BYTE(0x51, 0xBA, 0x55)
		RTQ_WRITE_BYTE(0x51, 0xBB, 0x22)
		RTQ_WRITE_BYTE(0x51, 0xBC, 0x0F)
		RTQ_WRITE_BYTE(0x51, 0xBD, 0x11)
		RTQ_WRITE_BYTE(0x51, 0xBE, 0x8A)
		RTQ_WRITE_BYTE(0x51, 0xBF, 0x1C)
		RTQ_WRITE_BYTE(0x51, 0xC0, 0x20)
		RTQ_WRITE_BYTE(0x51, 0xC1, 0x20)
		RTQ_WRITE_BYTE(0x51, 0xC2, 0x20)
		RTQ_WRITE_BYTE(0x51, 0xC3, 0x20)
		RTQ_WRITE_WORD(0x51, 0xC4, 0x29, 0x07)
		RTQ_WRITE_BYTE(0x51, 0xC5, 0x0F)
		RTQ_WRITE_BYTE(0x51, 0xC6, 0xEC)
		RTQ_WRITE_BYTE(0x51, 0xC7, 0x00)
		RTQ_WRITE_BYTE(0x51, 0xC8, 0x44)
		RTQ_WRITE_WORD(0x51, 0xCB, 0xDD, 0x01)
		RTQ_WRITE_BYTE(0x51, 0xCC, 0x40)
		RTQ_WRITE_BLOCK(0x51, 0xCD, 0x05, 0x04 0xC8 0x1D 0x00 0x01)
		RTQ_WRITE_BLOCK(0x51, 0xCE, 0x05, 0x04 0x0F 0x1A 0x00 0x00)
		RTQ_WRITE_BYTE(0x51, 0xCF, 0x00)
		RTQ_WRITE_WORD(0x51, 0xD0, 0x08, 0x00)
		RTQ_WRITE_BLOCK(0x51, 0xD1, 0x05, 0x04 0x00 0x00 0x00 0xB0)
		RTQ_WRITE_BYTE(0x51, 0xD2, 0xB4)
		RTQ_WRITE_BLOCK(0x51, 0xD3, 0x05, 0x04 0x0F 0x19 0x20 0x28)
		RTQ_WRITE_BLOCK(0x51, 0xD4, 0x05, 0x04 0x2F 0x36 0x3D 0x44)
		RTQ_WRITE_BLOCK(0x51, 0xD5, 0x05, 0x04 0x4B 0x52 0x59 0x00)
		RTQ_WRITE_BLOCK(0x51, 0xD6, 0x05, 0x04 0x10 0x1C 0x20 0x28)
		RTQ_WRITE_BLOCK(0x51, 0xD7, 0x05, 0x04 0x2F 0x36 0x3D 0x44)
		RTQ_WRITE_BLOCK(0x51, 0xD8, 0x05, 0x04 0x4B 0x52 0x59 0x00)
		RTQ_WRITE_BYTE(0x51, 0xD9, 0xC3)
		RTQ_WRITE_BYTE(0x51, 0xDA, 0x08)
		RTQ_WRITE_BYTE(0x51, 0xDB, 0x4B)
		RTQ_WRITE_BYTE(0x51, 0xDC, 0x03)
		RTQ_WRITE_BYTE(0x51, 0xDD, 0x06)
		RTQ_WRITE_WORD(0x51, 0xDE, 0x30, 0x02)
		RTQ_WRITE_WORD(0x51, 0xDF, 0x0E, 0x01)
		RTQ_WRITE_WORD(0x51, 0xE0, 0x32, 0x00)
		RTQ_WRITE_WORD(0x51, 0xE1, 0x29, 0x00)
		RTQ_WRITE_WORD(0x51, 0xE2, 0x0B, 0x00)
		RTQ_WRITE_WORD(0x51, 0xE3, 0x0B, 0x00)
		RTQ_WRITE_WORD(0x51, 0xE4, 0x06, 0x00)
		RTQ_WRITE_WORD(0x51, 0xE5, 0x06, 0x00)
		RTQ_WRITE_BYTE(0x51, 0xE6, 0x05)
		RTQ_WRITE_BYTE(0x51, 0xE7, 0x00)
		RTQ_WRITE_BYTE(0x51, 0xE8, 0x00)
		RTQ_WRITE_BYTE(0x51, 0xE9, 0x00)
		RTQ_WRITE_BYTE(0x52, 0x01, 0x00)
		RTQ_WRITE_BYTE(0x52, 0x02, 0x00)
		RTQ_WRITE_BLOCK(0x52, 0x03, 0x06, 0x05 0xA0 0x81 0x06 0x5A 0x08)
		RTQ_WRITE_BLOCK(0x52, 0x04, 0x06, 0x05 0xA0 0x81 0x06 0x1A 0x68)
		RTQ_WRITE_BLOCK(0x52, 0x05, 0x06, 0x05 0x16 0x68 0x00 0x1A 0x68)
		RTQ_WRITE_BLOCK(0x52, 0x06, 0x06, 0x05 0x1F 0x58 0xA0 0xC1 0x07)
		RTQ_WRITE_BYTE(0x52, 0x07, 0x00)
		RTQ_WRITE_BYTE(0x52, 0x08, 0x1A)
		RTQ_WRITE_BYTE(0x52, 0x09, 0x00)
		RTQ_WRITE_BYTE(0x52, 0x0A, 0x16)
		RTQ_WRITE_BYTE(0x52, 0x0B, 0x00)
		RTQ_WRITE_BYTE(0x52, 0x0C, 0x1F)
		RTQ_WRITE_BYTE(0x52, 0x0D, 0x00)
		RTQ_WRITE_BYTE(0x52, 0x0E, 0x00)
		RTQ_WRITE_BLOCK(0x52, 0x0F, 0x06, 0x05 0x16 0x58 0xA0 0x01 0x08)
		RTQ_WRITE_BLOCK(0x52, 0x10, 0x06, 0x05 0x1A 0x58 0x60 0x81 0x06)
		RTQ_WRITE_BYTE(0x52, 0x11, 0x00)
		RTQ_WRITE_BYTE(0x52, 0x12, 0x16)
		RTQ_WRITE_BYTE(0x52, 0x13, 0x00)
		RTQ_WRITE_BYTE(0x52, 0x14, 0x16)
		RTQ_WRITE_BYTE(0x52, 0x15, 0x00)
		RTQ_WRITE_BYTE(0x52, 0x16, 0x00)
		RTQ_WRITE_BLOCK(0x52, 0x17, 0x06, 0x05 0x05 0x14 0x50 0x00 0x80)
		RTQ_WRITE_BLOCK(0x52, 0x18, 0x06, 0x05 0x10 0x40 0x00 0x01 0x04)
		RTQ_WRITE_BYTE(0x52, 0x19, 0x00)
		RTQ_WRITE_BYTE(0x52, 0x1A, 0x10)
		RTQ_WRITE_BYTE(0x52, 0x1B, 0x00)
		RTQ_WRITE_BYTE(0x52, 0x1C, 0x10)
		RTQ_WRITE_BYTE(0x52, 0x1D, 0x00)
		RTQ_WRITE_BYTE(0x52, 0x1E, 0x00)
		RTQ_WRITE_BLOCK(0x52, 0x1F, 0x06, 0x05 0x65 0x94 0x51 0x06 0x80)
		RTQ_WRITE_BLOCK(0x52, 0x20, 0x06, 0x05 0x30 0xC1 0x04 0x13 0x4C)
		RTQ_WRITE_BYTE(0x52, 0x21, 0x09)
		RTQ_WRITE_BYTE(0x52, 0x22, 0x10)
		RTQ_WRITE_BYTE(0x52, 0x23, 0x09)
		RTQ_WRITE_BYTE(0x52, 0x24, 0x10)
		RTQ_WRITE_BYTE(0x52, 0x25, 0x00)
		RTQ_WRITE_WORD(0x52, 0x26, 0x46, 0x00)
		RTQ_WRITE_BYTE(0x52, 0x27, 0x54)
		RTQ_WRITE_BYTE(0x52, 0x28, 0x28)
		RTQ_WRITE_BYTE(0x52, 0x29, 0x05)
		RTQ_WRITE_BYTE(0x52, 0x2A, 0x02)
		RTQ_WRITE_BYTE(0x52, 0x2B, 0x30)
		RTQ_WRITE_BYTE(0x52, 0x2C, 0x08)
		RTQ_WRITE_WORD(0x52, 0x2D, 0x23, 0x00)
		RTQ_WRITE_BYTE(0x52, 0x2E, 0x82)
		RTQ_WRITE_WORD(0x52, 0x2F, 0x32, 0x00)
		RTQ_WRITE_BYTE(0x52, 0x30, 0xE9)
		RTQ_WRITE_BYTE(0x52, 0x31, 0x3F)
		RTQ_WRITE_BYTE(0x52, 0x32, 0x0D)
		RTQ_WRITE_BYTE(0x52, 0x33, 0x24)
		RTQ_WRITE_BYTE(0x52, 0x34, 0x2F)
		RTQ_WRITE_BYTE(0x52, 0x35, 0x11)
		RTQ_WRITE_BYTE(0x52, 0x36, 0x04)
		RTQ_WRITE_BYTE(0x52, 0x37, 0x01)
		RTQ_WRITE_WORD(0x52, 0x38, 0x0F, 0x00)
		RTQ_WRITE_WORD(0x52, 0x39, 0x20, 0x04)
		RTQ_WRITE_WORD(0x52, 0x3A, 0x01, 0x00)
		RTQ_WRITE_BYTE(0x52, 0x3B, 0x08)
		RTQ_WRITE_BYTE(0x52, 0x3C, 0x30)
		RTQ_WRITE_BYTE(0x52, 0x3D, 0x03)
		RTQ_WRITE_BYTE(0x52, 0x3E, 0x18)
		RTQ_WRITE_BYTE(0x52, 0x40, 0x03)
		RTQ_WRITE_BYTE(0x52, 0x41, 0x00)
		RTQ_WRITE_BYTE(0x52, 0x42, 0x00)
		RTQ_WRITE_BYTE(0x52, 0x43, 0x00)
		RTQ_WRITE_BYTE(0x52, 0x44, 0x51)
		RTQ_WRITE_BYTE(0x52, 0x45, 0xA8)
		RTQ_WRITE_BYTE(0x52, 0x46, 0x2F)
		RTQ_WRITE_BYTE(0x52, 0x47, 0x10)
		RTQ_WRITE_BYTE(0x52, 0x48, 0x36)
		RTQ_WRITE_BYTE(0x52, 0x49, 0x00)
		RTQ_WRITE_BYTE(0x52, 0x4A, 0x64)
		RTQ_WRITE_BYTE(0x52, 0x4B, 0x61)
		RTQ_WRITE_BYTE(0x52, 0x4C, 0x11)
		RTQ_WRITE_BYTE(0x52, 0x4D, 0x00)
		RTQ_WRITE_BYTE(0x52, 0x4E, 0x80)
		RTQ_WRITE_BYTE(0x52, 0x4F, 0x00)
		RTQ_WRITE_BYTE(0x52, 0x50, 0x1F)
		RTQ_WRITE_BYTE(0x52, 0x51, 0x00)
		RTQ_WRITE_BYTE(0x52, 0x52, 0x00)
		RTQ_WRITE_BYTE(0x52, 0x53, 0x12)
		RTQ_WRITE_BYTE(0x52, 0x54, 0x32)
		RTQ_WRITE_BYTE(0x52, 0x55, 0x24)
		RTQ_WRITE_BYTE(0x52, 0x56, 0x1F)
		RTQ_WRITE_WORD(0x52, 0x57, 0xA1, 0x00)
		RTQ_WRITE_BYTE(0x52, 0x58, 0x04)
		RTQ_WRITE_WORD(0x52, 0x59, 0x6F, 0x00)
		RTQ_WRITE_BYTE(0x52, 0x5A, 0x04)
		RTQ_WRITE_BYTE(0x52, 0x5B, 0x07)
		RTQ_WRITE_BYTE(0x52, 0x5C, 0x0A)
		RTQ_WRITE_BYTE(0x52, 0x5D, 0x00)
		RTQ_WRITE_BYTE(0x52, 0x5E, 0x00)
		RTQ_WRITE_BYTE(0x52, 0x5F, 0x00)
		RTQ_WRITE_BYTE(0x52, 0x60, 0x00)
		RTQ_WRITE_BYTE(0x52, 0x61, 0x8C)
		RTQ_WRITE_BYTE(0x52, 0x62, 0xA5)
		RTQ_WRITE_BYTE(0x52, 0x63, 0x66)
		RTQ_WRITE_BYTE(0x52, 0x64, 0x35)
		RTQ_WRITE_BYTE(0x52, 0x65, 0x60)
		RTQ_WRITE_BYTE(0x52, 0x66, 0x2F)
		RTQ_WRITE_BYTE(0x52, 0x67, 0x3F)
		RTQ_WRITE_BYTE(0x52, 0x68, 0x3F)
		RTQ_WRITE_BYTE(0x52, 0x69, 0xC0)
		RTQ_WRITE_BYTE(0x52, 0x6A, 0x08)
		RTQ_WRITE_BYTE(0x52, 0x6B, 0xC6)
		RTQ_WRITE_WORD(0x52, 0x6C, 0x7A, 0x7A)
		RTQ_WRITE_BYTE(0x52, 0x6E, 0x40)
		RTQ_WRITE_WORD(0x52, 0x6F, 0x01, 0x00)
		RTQ_WRITE_BYTE(0x52, 0x70, 0x1D)
		RTQ_WRITE_BYTE(0x52, 0x71, 0x23)
		RTQ_WRITE_BLOCK(0x52, 0x72, 0x05, 0x04 0x60 0xA4 0xA0 0x6C)
		RTQ_WRITE_BLOCK(0x52, 0x73, 0x05, 0x04 0x60 0xA4 0xD6 0xA5)
		RTQ_WRITE_BLOCK(0x52, 0x74, 0x05, 0x04 0x60 0xA4 0x60 0xA4)
		RTQ_WRITE_BLOCK(0x52, 0x75, 0x05, 0x04 0x45 0xA4 0x60 0xA4)
		RTQ_WRITE_BLOCK(0x52, 0x76, 0x05, 0x04 0x60 0x5D 0x45 0x5D)
		RTQ_WRITE_BLOCK(0x52, 0x77, 0x05, 0x04 0x60 0x5C 0x60 0x5C)
		RTQ_WRITE_BLOCK(0x52, 0x78, 0x05, 0x04 0x60 0x64 0x5C 0x6C)
		RTQ_WRITE_BLOCK(0x52, 0x79, 0x05, 0x04 0x60 0x64 0x60 0x64)
		RTQ_WRITE_BLOCK(0x52, 0x7A, 0x05, 0x04 0x60 0x64 0x60 0x64)
		RTQ_WRITE_BLOCK(0x52, 0x7B, 0x05, 0x04 0x60 0x64 0x60 0x64)
		RTQ_WRITE_BLOCK(0x52, 0x7C, 0x05, 0x04 0x60 0x64 0x60 0x64)
		RTQ_WRITE_BLOCK(0x52, 0x7D, 0x05, 0x04 0x60 0x64 0x60 0x64)
		RTQ_WRITE_WORD(0x52, 0x7E, 0x83, 0x01)
		RTQ_WRITE_BYTE(0x52, 0x7F, 0x52)
		RTQ_WRITE_BLOCK(0x52, 0x80, 0x05, 0x04 0x10 0x42 0x08 0x21)
		RTQ_WRITE_BLOCK(0x52, 0x81, 0x05, 0x04 0x08 0x21 0x84 0x00)
		RTQ_WRITE_BYTE(0x52, 0x82, 0x21)
		RTQ_WRITE_BLOCK(0x52, 0x85, 0x05, 0x04 0x18 0x00 0x01 0x00)
		RTQ_WRITE_BYTE(0x52, 0x86, 0x32)
		RTQ_WRITE_BYTE(0x52, 0x87, 0x49)
		RTQ_WRITE_BYTE(0x52, 0x88, 0x1F)
		RTQ_WRITE_BLOCK(0x52, 0x89, 0x05, 0x04 0x00 0x04 0xC0 0x7F)
		RTQ_WRITE_WORD(0x52, 0x8C, 0x21, 0x21)
		RTQ_WRITE_BYTE(0x52, 0x8D, 0x04)
		RTQ_WRITE_BYTE(0x52, 0x8E, 0x8C)
		RTQ_WRITE_BYTE(0x52, 0x8F, 0x01)
		RTQ_WRITE_WORD(0x52, 0x90, 0xC0, 0xC0)
		RTQ_WRITE_BYTE(0x52, 0x91, 0x00)
		RTQ_WRITE_BLOCK(0x52, 0x92, 0x0A, 0x09 0x00 0x00 0x00 0x00 0x00 0x00 0x00 0x00 0x00)
		RTQ_WRITE_BLOCK(0x52, 0x93, 0x0A, 0x09 0x00 0x00 0x00 0x00 0x00 0x00 0x00 0x00 0x00)
		RTQ_WRITE_BYTE(0x52, 0x94, 0x00)
		RTQ_WRITE_BYTE(0x52, 0x95, 0x00)
		RTQ_WRITE_BYTE(0x52, 0x96, 0x00)
		RTQ_WRITE_BLOCK(0x53, 0x01, 0x05, 0x04 0xB7 0x1D 0x01 0x00)
		RTQ_WRITE_WORD(0x53, 0x02, 0x64, 0x00)
		RTQ_WRITE_BYTE(0x53, 0x03, 0x00)
		RTQ_WRITE_WORD(0x53, 0x04, 0x13, 0x17)
		RTQ_WRITE_WORD(0x53, 0x05, 0x07, 0x0F)
		RTQ_WRITE_BYTE(0x53, 0x06, 0x82)
		RTQ_WRITE_BYTE(0x53, 0x07, 0x23)
		RTQ_WRITE_BYTE(0x53, 0x08, 0x1B)
		RTQ_WRITE_BYTE(0x53, 0x09, 0x1B)
		RTQ_WRITE_BYTE(0x53, 0x0A, 0x1B)
		RTQ_WRITE_BYTE(0x53, 0x0B, 0x1B)
		RTQ_WRITE_BYTE(0x53, 0x0C, 0x1B)
		RTQ_WRITE_BYTE(0x53, 0x0D, 0x1B)
		RTQ_WRITE_BYTE(0x53, 0x0E, 0x1B)
		RTQ_WRITE_BYTE(0x53, 0x0F, 0x1B)
		RTQ_WRITE_BYTE(0x53, 0x10, 0x1B)
		RTQ_WRITE_BYTE(0x53, 0x11, 0x1B)
		RTQ_WRITE_BYTE(0x53, 0x12, 0x1B)
		RTQ_WRITE_BYTE(0x53, 0x13, 0x1B)
		RTQ_WRITE_BYTE(0x53, 0x14, 0x1B)
		RTQ_WRITE_BYTE(0x53, 0x15, 0x1B)
		RTQ_WRITE_BYTE(0x53, 0x16, 0x1B)
		RTQ_WRITE_BYTE(0x53, 0x17, 0x1B)
		RTQ_WRITE_BYTE(0x53, 0x19, 0x1B)
		RTQ_WRITE_BYTE(0x53, 0x1A, 0x0D)
		RTQ_WRITE_BYTE(0x53, 0x1B, 0x0D)
		RTQ_WRITE_BYTE(0x53, 0x1C, 0x1B)
		RTQ_WRITE_BYTE(0x53, 0x1E, 0x17)
		RTQ_WRITE_BYTE(0x53, 0x1F, 0x17)
		RTQ_WRITE_BYTE(0x53, 0x21, 0x17)
		RTQ_WRITE_BYTE(0x53, 0x22, 0x17)
		RTQ_WRITE_BYTE(0x53, 0x23, 0x17)
		RTQ_WRITE_BYTE(0x53, 0x24, 0x17)
		RTQ_WRITE_BYTE(0x53, 0x25, 0x17)
		RTQ_WRITE_BYTE(0x53, 0x26, 0x17)
		RTQ_WRITE_BYTE(0x53, 0x27, 0x17)
		RTQ_WRITE_BYTE(0x53, 0x28, 0x17)
		RTQ_WRITE_BYTE(0x53, 0x29, 0x17)
		RTQ_WRITE_BYTE(0x53, 0x2A, 0x17)
		RTQ_WRITE_BYTE(0x53, 0x2B, 0x17)
		RTQ_WRITE_BYTE(0x53, 0x2C, 0x17)
		RTQ_WRITE_BYTE(0x53, 0x2F, 0x17)
		RTQ_WRITE_BYTE(0x53, 0x30, 0x16)
		RTQ_WRITE_BYTE(0x53, 0x31, 0x16)
		RTQ_WRITE_BYTE(0x53, 0x32, 0x17)
		RTQ_WRITE_BLOCK(0x53, 0x33, 0x06, 0x05 0x10 0x42 0x08 0x21 0x84)
		RTQ_WRITE_BLOCK(0x53, 0x34, 0x06, 0x05 0x10 0x42 0x08 0x21 0x84)
		RTQ_WRITE_BLOCK(0x53, 0x35, 0x06, 0x05 0x1B 0x20 0x84 0x10 0x84)
		RTQ_WRITE_BLOCK(0x53, 0x36, 0x06, 0x05 0x7B 0xEF 0xBD 0xF7 0xDE)
		RTQ_WRITE_BLOCK(0x53, 0x37, 0x06, 0x05 0x60 0xEF 0xBD 0xF7 0xDE)
		RTQ_WRITE_BYTE(0x53, 0x38, 0x1B)
		RTQ_WRITE_BYTE(0x53, 0x39, 0x1D)
		RTQ_WRITE_BYTE(0x53, 0x3A, 0x1D)
		RTQ_WRITE_BYTE(0x53, 0x3B, 0x1D)
		RTQ_WRITE_BYTE(0x53, 0x3C, 0x00)
		RTQ_WRITE_BYTE(0x53, 0x3D, 0x10)
		RTQ_WRITE_BYTE(0x53, 0x3E, 0x10)
		RTQ_WRITE_BYTE(0x53, 0x3F, 0x10)
		RTQ_WRITE_BYTE(0x53, 0x40, 0x10)
		RTQ_WRITE_BYTE(0x53, 0x41, 0x10)
		RTQ_WRITE_BYTE(0x53, 0x42, 0x10)
		RTQ_WRITE_BYTE(0x53, 0x43, 0x10)
		RTQ_WRITE_BYTE(0x53, 0x44, 0x10)
		RTQ_WRITE_BYTE(0x53, 0x45, 0x10)
		RTQ_WRITE_BYTE(0x53, 0x46, 0x10)
		RTQ_WRITE_BYTE(0x53, 0x47, 0x10)
		RTQ_WRITE_BYTE(0x53, 0x48, 0x10)
		RTQ_WRITE_BYTE(0x53, 0x49, 0x10)
		RTQ_WRITE_BYTE(0x53, 0x4A, 0x10)
		RTQ_WRITE_BYTE(0x53, 0x4B, 0x10)
		RTQ_WRITE_BYTE(0x53, 0x4C, 0x10)
		RTQ_WRITE_BYTE(0x53, 0x4D, 0x10)
		RTQ_WRITE_BYTE(0x53, 0x4E, 0x10)
		RTQ_WRITE_BYTE(0x53, 0x4F, 0x10)
		RTQ_WRITE_BYTE(0x53, 0x50, 0x10)
		RTQ_WRITE_BYTE(0x53, 0x51, 0x10)
		RTQ_WRITE_BYTE(0x53, 0x52, 0x11)
		RTQ_WRITE_BYTE(0x53, 0x53, 0x11)
		RTQ_WRITE_BYTE(0x53, 0x54, 0x11)
		RTQ_WRITE_BYTE(0x53, 0x55, 0x11)
		RTQ_WRITE_BYTE(0x53, 0x56, 0x11)
		RTQ_WRITE_BYTE(0x53, 0x57, 0x11)
		RTQ_WRITE_BYTE(0x53, 0x58, 0x11)
		RTQ_WRITE_BYTE(0x53, 0x59, 0x11)
		RTQ_WRITE_BYTE(0x53, 0x5A, 0x11)
		RTQ_WRITE_BYTE(0x53, 0x5B, 0x11)
		RTQ_WRITE_BYTE(0x53, 0x5C, 0x11)
		RTQ_WRITE_BYTE(0x53, 0x5D, 0x11)
		RTQ_WRITE_BYTE(0x53, 0x5E, 0x11)
		RTQ_WRITE_BYTE(0x53, 0x5F, 0x11)
		RTQ_WRITE_BYTE(0x53, 0x60, 0x11)
		RTQ_WRITE_BYTE(0x53, 0x61, 0x11)
		RTQ_WRITE_BYTE(0x53, 0x62, 0x11)
		RTQ_WRITE_BYTE(0x53, 0x63, 0x11)
		RTQ_WRITE_BYTE(0x53, 0x64, 0x11)
		RTQ_WRITE_BYTE(0x53, 0x65, 0x11)
		RTQ_WRITE_BYTE(0x53, 0x66, 0x11)
		RTQ_WRITE_BYTE(0x53, 0x67, 0x11)
		RTQ_WRITE_WORD(0x53, 0x68, 0x50, 0x10)
		RTQ_WRITE_BYTE(0x53, 0x69, 0x18)
		RTQ_WRITE_BYTE(0x53, 0x6A, 0x18)
		RTQ_WRITE_BYTE(0x53, 0x6B, 0x18)
		RTQ_WRITE_BYTE(0x53, 0x6C, 0x13)
		RTQ_WRITE_BYTE(0x53, 0x6D, 0x2D)
		RTQ_WRITE_BYTE(0x53, 0x6E, 0x14)
		RTQ_WRITE_BYTE(0x53, 0x6F, 0x14)
		RTQ_WRITE_WORD(0x53, 0x70, 0x80, 0x01)
		RTQ_WRITE_WORD(0x53, 0x71, 0x20, 0x00)
		RTQ_WRITE_BYTE(0x53, 0x72, 0x7F)
		RTQ_WRITE_BYTE(0x53, 0x73, 0x1E)
		RTQ_WRITE_BYTE(0x53, 0x74, 0x0E)
		RTQ_WRITE_BYTE(0x53, 0x75, 0x7F)
		RTQ_WRITE_BYTE(0x53, 0x76, 0x1C)
		RTQ_WRITE_BYTE(0x53, 0x77, 0x0C)
		RTQ_WRITE_BYTE(0x53, 0x78, 0x7F)
		RTQ_WRITE_BYTE(0x53, 0x79, 0x20)
		RTQ_WRITE_BYTE(0x53, 0x7A, 0x10)
		RTQ_WRITE_BYTE(0x53, 0x7B, 0x29)
		RTQ_WRITE_BYTE(0x53, 0x7C, 0x1F)
		RTQ_WRITE_BYTE(0x53, 0x7D, 0x15)
		RTQ_WRITE_BYTE(0x53, 0x7E, 0x2D)
		RTQ_WRITE_BYTE(0x53, 0x7F, 0x23)
		RTQ_WRITE_BYTE(0x53, 0x80, 0x19)
		RTQ_WRITE_BYTE(0x53, 0x81, 0x28)
		RTQ_WRITE_BYTE(0x53, 0x82, 0x28)
		RTQ_WRITE_BYTE(0x53, 0x83, 0x28)
		RTQ_WRITE_BYTE(0x53, 0x84, 0x18)
		RTQ_WRITE_BYTE(0x53, 0x85, 0x2C)
		RTQ_WRITE_BYTE(0x53, 0x86, 0x88)
		RTQ_WRITE_BYTE(0x53, 0x87, 0x02)
		RTQ_WRITE_BYTE(0x53, 0x88, 0x0F)
		RTQ_WRITE_BYTE(0x53, 0x89, 0x8F)
		RTQ_WRITE_WORD(0x53, 0x8A, 0xDB, 0xFB)
		RTQ_WRITE_BLOCK(0x53, 0x8B, 0x05, 0x04 0x00 0x00 0x07 0x00)
		RTQ_WRITE_BLOCK(0x53, 0x8C, 0x04, 0x03 0x1E 0x0F 0x00)
		RTQ_WRITE_BLOCK(0x53, 0x8D, 0x04, 0x03 0x00 0x00 0x00)
		RTQ_WRITE_BLOCK(0x53, 0x8E, 0x04, 0x03 0x00 0x00 0x00)
		RTQ_WRITE_BLOCK(0x53, 0x9A, 0x05, 0x04 0x07 0x00 0xFC 0x07)
		RTQ_WRITE_BLOCK(0x53, 0x9B, 0x05, 0x04 0xE9 0x26 0x02 0x04)
		RTQ_WRITE_BYTE(0x53, 0x9C, 0xDA)
		RTQ_WRITE_BYTE(0x53, 0x9D, 0xE8)
		RTQ_WRITE_BYTE(0x53, 0x9E, 0x80)
		RTQ_WRITE_BYTE(0x53, 0x9F, 0x80)
		RTQ_WRITE_BYTE(0x53, 0xA0, 0x2A)
		RTQ_WRITE_BYTE(0x53, 0xA1, 0x2A)
		RTQ_WRITE_BYTE(0x53, 0xA2, 0x1E)
		RTQ_WRITE_BYTE(0x53, 0xA3, 0x26)
		RTQ_WRITE_BYTE(0x53, 0xA4, 0x66)
		RTQ_WRITE_BYTE(0x53, 0xA5, 0x11)
		RTQ_WRITE_BYTE(0x53, 0xA6, 0x11)
		RTQ_WRITE_BYTE(0x53, 0xA7, 0x1F)
		RTQ_WRITE_BYTE(0x53, 0xA8, 0x7A)
		RTQ_WRITE_BYTE(0x53, 0xA9, 0x1F)
		RTQ_WRITE_BYTE(0x53, 0xAA, 0x98)
		RTQ_WRITE_BYTE(0x53, 0xAB, 0x1F)
		RTQ_WRITE_BYTE(0x53, 0xAC, 0x98)
		RTQ_WRITE_BYTE(0x53, 0xAD, 0x1F)
		RTQ_WRITE_BYTE(0x53, 0xAE, 0x79)
		RTQ_WRITE_BYTE(0x53, 0xAF, 0x27)
		RTQ_WRITE_BYTE(0x53, 0xB0, 0x8A)
		RTQ_WRITE_BYTE(0x53, 0xB1, 0x2F)
		RTQ_WRITE_BYTE(0x53, 0xB2, 0xA8)
		RTQ_WRITE_BYTE(0x53, 0xB3, 0x6E)
		RTQ_WRITE_WORD(0x53, 0xB4, 0x44, 0x0E)
		RTQ_WRITE_BYTE(0x53, 0xB5, 0x55)
		RTQ_WRITE_BYTE(0x53, 0xB6, 0x55)
		RTQ_WRITE_BYTE(0x53, 0xB7, 0x55)
		RTQ_WRITE_BYTE(0x53, 0xB8, 0x55)
		RTQ_WRITE_BYTE(0x53, 0xB9, 0x55)
		RTQ_WRITE_BYTE(0x53, 0xBA, 0x55)
		RTQ_WRITE_BYTE(0x53, 0xBB, 0x02)
		RTQ_WRITE_BYTE(0x53, 0xBC, 0x0F)
		RTQ_WRITE_BYTE(0x53, 0xBD, 0x00)
		RTQ_WRITE_BYTE(0x53, 0xBE, 0x0A)
		RTQ_WRITE_BYTE(0x53, 0xBF, 0x20)
		RTQ_WRITE_BYTE(0x53, 0xC0, 0x20)
		RTQ_WRITE_BYTE(0x53, 0xC1, 0x20)
		RTQ_WRITE_BYTE(0x53, 0xC2, 0x20)
		RTQ_WRITE_BYTE(0x53, 0xC3, 0x20)
		RTQ_WRITE_WORD(0x53, 0xC4, 0x29, 0x0B)
		RTQ_WRITE_BYTE(0x53, 0xC5, 0x00)
		RTQ_WRITE_BYTE(0x53, 0xC6, 0x00)
		RTQ_WRITE_BYTE(0x53, 0xC7, 0x00)
		RTQ_WRITE_BYTE(0x53, 0xC8, 0x41)
		RTQ_WRITE_WORD(0x53, 0xCB, 0x29, 0x02)
		RTQ_WRITE_BYTE(0x53, 0xCC, 0x42)
		RTQ_WRITE_BLOCK(0x53, 0xCD, 0x05, 0x04 0x52 0x22 0x00 0x01)
		RTQ_WRITE_BLOCK(0x53, 0xCE, 0x05, 0x04 0x16 0x1C 0x00 0x00)
		RTQ_WRITE_BYTE(0x53, 0xCF, 0x00)
		RTQ_WRITE_WORD(0x53, 0xD0, 0x0F, 0x1F)
		RTQ_WRITE_BLOCK(0x53, 0xD1, 0x05, 0x04 0x00 0x00 0x00 0xB0)
		RTQ_WRITE_BYTE(0x53, 0xD2, 0xB4)
		RTQ_WRITE_BLOCK(0x53, 0xD3, 0x05, 0x04 0x0F 0x18 0x20 0x28)
		RTQ_WRITE_BLOCK(0x53, 0xD4, 0x05, 0x04 0x30 0x00 0x00 0x00)
		RTQ_WRITE_BLOCK(0x53, 0xD6, 0x05, 0x04 0x10 0x18 0x20 0x28)
		RTQ_WRITE_BLOCK(0x53, 0xD7, 0x05, 0x04 0x30 0x00 0x00 0x00)
		RTQ_WRITE_BYTE(0x53, 0xD9, 0xC3)
		RTQ_WRITE_BYTE(0x53, 0xDA, 0x08)
		RTQ_WRITE_BYTE(0x53, 0xDB, 0x4B)
		RTQ_WRITE_BYTE(0x53, 0xDC, 0x03)
		RTQ_WRITE_BYTE(0x53, 0xDD, 0x06)
		RTQ_WRITE_WORD(0x53, 0xDE, 0x30, 0x02)
		RTQ_WRITE_WORD(0x53, 0xDF, 0x0E, 0x01)
		RTQ_WRITE_WORD(0x53, 0xE0, 0x32, 0x00)
		RTQ_WRITE_WORD(0x53, 0xE1, 0x29, 0x00)
		RTQ_WRITE_WORD(0x53, 0xE2, 0x7E, 0x00)
		RTQ_WRITE_WORD(0x53, 0xE3, 0x3C, 0x00)
		RTQ_WRITE_WORD(0x53, 0xE4, 0x0C, 0x00)
		RTQ_WRITE_WORD(0x53, 0xE5, 0x00, 0x00)
		RTQ_WRITE_BYTE(0x53, 0xE6, 0x05)
		RTQ_WRITE_BYTE(0x53, 0xE7, 0x00)
		RTQ_WRITE_BYTE(0x53, 0xE8, 0x00)
		RTQ_WRITE_BYTE(0x53, 0xE9, 0x00)
		RTQ_WRITE_BYTE(0x54, 0x01, 0x00)
		RTQ_WRITE_BYTE(0x54, 0x02, 0x00)
		RTQ_WRITE_BLOCK(0x54, 0x03, 0x06, 0x05 0x40 0x01 0x00 0x40 0x9B)
		RTQ_WRITE_BLOCK(0x54, 0x04, 0x06, 0x05 0x00 0x00 0x05 0x00 0x05)
		RTQ_WRITE_BLOCK(0x54, 0x05, 0x06, 0x05 0x0D 0x34 0x00 0x14 0x00)
		RTQ_WRITE_BLOCK(0x54, 0x06, 0x06, 0x05 0x1F 0xB4 0xD6 0xC0 0x07)
		RTQ_WRITE_BYTE(0x54, 0x07, 0x00)
		RTQ_WRITE_BYTE(0x54, 0x08, 0x1F)
		RTQ_WRITE_BYTE(0x54, 0x09, 0x00)
		RTQ_WRITE_BYTE(0x54, 0x0A, 0x1F)
		RTQ_WRITE_BYTE(0x54, 0x0B, 0x00)
		RTQ_WRITE_BYTE(0x54, 0x0C, 0x1F)
		RTQ_WRITE_BYTE(0x54, 0x0D, 0x00)
		RTQ_WRITE_BYTE(0x54, 0x0E, 0x00)
		RTQ_WRITE_BLOCK(0x54, 0x0F, 0x06, 0x05 0x1F 0x3C 0xF0 0x38 0x80)
		RTQ_WRITE_BLOCK(0x54, 0x10, 0x06, 0x05 0x5F 0x7F 0xF0 0x80 0xD2)
		RTQ_WRITE_BYTE(0x54, 0x11, 0x00)
		RTQ_WRITE_BYTE(0x54, 0x12, 0x1F)
		RTQ_WRITE_BYTE(0x54, 0x13, 0x00)
		RTQ_WRITE_BYTE(0x54, 0x14, 0x1F)
		RTQ_WRITE_BYTE(0x54, 0x15, 0x00)
		RTQ_WRITE_BYTE(0x54, 0x16, 0x00)
		RTQ_WRITE_BLOCK(0x54, 0x17, 0x06, 0x05 0x1F 0x68 0xA0 0x01 0x98)
		RTQ_WRITE_BLOCK(0x54, 0x18, 0x06, 0x05 0x1F 0x7C 0xA0 0x81 0x06)
		RTQ_WRITE_BYTE(0x54, 0x19, 0x00)
		RTQ_WRITE_BYTE(0x54, 0x1A, 0x1F)
		RTQ_WRITE_BYTE(0x54, 0x1B, 0x00)
		RTQ_WRITE_BYTE(0x54, 0x1C, 0x1F)
		RTQ_WRITE_BYTE(0x54, 0x1D, 0x00)
		RTQ_WRITE_BYTE(0x54, 0x1E, 0x00)
		RTQ_WRITE_BLOCK(0x54, 0x1F, 0x06, 0x05 0x65 0x94 0x51 0x06 0x80)
		RTQ_WRITE_BLOCK(0x54, 0x20, 0x06, 0x05 0x30 0xC1 0x04 0x13 0x4C)
		RTQ_WRITE_BYTE(0x54, 0x21, 0x09)
		RTQ_WRITE_BYTE(0x54, 0x22, 0x10)
		RTQ_WRITE_BYTE(0x54, 0x23, 0x09)
		RTQ_WRITE_BYTE(0x54, 0x24, 0x10)
		RTQ_WRITE_BYTE(0x54, 0x25, 0x00)
		RTQ_WRITE_WORD(0x54, 0x26, 0x7D, 0x00)
		RTQ_WRITE_BYTE(0x54, 0x27, 0x54)
		RTQ_WRITE_BYTE(0x54, 0x28, 0x1C)
		RTQ_WRITE_BYTE(0x54, 0x29, 0x24)
		RTQ_WRITE_BYTE(0x54, 0x2A, 0x02)
		RTQ_WRITE_BYTE(0x54, 0x2B, 0x48)
		RTQ_WRITE_BYTE(0x54, 0x2C, 0x1F)
		RTQ_WRITE_WORD(0x54, 0x2D, 0x00, 0x00)
		RTQ_WRITE_BYTE(0x54, 0x2E, 0x82)
		RTQ_WRITE_WORD(0x54, 0x2F, 0x32, 0x00)
		RTQ_WRITE_BYTE(0x54, 0x30, 0x89)
		RTQ_WRITE_BYTE(0x54, 0x31, 0x3F)
		RTQ_WRITE_BYTE(0x54, 0x32, 0x1F)
		RTQ_WRITE_BYTE(0x54, 0x33, 0x1F)
		RTQ_WRITE_BYTE(0x54, 0x34, 0x29)
		RTQ_WRITE_BYTE(0x54, 0x35, 0x11)
		RTQ_WRITE_BYTE(0x54, 0x36, 0x04)
		RTQ_WRITE_BYTE(0x54, 0x37, 0x01)
		RTQ_WRITE_WORD(0x54, 0x38, 0x16, 0x00)
		RTQ_WRITE_WORD(0x54, 0x39, 0x60, 0x05)
		RTQ_WRITE_WORD(0x54, 0x3A, 0x03, 0x00)
		RTQ_WRITE_BYTE(0x54, 0x3B, 0x02)
		RTQ_WRITE_BYTE(0x54, 0x3C, 0x30)
		RTQ_WRITE_BYTE(0x54, 0x3D, 0x08)
		RTQ_WRITE_BYTE(0x54, 0x3E, 0x18)
		RTQ_WRITE_BYTE(0x54, 0x40, 0x03)
		RTQ_WRITE_BYTE(0x54, 0x41, 0x00)
		RTQ_WRITE_BYTE(0x54, 0x42, 0x01)
		RTQ_WRITE_BYTE(0x54, 0x43, 0x05)
		RTQ_WRITE_BYTE(0x54, 0x44, 0xD1)
		RTQ_WRITE_BYTE(0x54, 0x45, 0xA8)
		RTQ_WRITE_BYTE(0x54, 0x46, 0x2F)
		RTQ_WRITE_BYTE(0x54, 0x47, 0x10)
		RTQ_WRITE_BYTE(0x54, 0x48, 0x2F)
		RTQ_WRITE_BYTE(0x54, 0x49, 0x00)
		RTQ_WRITE_BYTE(0x54, 0x4A, 0x64)
		RTQ_WRITE_BYTE(0x54, 0x4B, 0x61)
		RTQ_WRITE_BYTE(0x54, 0x4C, 0x11)
		RTQ_WRITE_BYTE(0x54, 0x4D, 0x00)
		RTQ_WRITE_BYTE(0x54, 0x4E, 0x80)
		RTQ_WRITE_BYTE(0x54, 0x4F, 0x00)
		RTQ_WRITE_BYTE(0x54, 0x50, 0x1F)
		RTQ_WRITE_BYTE(0x54, 0x51, 0x00)
		RTQ_WRITE_BYTE(0x54, 0x52, 0x01)
		RTQ_WRITE_BYTE(0x54, 0x53, 0x12)
		RTQ_WRITE_BYTE(0x54, 0x54, 0x24)
		RTQ_WRITE_BYTE(0x54, 0x55, 0x24)
		RTQ_WRITE_BYTE(0x54, 0x56, 0x1F)
		RTQ_WRITE_WORD(0x54, 0x57, 0xA1, 0x00)
		RTQ_WRITE_BYTE(0x54, 0x58, 0x04)
		RTQ_WRITE_WORD(0x54, 0x59, 0x6F, 0x00)
		RTQ_WRITE_BYTE(0x54, 0x5A, 0x04)
		RTQ_WRITE_BYTE(0x54, 0x5B, 0x07)
		RTQ_WRITE_BYTE(0x54, 0x5C, 0x00)
		RTQ_WRITE_BYTE(0x54, 0x5D, 0x00)
		RTQ_WRITE_BYTE(0x54, 0x5E, 0x00)
		RTQ_WRITE_BYTE(0x54, 0x5F, 0x00)
		RTQ_WRITE_BYTE(0x54, 0x60, 0x02)
		RTQ_WRITE_BYTE(0x54, 0x61, 0x8C)
		RTQ_WRITE_BYTE(0x54, 0x62, 0xA5)
		RTQ_WRITE_BYTE(0x54, 0x63, 0x66)
		RTQ_WRITE_BYTE(0x54, 0x64, 0x21)
		RTQ_WRITE_BYTE(0x54, 0x65, 0x60)
		RTQ_WRITE_BYTE(0x54, 0x66, 0x2F)
		RTQ_WRITE_BYTE(0x54, 0x67, 0x32)
		RTQ_WRITE_BYTE(0x54, 0x68, 0x32)
		RTQ_WRITE_BYTE(0x54, 0x69, 0xC0)
		RTQ_WRITE_BYTE(0x54, 0x6A, 0x08)
		RTQ_WRITE_BYTE(0x54, 0x6B, 0xC9)
		RTQ_WRITE_WORD(0x54, 0x6C, 0x7B, 0x7A)
		RTQ_WRITE_BYTE(0x54, 0x6E, 0x40)
		RTQ_WRITE_WORD(0x54, 0x6F, 0x02, 0x00)
		RTQ_WRITE_BYTE(0x54, 0x70, 0x1D)
		RTQ_WRITE_BYTE(0x54, 0x71, 0x1E)
		RTQ_WRITE_BLOCK(0x54, 0x72, 0x05, 0x04 0x60 0x98 0x60 0x34)
		RTQ_WRITE_BLOCK(0x54, 0x73, 0x05, 0x04 0x60 0x98 0x60 0x98)
		RTQ_WRITE_BLOCK(0x54, 0x74, 0x05, 0x04 0x60 0x98 0x60 0x98)
		RTQ_WRITE_BLOCK(0x54, 0x78, 0x05, 0x04 0x60 0x94 0x60 0x6D)
		RTQ_WRITE_BLOCK(0x54, 0x79, 0x05, 0x04 0xA0 0xDC 0xA0 0xDC)
		RTQ_WRITE_BLOCK(0x54, 0x7A, 0x05, 0x04 0x60 0x98 0x60 0xDC)
		RTQ_WRITE_WORD(0x54, 0x7E, 0x50, 0x01)
		RTQ_WRITE_BYTE(0x54, 0x7F, 0x52)
		RTQ_WRITE_BLOCK(0x54, 0x80, 0x05, 0x04 0x48 0x29 0xA5 0x00)
		RTQ_WRITE_BYTE(0x54, 0x82, 0x21)
		RTQ_WRITE_BLOCK(0x54, 0x85, 0x05, 0x04 0x18 0xE0 0x01 0x00)
		RTQ_WRITE_BYTE(0x54, 0x86, 0x32)
		RTQ_WRITE_BYTE(0x54, 0x87, 0x48)
		RTQ_WRITE_BYTE(0x54, 0x88, 0x24)
		RTQ_WRITE_BLOCK(0x54, 0x89, 0x05, 0x04 0xF6 0x03 0xC0 0x7F)
		RTQ_WRITE_WORD(0x54, 0x8C, 0x21, 0x21)
		RTQ_WRITE_BYTE(0x54, 0x8D, 0x03)
		RTQ_WRITE_BYTE(0x54, 0x8E, 0x8C)
		RTQ_WRITE_BYTE(0x54, 0x8F, 0x01)
		RTQ_WRITE_WORD(0x54, 0x90, 0xC0, 0xC0)
		RTQ_WRITE_BYTE(0x54, 0x91, 0x00)
		RTQ_WRITE_BLOCK(0x54, 0x92, 0x0A, 0x09 0x00 0x00 0x00 0x00 0x00 0x00 0x00 0x00 0x00)
		RTQ_WRITE_BYTE(0x54, 0x94, 0x09)
		RTQ_WRITE_BYTE(0x54, 0x95, 0x00)
		RTQ_WRITE_BYTE(0x54, 0x96, 0x00)
		RTQ_WRITE_BLOCK(0x55, 0x01, 0x05, 0x04 0x95 0x7E 0x00 0x00)
		RTQ_WRITE_WORD(0x55, 0x02, 0xEE, 0x02)
		RTQ_WRITE_BYTE(0x55, 0x03, 0x4B)
		RTQ_WRITE_WORD(0x55, 0x04, 0x10, 0x0B)
		RTQ_WRITE_WORD(0x55, 0x05, 0x10, 0x0C)
		RTQ_WRITE_BYTE(0x55, 0x06, 0x82)
		RTQ_WRITE_BYTE(0x55, 0x07, 0x1E)
		RTQ_WRITE_BYTE(0x55, 0x08, 0x18)
		RTQ_WRITE_BYTE(0x55, 0x09, 0x1D)
		RTQ_WRITE_BYTE(0x55, 0x0A, 0x10)
		RTQ_WRITE_BYTE(0x55, 0x0B, 0x18)
		RTQ_WRITE_BYTE(0x55, 0x0C, 0x18)
		RTQ_WRITE_BYTE(0x55, 0x0D, 0x18)
		RTQ_WRITE_BYTE(0x55, 0x0E, 0x18)
		RTQ_WRITE_BYTE(0x55, 0x0F, 0x18)
		RTQ_WRITE_BYTE(0x55, 0x10, 0x18)
		RTQ_WRITE_BYTE(0x55, 0x11, 0x18)
		RTQ_WRITE_BYTE(0x55, 0x12, 0x18)
		RTQ_WRITE_BYTE(0x55, 0x13, 0x18)
		RTQ_WRITE_BYTE(0x55, 0x14, 0x18)
		RTQ_WRITE_BYTE(0x55, 0x15, 0x18)
		RTQ_WRITE_BYTE(0x55, 0x16, 0x18)
		RTQ_WRITE_BYTE(0x55, 0x17, 0x18)
		RTQ_WRITE_BYTE(0x55, 0x19, 0x18)
		RTQ_WRITE_BYTE(0x55, 0x1A, 0x18)
		RTQ_WRITE_BYTE(0x55, 0x1B, 0x19)
		RTQ_WRITE_BYTE(0x55, 0x1C, 0x19)
		RTQ_WRITE_BYTE(0x55, 0x1E, 0x17)
		RTQ_WRITE_BYTE(0x55, 0x1F, 0x02)
		RTQ_WRITE_BYTE(0x55, 0x21, 0x02)
		RTQ_WRITE_BYTE(0x55, 0x22, 0x02)
		RTQ_WRITE_BYTE(0x55, 0x23, 0x02)
		RTQ_WRITE_BYTE(0x55, 0x24, 0x02)
		RTQ_WRITE_BYTE(0x55, 0x25, 0x02)
		RTQ_WRITE_BYTE(0x55, 0x26, 0x02)
		RTQ_WRITE_BYTE(0x55, 0x27, 0x02)
		RTQ_WRITE_BYTE(0x55, 0x28, 0x02)
		RTQ_WRITE_BYTE(0x55, 0x29, 0x02)
		RTQ_WRITE_BYTE(0x55, 0x2A, 0x02)
		RTQ_WRITE_BYTE(0x55, 0x2B, 0x02)
		RTQ_WRITE_BYTE(0x55, 0x2C, 0x02)
		RTQ_WRITE_BYTE(0x55, 0x2F, 0x02)
		RTQ_WRITE_BYTE(0x55, 0x30, 0x02)
		RTQ_WRITE_BYTE(0x55, 0x31, 0x03)
		RTQ_WRITE_BYTE(0x55, 0x32, 0x05)
		RTQ_WRITE_BLOCK(0x55, 0x33, 0x06, 0x05 0x08 0x21 0x84 0x10 0x42)
		RTQ_WRITE_BLOCK(0x55, 0x34, 0x06, 0x05 0x08 0x21 0x84 0x10 0x42)
		RTQ_WRITE_BLOCK(0x55, 0x35, 0x06, 0x05 0x39 0x23 0x84 0x10 0x42)
		RTQ_WRITE_BLOCK(0x55, 0x36, 0x06, 0x05 0x39 0xE7 0x9C 0x73 0xCE)
		RTQ_WRITE_BLOCK(0x55, 0x37, 0x06, 0x05 0x39 0xE7 0x9C 0x73 0xCE)
		RTQ_WRITE_BYTE(0x55, 0x38, 0x19)
		RTQ_WRITE_BYTE(0x55, 0x39, 0x19)
		RTQ_WRITE_BYTE(0x55, 0x3A, 0x19)
		RTQ_WRITE_BYTE(0x55, 0x3B, 0x19)
		RTQ_WRITE_BYTE(0x55, 0x3C, 0x10)
		RTQ_WRITE_BYTE(0x55, 0x3D, 0x10)
		RTQ_WRITE_BYTE(0x55, 0x3E, 0x10)
		RTQ_WRITE_BYTE(0x55, 0x3F, 0x10)
		RTQ_WRITE_BYTE(0x55, 0x40, 0x10)
		RTQ_WRITE_BYTE(0x55, 0x41, 0x10)
		RTQ_WRITE_BYTE(0x55, 0x42, 0x10)
		RTQ_WRITE_BYTE(0x55, 0x43, 0x10)
		RTQ_WRITE_BYTE(0x55, 0x44, 0x10)
		RTQ_WRITE_BYTE(0x55, 0x45, 0x10)
		RTQ_WRITE_BYTE(0x55, 0x46, 0x10)
		RTQ_WRITE_BYTE(0x55, 0x47, 0x10)
		RTQ_WRITE_BYTE(0x55, 0x48, 0x10)
		RTQ_WRITE_BYTE(0x55, 0x49, 0x10)
		RTQ_WRITE_BYTE(0x55, 0x4A, 0x10)
		RTQ_WRITE_BYTE(0x55, 0x4B, 0x10)
		RTQ_WRITE_BYTE(0x55, 0x4C, 0x10)
		RTQ_WRITE_BYTE(0x55, 0x4D, 0x10)
		RTQ_WRITE_BYTE(0x55, 0x4E, 0x10)
		RTQ_WRITE_BYTE(0x55, 0x4F, 0x10)
		RTQ_WRITE_BYTE(0x55, 0x50, 0x10)
		RTQ_WRITE_BYTE(0x55, 0x51, 0x10)
		RTQ_WRITE_BYTE(0x55, 0x52, 0x11)
		RTQ_WRITE_BYTE(0x55, 0x53, 0x11)
		RTQ_WRITE_BYTE(0x55, 0x54, 0x11)
		RTQ_WRITE_BYTE(0x55, 0x55, 0x11)
		RTQ_WRITE_BYTE(0x55, 0x56, 0x11)
		RTQ_WRITE_BYTE(0x55, 0x57, 0x11)
		RTQ_WRITE_BYTE(0x55, 0x58, 0x11)
		RTQ_WRITE_BYTE(0x55, 0x59, 0x11)
		RTQ_WRITE_BYTE(0x55, 0x5A, 0x11)
		RTQ_WRITE_BYTE(0x55, 0x5B, 0x11)
		RTQ_WRITE_BYTE(0x55, 0x5C, 0x11)
		RTQ_WRITE_BYTE(0x55, 0x5D, 0x11)
		RTQ_WRITE_BYTE(0x55, 0x5E, 0x11)
		RTQ_WRITE_BYTE(0x55, 0x5F, 0x11)
		RTQ_WRITE_BYTE(0x55, 0x60, 0x11)
		RTQ_WRITE_BYTE(0x55, 0x61, 0x11)
		RTQ_WRITE_BYTE(0x55, 0x62, 0x11)
		RTQ_WRITE_BYTE(0x55, 0x63, 0x11)
		RTQ_WRITE_BYTE(0x55, 0x64, 0x11)
		RTQ_WRITE_BYTE(0x55, 0x65, 0x11)
		RTQ_WRITE_BYTE(0x55, 0x66, 0x11)
		RTQ_WRITE_BYTE(0x55, 0x67, 0x11)
		RTQ_WRITE_WORD(0x55, 0x68, 0x50, 0x10)
		RTQ_WRITE_BYTE(0x55, 0x69, 0x4F)
		RTQ_WRITE_BYTE(0x55, 0x6A, 0x10)
		RTQ_WRITE_BYTE(0x55, 0x6B, 0x4F)
		RTQ_WRITE_BYTE(0x55, 0x6C, 0x26)
		RTQ_WRITE_BYTE(0x55, 0x6D, 0x27)
		RTQ_WRITE_BYTE(0x55, 0x6E, 0x98)
		RTQ_WRITE_BYTE(0x55, 0x6F, 0x98)
		RTQ_WRITE_WORD(0x55, 0x70, 0x40, 0x02)
		RTQ_WRITE_WORD(0x55, 0x71, 0x20, 0x00)
		RTQ_WRITE_BYTE(0x55, 0x72, 0x7F)
		RTQ_WRITE_BYTE(0x55, 0x73, 0x1E)
		RTQ_WRITE_BYTE(0x55, 0x74, 0x0E)
		RTQ_WRITE_BYTE(0x55, 0x75, 0x7F)
		RTQ_WRITE_BYTE(0x55, 0x76, 0x1C)
		RTQ_WRITE_BYTE(0x55, 0x77, 0x0C)
		RTQ_WRITE_BYTE(0x55, 0x78, 0x7F)
		RTQ_WRITE_BYTE(0x55, 0x79, 0x20)
		RTQ_WRITE_BYTE(0x55, 0x7A, 0x10)
		RTQ_WRITE_BYTE(0x55, 0x7B, 0x77)
		RTQ_WRITE_BYTE(0x55, 0x7C, 0x5A)
		RTQ_WRITE_BYTE(0x55, 0x7D, 0x3C)
		RTQ_WRITE_BYTE(0x55, 0x7E, 0x76)
		RTQ_WRITE_BYTE(0x55, 0x7F, 0x5A)
		RTQ_WRITE_BYTE(0x55, 0x80, 0x3C)
		RTQ_WRITE_BYTE(0x55, 0x81, 0x50)
		RTQ_WRITE_BYTE(0x55, 0x82, 0x70)
		RTQ_WRITE_BYTE(0x55, 0x83, 0x50)
		RTQ_WRITE_BYTE(0x55, 0x84, 0x23)
		RTQ_WRITE_BYTE(0x55, 0x85, 0x24)
		RTQ_WRITE_BYTE(0x55, 0x86, 0x88)
		RTQ_WRITE_BYTE(0x55, 0x87, 0x01)
		RTQ_WRITE_BYTE(0x55, 0x88, 0x0F)
		RTQ_WRITE_BYTE(0x55, 0x89, 0x0B)
		RTQ_WRITE_WORD(0x55, 0x8A, 0x49, 0xBC)
		RTQ_WRITE_BLOCK(0x55, 0x8B, 0x05, 0x04 0x00 0x00 0x03 0x00)
		RTQ_WRITE_BLOCK(0x55, 0x8C, 0x04, 0x03 0x1E 0x0F 0x00)
		RTQ_WRITE_BLOCK(0x55, 0x8D, 0x04, 0x03 0x00 0x00 0x00)
		RTQ_WRITE_BLOCK(0x55, 0x8E, 0x04, 0x03 0x00 0x00 0x00)
		RTQ_WRITE_BLOCK(0x55, 0x9A, 0x05, 0x04 0x66 0x66 0xFF 0x07)
		RTQ_WRITE_BLOCK(0x55, 0x9B, 0x05, 0x04 0x9A 0x9A 0x00 0x04)
		RTQ_WRITE_BYTE(0x55, 0x9C, 0xBA)
		RTQ_WRITE_BYTE(0x55, 0x9D, 0x97)
		RTQ_WRITE_BYTE(0x55, 0x9E, 0x83)
		RTQ_WRITE_BYTE(0x55, 0x9F, 0xD5)
		RTQ_WRITE_BYTE(0x55, 0xA0, 0x26)
		RTQ_WRITE_BYTE(0x55, 0xA1, 0x26)
		RTQ_WRITE_BYTE(0x55, 0xA2, 0x26)
		RTQ_WRITE_BYTE(0x55, 0xA3, 0x26)
		RTQ_WRITE_BYTE(0x55, 0xA4, 0x11)
		RTQ_WRITE_BYTE(0x55, 0xA5, 0x11)
		RTQ_WRITE_BYTE(0x55, 0xA6, 0x11)
		RTQ_WRITE_BYTE(0x55, 0xA7, 0x1F)
		RTQ_WRITE_BYTE(0x55, 0xA8, 0x7D)
		RTQ_WRITE_BYTE(0x55, 0xA9, 0x1F)
		RTQ_WRITE_BYTE(0x55, 0xAA, 0x7D)
		RTQ_WRITE_BYTE(0x55, 0xAB, 0x1F)
		RTQ_WRITE_BYTE(0x55, 0xAC, 0x9A)
		RTQ_WRITE_BYTE(0x55, 0xAD, 0x1F)
		RTQ_WRITE_BYTE(0x55, 0xAE, 0x7D)
		RTQ_WRITE_BYTE(0x55, 0xAF, 0x23)
		RTQ_WRITE_BYTE(0x55, 0xB0, 0x7A)
		RTQ_WRITE_BYTE(0x55, 0xB1, 0x1F)
		RTQ_WRITE_BYTE(0x55, 0xB2, 0x7A)
		RTQ_WRITE_BYTE(0x55, 0xB3, 0x6E)
		RTQ_WRITE_WORD(0x55, 0xB4, 0x54, 0x0E)
		RTQ_WRITE_BYTE(0x55, 0xB5, 0x55)
		RTQ_WRITE_BYTE(0x55, 0xB6, 0x55)
		RTQ_WRITE_BYTE(0x55, 0xB7, 0x55)
		RTQ_WRITE_BYTE(0x55, 0xB8, 0x55)
		RTQ_WRITE_BYTE(0x55, 0xB9, 0x55)
		RTQ_WRITE_BYTE(0x55, 0xBA, 0x55)
		RTQ_WRITE_BYTE(0x55, 0xBB, 0x02)
		RTQ_WRITE_BYTE(0x55, 0xBC, 0x0F)
		RTQ_WRITE_BYTE(0x55, 0xBD, 0x00)
		RTQ_WRITE_BYTE(0x55, 0xBE, 0x8A)
		RTQ_WRITE_BYTE(0x55, 0xBF, 0x22)
		RTQ_WRITE_BYTE(0x55, 0xC0, 0x20)
		RTQ_WRITE_BYTE(0x55, 0xC1, 0x20)
		RTQ_WRITE_BYTE(0x55, 0xC2, 0x20)
		RTQ_WRITE_BYTE(0x55, 0xC3, 0x20)
		RTQ_WRITE_WORD(0x55, 0xC4, 0x29, 0x0B)
		RTQ_WRITE_BYTE(0x55, 0xC5, 0x0A)
		RTQ_WRITE_BYTE(0x55, 0xC6, 0x02)
		RTQ_WRITE_BYTE(0x55, 0xC7, 0x00)
		RTQ_WRITE_BYTE(0x55, 0xC8, 0x02)
		RTQ_WRITE_WORD(0x55, 0xCB, 0x2C, 0x02)
		RTQ_WRITE_BYTE(0x55, 0xCC, 0x46)
		RTQ_WRITE_BLOCK(0x55, 0xCD, 0x05, 0x04 0xC0 0x19 0x00 0x01)
		RTQ_WRITE_BLOCK(0x55, 0xCE, 0x05, 0x04 0x24 0x18 0x00 0x00)
		RTQ_WRITE_BYTE(0x55, 0xCF, 0x00)
		RTQ_WRITE_WORD(0x55, 0xD0, 0x08, 0x00)
		RTQ_WRITE_BLOCK(0x55, 0xD1, 0x05, 0x04 0x00 0x00 0x00 0xB0)
		RTQ_WRITE_BYTE(0x55, 0xD2, 0xB4)
		RTQ_WRITE_BLOCK(0x55, 0xD3, 0x05, 0x04 0x0E 0x17 0x00 0x00)
		RTQ_WRITE_BLOCK(0x55, 0xD6, 0x05, 0x04 0x0E 0x17 0x00 0x00)
		RTQ_WRITE_BYTE(0x55, 0xD9, 0xC3)
		RTQ_WRITE_BYTE(0x55, 0xDA, 0x08)
		RTQ_WRITE_BYTE(0x55, 0xDB, 0x4B)
		RTQ_WRITE_BYTE(0x55, 0xDC, 0x03)
		RTQ_WRITE_BYTE(0x55, 0xDD, 0x06)
		RTQ_WRITE_WORD(0x55, 0xDE, 0x30, 0x02)
		RTQ_WRITE_WORD(0x55, 0xDF, 0x0E, 0x01)
		RTQ_WRITE_WORD(0x55, 0xE0, 0x32, 0x00)
		RTQ_WRITE_WORD(0x55, 0xE1, 0x29, 0x00)
		RTQ_WRITE_WORD(0x55, 0xE2, 0xE8, 0x00)
		RTQ_WRITE_WORD(0x55, 0xE3, 0x3C, 0x00)
		RTQ_WRITE_WORD(0x55, 0xE4, 0x40, 0x00)
		RTQ_WRITE_WORD(0x55, 0xE5, 0x07, 0x00)
		RTQ_WRITE_BYTE(0x55, 0xE6, 0x05)
		RTQ_WRITE_BYTE(0x55, 0xE7, 0x00)
		RTQ_WRITE_BYTE(0x55, 0xE8, 0x00)
		RTQ_WRITE_BYTE(0x55, 0xE9, 0x00)
		RTQ_WRITE_BYTE(0x56, 0x01, 0x00)
		RTQ_WRITE_BYTE(0x56, 0x02, 0x38)
		RTQ_WRITE_BLOCK(0x56, 0x03, 0x06, 0x05 0xC5 0x96 0x59 0xDE 0x9C)
		RTQ_WRITE_BLOCK(0x56, 0x04, 0x06, 0x05 0xE5 0x15 0x5B 0x66 0x79)
		RTQ_WRITE_BLOCK(0x56, 0x05, 0x06, 0x05 0x0D 0x34 0x50 0x6C 0x99)
		RTQ_WRITE_BLOCK(0x56, 0x06, 0x06, 0x05 0x1F 0x34 0xD0 0xC0 0x07)
		RTQ_WRITE_BYTE(0x56, 0x07, 0x00)
		RTQ_WRITE_BYTE(0x56, 0x08, 0x1F)
		RTQ_WRITE_BYTE(0x56, 0x09, 0x00)
		RTQ_WRITE_BYTE(0x56, 0x0A, 0x1F)
		RTQ_WRITE_BYTE(0x56, 0x0B, 0x00)
		RTQ_WRITE_BYTE(0x56, 0x0C, 0x1F)
		RTQ_WRITE_BYTE(0x56, 0x0D, 0x35)
		RTQ_WRITE_BYTE(0x56, 0x0E, 0x00)
		RTQ_WRITE_BLOCK(0x56, 0x0F, 0x06, 0x05 0x0F 0x3C 0xF0 0x00 0xB0)
		RTQ_WRITE_BLOCK(0x56, 0x10, 0x06, 0x05 0x07 0x3C 0xF0 0xC0 0x03)
		RTQ_WRITE_BYTE(0x56, 0x11, 0x00)
		RTQ_WRITE_BYTE(0x56, 0x12, 0x0F)
		RTQ_WRITE_BYTE(0x56, 0x13, 0x00)
		RTQ_WRITE_BYTE(0x56, 0x14, 0x0F)
		RTQ_WRITE_BYTE(0x56, 0x15, 0x00)
		RTQ_WRITE_BYTE(0x56, 0x16, 0x00)
		RTQ_WRITE_BLOCK(0x56, 0x17, 0x06, 0x05 0x1F 0x68 0xA0 0x01 0x98)
		RTQ_WRITE_BLOCK(0x56, 0x18, 0x06, 0x05 0x1F 0x7C 0xA0 0x81 0x06)
		RTQ_WRITE_BYTE(0x56, 0x19, 0x00)
		RTQ_WRITE_BYTE(0x56, 0x1A, 0x1F)
		RTQ_WRITE_BYTE(0x56, 0x1B, 0x00)
		RTQ_WRITE_BYTE(0x56, 0x1C, 0x1F)
		RTQ_WRITE_BYTE(0x56, 0x1D, 0x00)
		RTQ_WRITE_BYTE(0x56, 0x1E, 0x00)
		RTQ_WRITE_BLOCK(0x56, 0x1F, 0x06, 0x05 0x65 0x94 0x51 0x06 0x80)
		RTQ_WRITE_BLOCK(0x56, 0x20, 0x06, 0x05 0x30 0xC1 0x04 0x13 0x4C)
		RTQ_WRITE_BYTE(0x56, 0x21, 0x09)
		RTQ_WRITE_BYTE(0x56, 0x22, 0x10)
		RTQ_WRITE_BYTE(0x56, 0x23, 0x09)
		RTQ_WRITE_BYTE(0x56, 0x24, 0x10)
		RTQ_WRITE_BYTE(0x56, 0x25, 0x00)
		RTQ_WRITE_WORD(0x56, 0x26, 0x7D, 0x00)
		RTQ_WRITE_BYTE(0x56, 0x27, 0x54)
		RTQ_WRITE_BYTE(0x56, 0x28, 0x10)
		RTQ_WRITE_BYTE(0x56, 0x29, 0x22)
		RTQ_WRITE_BYTE(0x56, 0x2A, 0x00)
		RTQ_WRITE_BYTE(0x56, 0x2B, 0x00)
		RTQ_WRITE_BYTE(0x56, 0x2C, 0x08)
		RTQ_WRITE_WORD(0x56, 0x2D, 0x65, 0x00)
		RTQ_WRITE_BYTE(0x56, 0x2E, 0x82)
		RTQ_WRITE_WORD(0x56, 0x2F, 0x32, 0x00)
		RTQ_WRITE_BYTE(0x56, 0x30, 0xE9)
		RTQ_WRITE_BYTE(0x56, 0x31, 0x3F)
		RTQ_WRITE_BYTE(0x56, 0x32, 0x0F)
		RTQ_WRITE_BYTE(0x56, 0x33, 0x24)
		RTQ_WRITE_BYTE(0x56, 0x34, 0x1F)
		RTQ_WRITE_BYTE(0x56, 0x35, 0x11)
		RTQ_WRITE_BYTE(0x56, 0x36, 0x04)
		RTQ_WRITE_BYTE(0x56, 0x37, 0x4B)
		RTQ_WRITE_WORD(0x56, 0x38, 0x16, 0x00)
		RTQ_WRITE_WORD(0x56, 0x39, 0x60, 0x07)
		RTQ_WRITE_WORD(0x56, 0x3A, 0x03, 0x00)
		RTQ_WRITE_BYTE(0x56, 0x3B, 0x02)
		RTQ_WRITE_BYTE(0x56, 0x3C, 0x30)
		RTQ_WRITE_BYTE(0x56, 0x3D, 0x08)
		RTQ_WRITE_BYTE(0x56, 0x3E, 0x18)
		RTQ_WRITE_BYTE(0x56, 0x40, 0x03)
		RTQ_WRITE_BYTE(0x56, 0x41, 0x01)
		RTQ_WRITE_BYTE(0x56, 0x42, 0x01)
		RTQ_WRITE_BYTE(0x56, 0x43, 0x01)
		RTQ_WRITE_BYTE(0x56, 0x44, 0xD1)
		RTQ_WRITE_BYTE(0x56, 0x45, 0xA8)
		RTQ_WRITE_BYTE(0x56, 0x46, 0x2F)
		RTQ_WRITE_BYTE(0x56, 0x47, 0x0B)
		RTQ_WRITE_BYTE(0x56, 0x48, 0x2D)
		RTQ_WRITE_BYTE(0x56, 0x49, 0x00)
		RTQ_WRITE_BYTE(0x56, 0x4A, 0x64)
		RTQ_WRITE_BYTE(0x56, 0x4B, 0x61)
		RTQ_WRITE_BYTE(0x56, 0x4C, 0x11)
		RTQ_WRITE_BYTE(0x56, 0x4D, 0x00)
		RTQ_WRITE_BYTE(0x56, 0x4E, 0x80)
		RTQ_WRITE_BYTE(0x56, 0x4F, 0x00)
		RTQ_WRITE_BYTE(0x56, 0x50, 0x1F)
		RTQ_WRITE_BYTE(0x56, 0x51, 0x00)
		RTQ_WRITE_BYTE(0x56, 0x52, 0x02)
		RTQ_WRITE_BYTE(0x56, 0x53, 0x12)
		RTQ_WRITE_BYTE(0x56, 0x54, 0x23)
		RTQ_WRITE_BYTE(0x56, 0x55, 0x24)
		RTQ_WRITE_BYTE(0x56, 0x56, 0x1F)
		RTQ_WRITE_WORD(0x56, 0x57, 0xA1, 0x00)
		RTQ_WRITE_BYTE(0x56, 0x58, 0x04)
		RTQ_WRITE_WORD(0x56, 0x59, 0x6F, 0x00)
		RTQ_WRITE_BYTE(0x56, 0x5A, 0x04)
		RTQ_WRITE_BYTE(0x56, 0x5B, 0x07)
		RTQ_WRITE_BYTE(0x56, 0x5C, 0x0A)
		RTQ_WRITE_BYTE(0x56, 0x5D, 0x00)
		RTQ_WRITE_BYTE(0x56, 0x5E, 0x00)
		RTQ_WRITE_BYTE(0x56, 0x5F, 0x00)
		RTQ_WRITE_BYTE(0x56, 0x60, 0x01)
		RTQ_WRITE_BYTE(0x56, 0x61, 0x8C)
		RTQ_WRITE_BYTE(0x56, 0x62, 0xA5)
		RTQ_WRITE_BYTE(0x56, 0x63, 0x66)
		RTQ_WRITE_BYTE(0x56, 0x64, 0x35)
		RTQ_WRITE_BYTE(0x56, 0x65, 0x60)
		RTQ_WRITE_BYTE(0x56, 0x66, 0x2F)
		RTQ_WRITE_BYTE(0x56, 0x67, 0x3F)
		RTQ_WRITE_BYTE(0x56, 0x68, 0x3F)
		RTQ_WRITE_BYTE(0x56, 0x69, 0xC0)
		RTQ_WRITE_BYTE(0x56, 0x6A, 0x08)
		RTQ_WRITE_BYTE(0x56, 0x6B, 0xC6)
		RTQ_WRITE_WORD(0x56, 0x6C, 0x7A, 0x7A)
		RTQ_WRITE_BYTE(0x56, 0x6E, 0x40)
		RTQ_WRITE_WORD(0x56, 0x6F, 0x01, 0x00)
		RTQ_WRITE_BYTE(0x56, 0x70, 0x20)
		RTQ_WRITE_BYTE(0x56, 0x71, 0x24)
		RTQ_WRITE_BLOCK(0x56, 0x72, 0x05, 0x04 0x54 0x98 0x60 0x34)
		RTQ_WRITE_BLOCK(0x56, 0x73, 0x05, 0x04 0x00 0x00 0x54 0x98)
		RTQ_WRITE_BLOCK(0x56, 0x78, 0x05, 0x04 0x54 0x78 0x60 0x34)
		RTQ_WRITE_BLOCK(0x56, 0x79, 0x05, 0x04 0x00 0x00 0x54 0x78)
		RTQ_WRITE_WORD(0x56, 0x7E, 0x83, 0x01)
		RTQ_WRITE_BYTE(0x56, 0x7F, 0x52)
		RTQ_WRITE_BLOCK(0x56, 0x80, 0x05, 0x04 0x8B 0x01 0x00 0x00)
		RTQ_WRITE_BYTE(0x56, 0x82, 0x21)
		RTQ_WRITE_BLOCK(0x56, 0x85, 0x05, 0x04 0x40 0x01 0x01 0x00)
		RTQ_WRITE_BYTE(0x56, 0x86, 0x32)
		RTQ_WRITE_BYTE(0x56, 0x87, 0x48)
		RTQ_WRITE_BYTE(0x56, 0x88, 0x33)
		RTQ_WRITE_BLOCK(0x56, 0x89, 0x05, 0x04 0x64 0x03 0xC0 0x7F)
		RTQ_WRITE_WORD(0x56, 0x8C, 0x21, 0x21)
		RTQ_WRITE_BYTE(0x56, 0x8D, 0x02)
		RTQ_WRITE_BYTE(0x56, 0x8E, 0x8C)
		RTQ_WRITE_BYTE(0x56, 0x8F, 0x01)
		RTQ_WRITE_WORD(0x56, 0x90, 0xC0, 0xC0)
		RTQ_WRITE_BYTE(0x56, 0x91, 0x00)
		RTQ_WRITE_BLOCK(0x56, 0x92, 0x0A, 0x09 0x00 0x00 0x00 0x00 0x00 0x00 0x00 0x00 0x00)
		RTQ_WRITE_BYTE(0x56, 0x94, 0x00)
		RTQ_WRITE_BYTE(0x56, 0x95, 0x00)
		RTQ_WRITE_BYTE(0x56, 0x96, 0x00)
		RTQ_WRITE_BLOCK(0x57, 0x01, 0x05, 0x04 0x6A 0xAC 0x00 0x00)
		RTQ_WRITE_WORD(0x57, 0x02, 0xEE, 0x02)
		RTQ_WRITE_BYTE(0x57, 0x03, 0x4B)
		RTQ_WRITE_WORD(0x57, 0x04, 0x16, 0x1C)
		RTQ_WRITE_WORD(0x57, 0x05, 0x16, 0x16)
		RTQ_WRITE_BYTE(0x57, 0x06, 0x82)
		RTQ_WRITE_BYTE(0x57, 0x07, 0x24)
		RTQ_WRITE_BYTE(0x57, 0x08, 0x20)
		RTQ_WRITE_BYTE(0x57, 0x09, 0x20)
		RTQ_WRITE_BYTE(0x57, 0x0A, 0x20)
		RTQ_WRITE_BYTE(0x57, 0x0B, 0x20)
		RTQ_WRITE_BYTE(0x57, 0x0C, 0x20)
		RTQ_WRITE_BYTE(0x57, 0x0D, 0x20)
		RTQ_WRITE_BYTE(0x57, 0x0E, 0x20)
		RTQ_WRITE_BYTE(0x57, 0x0F, 0x20)
		RTQ_WRITE_BYTE(0x57, 0x10, 0x20)
		RTQ_WRITE_BYTE(0x57, 0x11, 0x20)
		RTQ_WRITE_BYTE(0x57, 0x12, 0x20)
		RTQ_WRITE_BYTE(0x57, 0x13, 0x20)
		RTQ_WRITE_BYTE(0x57, 0x14, 0x20)
		RTQ_WRITE_BYTE(0x57, 0x15, 0x20)
		RTQ_WRITE_BYTE(0x57, 0x16, 0x20)
		RTQ_WRITE_BYTE(0x57, 0x17, 0x20)
		RTQ_WRITE_BYTE(0x57, 0x19, 0x20)
		RTQ_WRITE_BYTE(0x57, 0x1A, 0x20)
		RTQ_WRITE_BYTE(0x57, 0x1B, 0x20)
		RTQ_WRITE_BYTE(0x57, 0x1C, 0x20)
		RTQ_WRITE_BYTE(0x57, 0x1E, 0x09)
		RTQ_WRITE_BYTE(0x57, 0x1F, 0x09)
		RTQ_WRITE_BYTE(0x57, 0x21, 0x09)
		RTQ_WRITE_BYTE(0x57, 0x22, 0x09)
		RTQ_WRITE_BYTE(0x57, 0x23, 0x09)
		RTQ_WRITE_BYTE(0x57, 0x24, 0x09)
		RTQ_WRITE_BYTE(0x57, 0x25, 0x09)
		RTQ_WRITE_BYTE(0x57, 0x26, 0x09)
		RTQ_WRITE_BYTE(0x57, 0x27, 0x09)
		RTQ_WRITE_BYTE(0x57, 0x28, 0x09)
		RTQ_WRITE_BYTE(0x57, 0x29, 0x09)
		RTQ_WRITE_BYTE(0x57, 0x2A, 0x09)
		RTQ_WRITE_BYTE(0x57, 0x2B, 0x09)
		RTQ_WRITE_BYTE(0x57, 0x2C, 0x09)
		RTQ_WRITE_BYTE(0x57, 0x2F, 0x09)
		RTQ_WRITE_BYTE(0x57, 0x30, 0x09)
		RTQ_WRITE_BYTE(0x57, 0x31, 0x09)
		RTQ_WRITE_BYTE(0x57, 0x32, 0x09)
		RTQ_WRITE_BLOCK(0x57, 0x33, 0x06, 0x05 0x08 0x21 0x84 0x10 0x42)
		RTQ_WRITE_BLOCK(0x57, 0x34, 0x06, 0x05 0x08 0x21 0x84 0x10 0x42)
		RTQ_WRITE_BLOCK(0x57, 0x35, 0x06, 0x05 0x39 0x23 0x8C 0x10 0x42)
		RTQ_WRITE_BLOCK(0x57, 0x36, 0x06, 0x05 0x39 0xE7 0x9C 0x73 0xCE)
		RTQ_WRITE_BLOCK(0x57, 0x37, 0x06, 0x05 0x39 0xE7 0x9C 0x73 0xCE)
		RTQ_WRITE_BYTE(0x57, 0x38, 0x19)
		RTQ_WRITE_BYTE(0x57, 0x39, 0x19)
		RTQ_WRITE_BYTE(0x57, 0x3A, 0x1D)
		RTQ_WRITE_BYTE(0x57, 0x3B, 0x19)
		RTQ_WRITE_BYTE(0x57, 0x3C, 0x00)
		RTQ_WRITE_BYTE(0x57, 0x3D, 0x10)
		RTQ_WRITE_BYTE(0x57, 0x3E, 0x10)
		RTQ_WRITE_BYTE(0x57, 0x3F, 0x10)
		RTQ_WRITE_BYTE(0x57, 0x40, 0x10)
		RTQ_WRITE_BYTE(0x57, 0x41, 0x10)
		RTQ_WRITE_BYTE(0x57, 0x42, 0x10)
		RTQ_WRITE_BYTE(0x57, 0x43, 0x10)
		RTQ_WRITE_BYTE(0x57, 0x44, 0x10)
		RTQ_WRITE_BYTE(0x57, 0x45, 0x10)
		RTQ_WRITE_BYTE(0x57, 0x46, 0x10)
		RTQ_WRITE_BYTE(0x57, 0x47, 0x10)
		RTQ_WRITE_BYTE(0x57, 0x48, 0x10)
		RTQ_WRITE_BYTE(0x57, 0x49, 0x10)
		RTQ_WRITE_BYTE(0x57, 0x4A, 0x10)
		RTQ_WRITE_BYTE(0x57, 0x4B, 0x10)
		RTQ_WRITE_BYTE(0x57, 0x4C, 0x10)
		RTQ_WRITE_BYTE(0x57, 0x4D, 0x10)
		RTQ_WRITE_BYTE(0x57, 0x4E, 0x10)
		RTQ_WRITE_BYTE(0x57, 0x4F, 0x10)
		RTQ_WRITE_BYTE(0x57, 0x50, 0x10)
		RTQ_WRITE_BYTE(0x57, 0x51, 0x10)
		RTQ_WRITE_BYTE(0x57, 0x52, 0x11)
		RTQ_WRITE_BYTE(0x57, 0x53, 0x11)
		RTQ_WRITE_BYTE(0x57, 0x54, 0x11)
		RTQ_WRITE_BYTE(0x57, 0x55, 0x11)
		RTQ_WRITE_BYTE(0x57, 0x56, 0x11)
		RTQ_WRITE_BYTE(0x57, 0x57, 0x11)
		RTQ_WRITE_BYTE(0x57, 0x58, 0x11)
		RTQ_WRITE_BYTE(0x57, 0x59, 0x11)
		RTQ_WRITE_BYTE(0x57, 0x5A, 0x11)
		RTQ_WRITE_BYTE(0x57, 0x5B, 0x11)
		RTQ_WRITE_BYTE(0x57, 0x5C, 0x11)
		RTQ_WRITE_BYTE(0x57, 0x5D, 0x11)
		RTQ_WRITE_BYTE(0x57, 0x5E, 0x11)
		RTQ_WRITE_BYTE(0x57, 0x5F, 0x11)
		RTQ_WRITE_BYTE(0x57, 0x60, 0x11)
		RTQ_WRITE_BYTE(0x57, 0x61, 0x11)
		RTQ_WRITE_BYTE(0x57, 0x62, 0x11)
		RTQ_WRITE_BYTE(0x57, 0x63, 0x11)
		RTQ_WRITE_BYTE(0x57, 0x64, 0x11)
		RTQ_WRITE_BYTE(0x57, 0x65, 0x11)
		RTQ_WRITE_BYTE(0x57, 0x66, 0x11)
		RTQ_WRITE_BYTE(0x57, 0x67, 0x11)
		RTQ_WRITE_WORD(0x57, 0x68, 0x50, 0x10)
		RTQ_WRITE_BYTE(0x57, 0x69, 0x30)
		RTQ_WRITE_BYTE(0x57, 0x6A, 0x30)
		RTQ_WRITE_BYTE(0x57, 0x6B, 0x30)
		RTQ_WRITE_BYTE(0x57, 0x6C, 0x26)
		RTQ_WRITE_BYTE(0x57, 0x6D, 0x27)
		RTQ_WRITE_BYTE(0x57, 0x6E, 0x98)
		RTQ_WRITE_BYTE(0x57, 0x6F, 0x98)
		RTQ_WRITE_WORD(0x57, 0x70, 0x40, 0x02)
		RTQ_WRITE_WORD(0x57, 0x71, 0x20, 0x00)
		RTQ_WRITE_BYTE(0x57, 0x72, 0x7F)
		RTQ_WRITE_BYTE(0x57, 0x73, 0x1E)
		RTQ_WRITE_BYTE(0x57, 0x74, 0x0E)
		RTQ_WRITE_BYTE(0x57, 0x75, 0x7F)
		RTQ_WRITE_BYTE(0x57, 0x76, 0x1C)
		RTQ_WRITE_BYTE(0x57, 0x77, 0x0C)
		RTQ_WRITE_BYTE(0x57, 0x78, 0x7F)
		RTQ_WRITE_BYTE(0x57, 0x79, 0x20)
		RTQ_WRITE_BYTE(0x57, 0x7A, 0x10)
		RTQ_WRITE_BYTE(0x57, 0x7B, 0x77)
		RTQ_WRITE_BYTE(0x57, 0x7C, 0x5A)
		RTQ_WRITE_BYTE(0x57, 0x7D, 0x3C)
		RTQ_WRITE_BYTE(0x57, 0x7E, 0x76)
		RTQ_WRITE_BYTE(0x57, 0x7F, 0x5A)
		RTQ_WRITE_BYTE(0x57, 0x80, 0x3C)
		RTQ_WRITE_BYTE(0x57, 0x81, 0x50)
		RTQ_WRITE_BYTE(0x57, 0x82, 0x50)
		RTQ_WRITE_BYTE(0x57, 0x83, 0x50)
		RTQ_WRITE_BYTE(0x57, 0x84, 0x23)
		RTQ_WRITE_BYTE(0x57, 0x85, 0x24)
		RTQ_WRITE_BYTE(0x57, 0x86, 0x88)
		RTQ_WRITE_BYTE(0x57, 0x87, 0x01)
		RTQ_WRITE_BYTE(0x57, 0x88, 0x0F)
		RTQ_WRITE_BYTE(0x57, 0x89, 0x0F)
		RTQ_WRITE_WORD(0x57, 0x8A, 0xF3, 0xFB)
		RTQ_WRITE_BLOCK(0x57, 0x8B, 0x05, 0x04 0x00 0x00 0x08 0x00)
		RTQ_WRITE_BLOCK(0x57, 0x8C, 0x04, 0x03 0x1E 0x0F 0x00)
		RTQ_WRITE_BLOCK(0x57, 0x8D, 0x04, 0x03 0x00 0x00 0x00)
		RTQ_WRITE_BLOCK(0x57, 0x8E, 0x04, 0x03 0x00 0x00 0x00)
		RTQ_WRITE_BLOCK(0x57, 0x9A, 0x05, 0x04 0x33 0xB3 0xFE 0x07)
		RTQ_WRITE_BLOCK(0x57, 0x9B, 0x05, 0x04 0xEC 0x51 0x01 0x04)
		RTQ_WRITE_BYTE(0x57, 0x9C, 0xBA)
		RTQ_WRITE_BYTE(0x57, 0x9D, 0x97)
		RTQ_WRITE_BYTE(0x57, 0x9E, 0x83)
		RTQ_WRITE_BYTE(0x57, 0x9F, 0xD5)
		RTQ_WRITE_BYTE(0x57, 0xA0, 0x26)
		RTQ_WRITE_BYTE(0x57, 0xA1, 0x26)
		RTQ_WRITE_BYTE(0x57, 0xA2, 0x26)
		RTQ_WRITE_BYTE(0x57, 0xA3, 0x26)
		RTQ_WRITE_BYTE(0x57, 0xA4, 0x11)
		RTQ_WRITE_BYTE(0x57, 0xA5, 0x11)
		RTQ_WRITE_BYTE(0x57, 0xA6, 0x11)
		RTQ_WRITE_BYTE(0x57, 0xA7, 0x1F)
		RTQ_WRITE_BYTE(0x57, 0xA8, 0x7D)
		RTQ_WRITE_BYTE(0x57, 0xA9, 0x1F)
		RTQ_WRITE_BYTE(0x57, 0xAA, 0x7D)
		RTQ_WRITE_BYTE(0x57, 0xAB, 0x1F)
		RTQ_WRITE_BYTE(0x57, 0xAC, 0x9A)
		RTQ_WRITE_BYTE(0x57, 0xAD, 0x1F)
		RTQ_WRITE_BYTE(0x57, 0xAE, 0x7D)
		RTQ_WRITE_BYTE(0x57, 0xAF, 0x1F)
		RTQ_WRITE_BYTE(0x57, 0xB0, 0xCA)
		RTQ_WRITE_BYTE(0x57, 0xB1, 0x25)
		RTQ_WRITE_BYTE(0x57, 0xB2, 0xCA)
		RTQ_WRITE_BYTE(0x57, 0xB3, 0x6E)
		RTQ_WRITE_WORD(0x57, 0xB4, 0x15, 0x0E)
		RTQ_WRITE_BYTE(0x57, 0xBB, 0x02)
		RTQ_WRITE_BYTE(0x57, 0xBC, 0x0F)
		RTQ_WRITE_BYTE(0x57, 0xBD, 0x00)
		RTQ_WRITE_BYTE(0x57, 0xBE, 0x8A)
		RTQ_WRITE_BYTE(0x57, 0xBF, 0x1C)
		RTQ_WRITE_BYTE(0x57, 0xC0, 0x1C)
		RTQ_WRITE_BYTE(0x57, 0xC1, 0x20)
		RTQ_WRITE_BYTE(0x57, 0xC2, 0x20)
		RTQ_WRITE_BYTE(0x57, 0xC3, 0x20)
		RTQ_WRITE_WORD(0x57, 0xC4, 0x29, 0x0B)
		RTQ_WRITE_BYTE(0x57, 0xC5, 0x0A)
		RTQ_WRITE_BYTE(0x57, 0xC6, 0x02)
		RTQ_WRITE_BYTE(0x57, 0xC7, 0x00)
		RTQ_WRITE_BYTE(0x57, 0xC8, 0x02)
		RTQ_WRITE_WORD(0x57, 0xCB, 0x1A, 0x02)
		RTQ_WRITE_BYTE(0x57, 0xCC, 0x42)
		RTQ_WRITE_BLOCK(0x57, 0xCD, 0x05, 0x04 0x0A 0x19 0x00 0x01)
		RTQ_WRITE_BLOCK(0x57, 0xCE, 0x05, 0x04 0x0A 0x19 0x00 0x00)
		RTQ_WRITE_BYTE(0x57, 0xCF, 0x00)
		RTQ_WRITE_WORD(0x57, 0xD0, 0x08, 0x00)
		RTQ_WRITE_BLOCK(0x57, 0xD1, 0x05, 0x04 0x00 0x00 0x00 0xB0)
		RTQ_WRITE_BYTE(0x57, 0xDA, 0x08)
		RTQ_WRITE_BYTE(0x57, 0xDB, 0x4B)
		RTQ_WRITE_BYTE(0x57, 0xDC, 0x03)
		RTQ_WRITE_BYTE(0x57, 0xDD, 0x06)
		RTQ_WRITE_WORD(0x57, 0xDE, 0x30, 0x02)
		RTQ_WRITE_WORD(0x57, 0xDF, 0x0E, 0x01)
		RTQ_WRITE_WORD(0x57, 0xE0, 0x32, 0x00)
		RTQ_WRITE_WORD(0x57, 0xE1, 0x29, 0x00)
		RTQ_WRITE_WORD(0x57, 0xE2, 0x80, 0x00)
		RTQ_WRITE_WORD(0x57, 0xE3, 0x80, 0x00)
		RTQ_WRITE_WORD(0x57, 0xE4, 0x40, 0x00)
		RTQ_WRITE_BYTE(0x57, 0xE6, 0x05)
		RTQ_WRITE_BYTE(0x57, 0xE7, 0x00)
		RTQ_WRITE_BYTE(0x57, 0xE8, 0x00)
		RTQ_WRITE_BYTE(0x57, 0xE9, 0x00)
		RTQ_WRITE_BYTE(0x58, 0x01, 0x00)
		RTQ_WRITE_BYTE(0x58, 0x02, 0x38)
		RTQ_WRITE_BLOCK(0x58, 0x03, 0x06, 0x05 0xC5 0x96 0x59 0xDE 0x9C)
		RTQ_WRITE_BLOCK(0x58, 0x04, 0x06, 0x05 0xE5 0x15 0x5B 0x66 0x79)
		RTQ_WRITE_BLOCK(0x58, 0x05, 0x06, 0x05 0x0D 0x34 0x50 0x6C 0x99)
		RTQ_WRITE_BLOCK(0x58, 0x06, 0x06, 0x05 0x1F 0x34 0xD0 0xC0 0x07)
		RTQ_WRITE_BYTE(0x58, 0x07, 0x00)
		RTQ_WRITE_BYTE(0x58, 0x08, 0x1F)
		RTQ_WRITE_BYTE(0x58, 0x09, 0x00)
		RTQ_WRITE_BYTE(0x58, 0x0A, 0x1F)
		RTQ_WRITE_BYTE(0x58, 0x0B, 0x00)
		RTQ_WRITE_BYTE(0x58, 0x0C, 0x1F)
		RTQ_WRITE_BYTE(0x58, 0x0D, 0x01)
		RTQ_WRITE_BYTE(0x58, 0x0E, 0x00)
		RTQ_WRITE_BLOCK(0x58, 0x0F, 0x06, 0x05 0x0F 0x3C 0xF0 0x00 0x98)
		RTQ_WRITE_BLOCK(0x58, 0x10, 0x06, 0x05 0x0F 0x3C 0xF0 0xC0 0x03)
		RTQ_WRITE_BYTE(0x58, 0x11, 0x00)
		RTQ_WRITE_BYTE(0x58, 0x12, 0x0F)
		RTQ_WRITE_BYTE(0x58, 0x13, 0x00)
		RTQ_WRITE_BYTE(0x58, 0x14, 0x0F)
		RTQ_WRITE_BYTE(0x58, 0x15, 0x00)
		RTQ_WRITE_BYTE(0x58, 0x16, 0x00)
		RTQ_WRITE_BLOCK(0x58, 0x17, 0x06, 0x05 0x1F 0x68 0xA0 0x01 0x98)
		RTQ_WRITE_BLOCK(0x58, 0x18, 0x06, 0x05 0x1F 0x7C 0xA0 0x81 0x06)
		RTQ_WRITE_BYTE(0x58, 0x19, 0x00)
		RTQ_WRITE_BYTE(0x58, 0x1A, 0x1F)
		RTQ_WRITE_BYTE(0x58, 0x1B, 0x00)
		RTQ_WRITE_BYTE(0x58, 0x1C, 0x1F)
		RTQ_WRITE_BYTE(0x58, 0x1D, 0x00)
		RTQ_WRITE_BYTE(0x58, 0x1E, 0x00)
		RTQ_WRITE_BLOCK(0x58, 0x1F, 0x06, 0x05 0x65 0x94 0x51 0x06 0x80)
		RTQ_WRITE_BLOCK(0x58, 0x20, 0x06, 0x05 0x30 0xC1 0x04 0x13 0x4C)
		RTQ_WRITE_BYTE(0x58, 0x21, 0x09)
		RTQ_WRITE_BYTE(0x58, 0x22, 0x10)
		RTQ_WRITE_BYTE(0x58, 0x23, 0x09)
		RTQ_WRITE_BYTE(0x58, 0x24, 0x10)
		RTQ_WRITE_BYTE(0x58, 0x25, 0x00)
		RTQ_WRITE_WORD(0x58, 0x26, 0x7D, 0x00)
		RTQ_WRITE_BYTE(0x58, 0x27, 0x54)
		RTQ_WRITE_BYTE(0x58, 0x28, 0x10)
		RTQ_WRITE_BYTE(0x58, 0x29, 0x22)
		RTQ_WRITE_BYTE(0x58, 0x2A, 0x00)
		RTQ_WRITE_BYTE(0x58, 0x2B, 0x00)
		RTQ_WRITE_BYTE(0x58, 0x2C, 0x08)
		RTQ_WRITE_WORD(0x58, 0x2D, 0x65, 0x00)
		RTQ_WRITE_BYTE(0x58, 0x2E, 0x82)
		RTQ_WRITE_WORD(0x58, 0x2F, 0x32, 0x00)
		RTQ_WRITE_BYTE(0x58, 0x30, 0xE9)
		RTQ_WRITE_BYTE(0x58, 0x31, 0x3F)
		RTQ_WRITE_BYTE(0x58, 0x32, 0x0F)
		RTQ_WRITE_BYTE(0x58, 0x33, 0x24)
		RTQ_WRITE_BYTE(0x58, 0x34, 0x1F)
		RTQ_WRITE_BYTE(0x58, 0x35, 0x11)
		RTQ_WRITE_BYTE(0x58, 0x36, 0x04)
		RTQ_WRITE_BYTE(0x58, 0x37, 0x4B)
		RTQ_WRITE_WORD(0x58, 0x38, 0x16, 0x00)
		RTQ_WRITE_WORD(0x58, 0x39, 0x60, 0x07)
		RTQ_WRITE_WORD(0x58, 0x3A, 0x03, 0x00)
		RTQ_WRITE_BYTE(0x58, 0x3B, 0x02)
		RTQ_WRITE_BYTE(0x58, 0x3C, 0x30)
		RTQ_WRITE_BYTE(0x58, 0x3D, 0x08)
		RTQ_WRITE_BYTE(0x58, 0x3E, 0x18)
		RTQ_WRITE_BYTE(0x58, 0x40, 0x03)
		RTQ_WRITE_BYTE(0x58, 0x41, 0x01)
		RTQ_WRITE_BYTE(0x58, 0x42, 0x01)
		RTQ_WRITE_BYTE(0x58, 0x43, 0x01)
		RTQ_WRITE_BYTE(0x58, 0x44, 0xD1)
		RTQ_WRITE_BYTE(0x58, 0x45, 0xA8)
		RTQ_WRITE_BYTE(0x58, 0x46, 0x2F)
		RTQ_WRITE_BYTE(0x58, 0x47, 0x0B)
		RTQ_WRITE_BYTE(0x58, 0x48, 0x2D)
		RTQ_WRITE_BYTE(0x58, 0x49, 0x00)
		RTQ_WRITE_BYTE(0x58, 0x4A, 0x64)
		RTQ_WRITE_BYTE(0x58, 0x4B, 0x61)
		RTQ_WRITE_BYTE(0x58, 0x4C, 0x11)
		RTQ_WRITE_BYTE(0x58, 0x4E, 0x80)
		RTQ_WRITE_BYTE(0x58, 0x4F, 0x00)
		RTQ_WRITE_BYTE(0x58, 0x50, 0x1F)
		RTQ_WRITE_BYTE(0x58, 0x51, 0x00)
		RTQ_WRITE_BYTE(0x58, 0x52, 0x03)
		RTQ_WRITE_BYTE(0x58, 0x53, 0x12)
		RTQ_WRITE_BYTE(0x58, 0x54, 0x1C)
		RTQ_WRITE_BYTE(0x58, 0x55, 0x24)
		RTQ_WRITE_BYTE(0x58, 0x56, 0x1F)
		RTQ_WRITE_WORD(0x58, 0x57, 0xA1, 0x00)
		RTQ_WRITE_BYTE(0x58, 0x58, 0x04)
		RTQ_WRITE_WORD(0x58, 0x59, 0x6F, 0x00)
		RTQ_WRITE_BYTE(0x58, 0x5A, 0x04)
		RTQ_WRITE_BYTE(0x58, 0x5B, 0x07)
		RTQ_WRITE_BYTE(0x58, 0x5C, 0x0A)
		RTQ_WRITE_BYTE(0x58, 0x5D, 0x00)
		RTQ_WRITE_BYTE(0x58, 0x5E, 0x00)
		RTQ_WRITE_BYTE(0x58, 0x5F, 0x00)
		RTQ_WRITE_BYTE(0x58, 0x60, 0x00)
		RTQ_WRITE_BYTE(0x58, 0x61, 0x8C)
		RTQ_WRITE_BYTE(0x58, 0x62, 0xA5)
		RTQ_WRITE_BYTE(0x58, 0x63, 0x66)
		RTQ_WRITE_BYTE(0x58, 0x64, 0x2A)
		RTQ_WRITE_BYTE(0x58, 0x65, 0x60)
		RTQ_WRITE_BYTE(0x58, 0x66, 0x2F)
		RTQ_WRITE_BYTE(0x58, 0x67, 0x34)
		RTQ_WRITE_BYTE(0x58, 0x69, 0xC0)
		RTQ_WRITE_BYTE(0x58, 0x6A, 0x08)
		RTQ_WRITE_BYTE(0x58, 0x6B, 0xC6)
		RTQ_WRITE_BYTE(0x58, 0x6C, 0x7A)
		RTQ_WRITE_BYTE(0x58, 0x6E, 0x40)
		RTQ_WRITE_WORD(0x58, 0x6F, 0x00, 0x00)
		RTQ_WRITE_BYTE(0x58, 0x70, 0x22)
		RTQ_WRITE_BYTE(0x58, 0x71, 0x26)
		RTQ_WRITE_WORD(0x58, 0x7E, 0x83, 0x01)
		RTQ_WRITE_BYTE(0x58, 0x7F, 0x52)
		RTQ_WRITE_BYTE(0x58, 0x82, 0x21)
		RTQ_WRITE_BLOCK(0x58, 0x85, 0x05, 0x04 0x40 0x01 0x01 0x00)
		RTQ_WRITE_BYTE(0x58, 0x86, 0x32)
		RTQ_WRITE_BYTE(0x58, 0x87, 0x08)
		RTQ_WRITE_BYTE(0x58, 0x88, 0x37)
		RTQ_WRITE_BLOCK(0x58, 0x89, 0x05, 0x04 0x64 0x03 0xC0 0x7F)
		RTQ_WRITE_WORD(0x58, 0x8C, 0x21, 0x21)
		RTQ_WRITE_BYTE(0x58, 0x8D, 0x02)
		RTQ_WRITE_BYTE(0x58, 0x8E, 0x8C)
		RTQ_WRITE_BYTE(0x58, 0x8F, 0x01)
		RTQ_WRITE_WORD(0x58, 0x90, 0x00, 0xC0)
		RTQ_WRITE_BYTE(0x58, 0x91, 0x00)
		RTQ_WRITE_BLOCK(0x58, 0x92, 0x0A, 0x09 0x00 0x00 0x00 0x00 0x00 0x00 0x00 0x00 0x00)
		RTQ_WRITE_BYTE(0x58, 0x94, 0xF8)
		RTQ_WRITE_BYTE(0x58, 0x95, 0x00)
		RTQ_WRITE_BYTE(0x58, 0x96, 0x00)
>;
	update-crc = <0x01E8>;
};
