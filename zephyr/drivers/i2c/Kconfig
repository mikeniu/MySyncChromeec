## zephyr/drivers/i2c/Kconfig
```kconfig
# Copyright 2026 The ChromiumOS Authors
# Use of this source code is governed by a BSD-style license that can be
# found in the LICENSE file.

config I2C_DTS_PASSTHRU
	bool "I2C Passthru DTS Restrictions Driver"
	depends on !PLATFORM_EC_I2C_PASSTHRU_RESTRICTED
	help
	  Enable the I2C Passthru DTS restrictions driver.

if I2C_DTS_PASSTHRU

module = I2C_DTS_PASSTHRU
module-str = i2c_dts_passthru
source "subsys/logging/Kconfig.template.log_config"

config I2C_PASSTHRU_MAX_MSGS
	int "The maximum number of messages in a passthru command"
	default 16
	help
	  We use a buffer to store the intermediates for i2c_transfer.
	  This config defines the buffer size.

config CMD_I2C_DTS_PROTECT
	bool "The EC console command to controll i2c protection"
	default y
	help
	  Enable EC console command to controll i2c protection.

endif # I2C_DTS_PASSTHRU
```

## zephyr/drivers/imvp/Kconfig
```kconfig
# Copyright 2026 The ChromiumOS Authors
# Use of this source code is governed by a BSD-style license that can be
# found in the LICENSE file.

config IMVP_RT3645
	bool "Enable support for richtek RT3645 IMVP"
	default y if DT_HAS_RICHTEK_RT3645_ENABLED
	help
	  Enable support for richtek RT3645 IMVP.

config IMVP_RTQ3700FH
	bool "Enable support for richtek RTQ3700FH IMVP"
	default y if DT_HAS_RICHTEK_RTQ3700FH_ENABLED
	help
	  Enable support for richtek RTQ3700FH IMVP.

config IMVP_RT3645_CONSOLE
	bool "Enable IMVP RT3645 console"
	depends on IMVP_RT3645
	help
	  Support accessing RT3645 IMVP registers through console commands.

config IMVP_RTQ3700FH_CONSOLE
	bool "Enable IMVP RTQ3700FH console"
	depends on IMVP_RTQ3700FH
	help
	  Support accessing RTQ3700FH IMVP registers through console commands.

config IMVP_FACTORY_UPDATE
	bool "Support imvp update in factory"
	depends on AP_PWRSEQ_DRIVER
	depends on IMVP_RT3645 || IMVP_RTQ3700FH
	default y
	help
	  Support update of IMVP registers during system boot.
```

## zephyr/drivers/pw_host_command/Kconfig
```kconfig
# Copyright 2026 The ChromiumOS Authors
# Use of this source code is governed by a BSD-style license that can be
# found in the LICENSE file.

config PLATFORM_EC_PW_HOST_COMMAND
	bool "Pigweed RPC Host Command Service"
	depends on ZEPHYR_PIGWEED_MODULE && NANOPB
	select PIGWEED_SYNC_MUTEX
	select PIGWEED_THREAD
	select PIGWEED_THREAD_SLEEP
	select PIGWEED_RPC_SERVER
	help
	  Enables the Pigweed RPC service to receive and execute ChromeOS EC
	  host commands over Pigweed RPC.

choice PIGWEED_LOG
	default PIGWEED_LOG_STRING if PLATFORM_EC_PW_HOST_COMMAND_UART_SERVER
endchoice

if PLATFORM_EC_PW_HOST_COMMAND

config PLATFORM_EC_PW_HOST_COMMAND_UART_SERVER
	bool "Enable HDLC UART RPC Server for Host Commands"
	default y
	depends on !ARCH_POSIX && !ZTEST
	help
	  Spawns a background thread listening for HDLC-encoded Pigweed RPC
	  host commands over the EC UART device.

config PLATFORM_EC_PW_HOST_COMMAND_MAX_PAYLOAD_SIZE
	int "Max payload size for Pigweed RPC Host Commands"
	default 512
	help
	  Specifies the maximum size in bytes for host command request and
	  response payloads transmitted over Pigweed RPC.

endif # PLATFORM_EC_PW_HOST_COMMAND
```

## zephyr/drivers/pwrmon/Kconfig
```kconfig
# Copyright 2026 The ChromiumOS Authors
# Use of this source code is governed by a BSD-style license that can be
# found in the LICENSE file.

config PWRMON
	bool "Power monitoring"
	default y
	depends on DT_HAS_CROS_PWRMON_ENABLED
	help
	  This option enables power monitoring which serves interface
	  between AP and power monitors.

choice PWRMON_POWER_MONITOR
	prompt "Select the power monitor shim"
	default PWRMON_POWER_MONITOR_PAC194X if DT_HAS_MICROCHIP_PAC194X_ENABLED
	default PWRMON_POWER_MONITOR_COMMON
	depends on PWRMON

config PWRMON_POWER_MONITOR_COMMON
	bool "Common zephyr sensor channels and attributes"
	help
	  This option enables common sensor channels for power monitors.

config PWRMON_POWER_MONITOR_PAC194X
	bool "PAC194x power monitor shim"
	help
	  This option enables shim for Microchip PAC194x/PAC195x family
	  of power monitors.

endchoice
```

## zephyr/drivers/switchcap/Kconfig
```kconfig
# Copyright 2026 The ChromiumOS Authors
# Use of this source code is governed by a BSD-style license that can be
# found in the LICENSE file.

config CROS_SWITCHCAP
	bool "ChromiumOS Switchcap drivers"
	default y
	depends on DT_HAS_CROS_EC_SWITCHCAP_ENABLED || \
		   DT_HAS_CROS_EC_SWITCHCAP_COMPARATOR_ENABLED
	help
	  Enables the switchcap drivers for ChromiumOS.

if CROS_SWITCHCAP

config CROS_SWITCHCAP_GPIO
	bool "ChromiumOS GPIO Switchcap driver"
	default y
	depends on DT_HAS_CROS_EC_SWITCHCAP_ENABLED
	depends on GPIO
	help
	  Enables the GPIO-controlled switchcap driver for ChromiumOS.

config CROS_SWITCHCAP_COMPARATOR
	bool "ChromiumOS Comparator Switchcap driver"
	default y
	depends on DT_HAS_CROS_EC_SWITCHCAP_COMPARATOR_ENABLED
	depends on GPIO
	depends on COMPARATOR
	help
	  Enables the switchcap driver with comparator power-good monitoring
	  for ChromiumOS.

endif # CROS_SWITCHCAP
```

## zephyr/dts/bindings/ascp/ascp-mem-map.yaml
```yaml
# Copyright 2026 The ChromiumOS Authors
# Use of this source code is governed by a BSD-style license that can be
# found in the LICENSE file.

description: ASCP memory map
compatible: "ascp,mem-map"
properties:
  pk-m:
    type: int
    required: true
  s-goog:
    type: int
    required: true
  pk-d:
    type: int
    required: true
  s-m:
    type: int
    required: true
  pk-f:
    type: int
    required: true
  h-f:
    type: int
    required: true
  s-d:
    type: int
    required: true
  sk-f:
    type: int
    required: true
```

## zephyr/dts/bindings/ascp/cros-ec,ascp-mem-map.yaml
```yaml
# Copyright 2026 The ChromiumOS Authors
# Use of this source code is governed by a BSD-style license that can be
# found in the LICENSE file.

description: ASCP memory map
compatible: "cros-ec,ascp-mem-map"
properties:
  pk-m:
    type: phandle
    required: true
  s-goog:
    type: phandle
    required: true
  pk-d:
    type: phandle
    required: true
  s-m:
    type: phandle
    required: true
  pk-f:
    type: phandle
    required: true
  h-f:
    type: phandle
    required: true
  s-d:
    type: phandle
    required: true
  sk-f:
    type: phandle
    required: true
```

## zephyr/dts/bindings/cbi/cros-ec,cbi-ufsc-keyboard-selector.yaml
```yaml
# Copyright 2026 The ChromiumOS Authors
# Use of this source code is governed by a BSD-style license that can be
# found in the LICENSE file.

include: base.yaml

description: Devicetree keyboard layout and matrix patch selector via CBI UFSC

compatible: "cros-ec,cbi-ufsc-keyboard-selector"

child-binding:
  description: Step or category patch selector (e.g. region, numpad, vivaldi)
  properties:
    selections:
      type: phandles
      required: true
      description: |
        Alternating list of <&ufsc_value &layout_patch_node>. The driver evaluates
        each UFSC condition and, upon a match, applies the patches described in the
        corresponding layout_patch_node.
```

## zephyr/dts/bindings/cbi/cros-ec,keyboard-layout-patch.yaml
```yaml
# Copyright 2026 The ChromiumOS Authors
# Use of this source code is governed by a BSD-style license that can be
# found in the LICENSE file.

include: base.yaml

description: Devicetree keyboard layout patch definition

compatible: "cros-ec,keyboard-layout-patch"

properties:
  vivaldi-config:
    type: phandle
    description: |
      Phandle to the active Vivaldi top-row configuration child node under
      cros-ec,vivaldi-keys.
  copies:
    type: array
    description: |
      Scancode copy list, given as pairs of coordinates:
      <dst_row dst_col>, <src_row src_col>, ...

      Each pair copies the scancode at <src_row src_col> to
      <dst_row dst_col>. The source keeps its own scancode, so this is a
      one way copy and not an exchange. In builds with
      CONFIG_PLATFORM_EC_KEYBOARD_DEBUG the keycap label is copied too.

      Entries are applied in order and later entries observe the writes made
      by earlier ones, which lets a board rotate several positions by
      chaining them.

      Example, remapping right-ctrl to the 102nd key for a CA-FR layout:
        copies = <3 14>, <2 7>;
```

## zephyr/dts/bindings/cros_rtc/ite,it82xx2-cros-rtc.yaml
```yaml
# Copyright 2026 The ChromiumOS Authors
# Use of this source code is governed by a BSD-style license that can be
# found in the LICENSE file.

description: ITE, it82xx2 Real time clock (RTC) node

compatible: "ite,it82xx2-cros-rtc"

include: base.yaml

properties:
  reg:
    required: true

  interrupts:
    required: true

  data-mode:
    type: string
    default: "bcd"
    enum:
      - "bcd"
      - "bin"
    description: |
      RTC register data mode configuration.
      "bcd": RTC registers use BCD format.
      "bin": RTC registers use binary format.
      Default: "bcd".

  hour-mode:
    type: string
    default: "24h"
    enum:
      - "12h"
      - "24h"
    description: |
      RTC hour mode configuration.
      "24h": 24-hour time format.
      "12h": 12-hour time format (AM/PM).
      Default: "24h".

  alarm-sel:
    type: string
    default: "ALARM1"
    enum:
      - "ALARM1"
      - "ALARM2"
    description: |
      Selects which RTC alarm channel is used by this device instance.
      - ALARM1: Uses CTLREGB set BIT(5) to enable alarm1 interrupt
      - ALARM2: Uses CTLREGB set BIT(3) to enable alarm2 interrupt
```

## zephyr/dts/bindings/cros_rtc/ite,it8xxx2-cros-rtc.yaml
```yaml
# Copyright 2026 The ChromiumOS Authors
# Use of this source code is governed by a BSD-style license that can be
# found in the LICENSE file.

description: ITE, it8xxx2 Real time clock (RTC) node

compatible: "ite,it8xxx2-cros-rtc"

include: base.yaml

properties:
  reg:
    required: true

  interrupts:
    required: true

  data-mode:
    type: string
    default: "bcd"
    enum:
      - "bcd"
      - "bin"
    description: |
      RTC register data mode configuration.
      "bcd": RTC registers use BCD format.
      "bin": RTC registers use binary format.
      Default: "bcd".

  daylight-saving:
    type: boolean
    description: |
      Enable daylight saving (DS) adjustment.
      Spring: time advances from 1:59:59 AM to 3:00:00 AM
              on the first Sunday in April.
      Fall:   time returns from 1:59:59 AM to 1:00:00 AM
              on the last Sunday in October.
```

## zephyr/dts/bindings/emul/cros,bma5xy-emul.yaml
```yaml
# Copyright 2026 The ChromiumOS Authors
# Use of this source code is governed by a BSD-style license that can be
# found in the LICENSE file.

description: Emulator for the BMA5xy family of accelerometers.

compatible: "cros,bma5xy-emul"

include: base.yaml

properties:
  reg:
    required: true
  motionsense-sensor:
    required: true
    type: phandle
    description: |
      Reference to the /motionsense-sensor node representing the sensor
      associated with this emulator.
```

## zephyr/dts/bindings/fingerprint/realtek,rts5817maa.yaml
```yaml
# Copyright 2026 The Chromium OS Authors. All rights reserved.
# Use of this source code is governed by a BSD-style license that can be
# found in the LICENSE file.

description: Realtek RTS5817MAA Fingerprint sensor.

compatible: "realtek,rts5817maa"

include: [spi-device.yaml]

properties:
  irq-gpios:
    type: phandle-array
    required: true
    description: |
      This property specifies the connection for sensor interrupt.

  reset-gpios:
    type: phandle-array
    required: true
    description: |
      This property specifies the connection for sensor reset.
```
